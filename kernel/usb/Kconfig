## kernel/usb/Kconfig
```kconfig
#
# USB Bus Interfaces
#

config ARCH_HAS_USB
	bool

config ARCH_HAS_USB_DEV
	bool
	select ARCH_HAS_USB

config ARCH_HAS_USB_HCD
	bool
	select ARCH_HAS_USB

config ARCH_HAS_USB_OTG
	bool
	select ARCH_HAS_USB

config ARCH_IS_USBD_ENDP_TXCMPL
	bool
	select USBD_XFR_ASYNC_TXAVAL

config ARCH_IS_USBD_ENDP_DUPLEX
	bool

config ARCH_HAS_USBD_ENDP_CSO
	bool

menuconfig USB
	bool "Universal serial bus (USB) support"
	select TIMER if !SYS_NOIRQ
	select BIT_FFS16

if USB

config USB_DEV
	bool "USB device controller (USBD) support"
	depends ARCH_HAS_USB_DEV || ARCH_HAS_USB_OTG
	select USBD_XFR_ASYNC if !USBD_XFR_SYNC
	select USBD_XFR_ADAPT if (USBD_XFR_SYNC && USBD_XFR_ASYNC)

config USB_HCD
	bool "USB host controller (HCD) support"
	depends ARCH_HAS_USB_HCD || ARCH_HAS_USB_OTG

config USB_OTG
	bool "USB On-The-Go (OTG) support"
	depends USB_DEV && USB_HCD && ARCH_HAS_USB_OTG

config USBD_ENDP_DUPLEX
	bool "Enable duplex endpoints support"
	depends ARCH_IS_USBD_ENDP_DUPLEX && EXPERIMENTAL
	default y

config USBD_DETACH
	bool "Enable bus detach support"
	depends ARCH_HAS_USBD_DETACH

config USBD_XFR_MASS
	bool "Enable massive transfer support"
	depends USB_DEV

config USBD_XFR_ADAPT
	bool "Enable adaptive device transfer support"
	depends USBD_XFR_SYNC
	depends USBD_XFR_ASYNC

config USBD_XFR_ASYNC
	bool "Enable asynchronous device transfer support"

config USBD_XFR_SYNC
	bool "Enable synchronous device transfer support"
	help
	  This enables tuned USB requests handling codes between the
	  usbd_request_set_sync and the usbd_request_clear_sync to work as
	  synchronous transfers.
	  Note that this is not always safe. There are situations that an
	  asynchronous STALL or SETUP token may be received by the USB
	  device controller when a transfer is running.  The USB device
	  controller driver may choose not to handle these events
	  correctly in usbd_hw_transfer_open/usbd_hw_transfer_close for
	  synchronous support as it's very difficult to stop current
	  running synchronous transfers through these implementations.

config USBD_BULK
	bool "Enable bulk transfer support"

config USBD_XFR_ASYNC_TXAVAL
	bool "Enable asynchronous TXAVAL emulation support"
	default n
	help
	  This is required for controllers with TXCMPL edge triggered
	  IRQs, but controllers with TXAVAL level triggered IRQs are safe
	  to enable this to emulate itself as a controller with TXCMPL
	  IRQs.  Note asynchronous task context transfer IO calls then can
	  not be disabled in this way, which might result in worse
	  performance on the controllers with TXAVAL IRQs.
	  If you are not sure, say N here.

config USBD_MAX_INTFS
	int "Number of interfaces (1~3)"
	range 1 3
	depends USB_DEV
	default 1
	help
	  Currently, we only support 3 kind of interfaces:
	    HID: Human interface device
	    MSD: Mass storage device
	    CCID: Curcuit card interface device
	  Since interface drivers can be disabled, you can also reduce
	  number of interfaces here to save memory.
	  If you are not sure, say 1 here.

source kernel/usb/scd/Kconfig
source kernel/usb/msd/Kconfig
source kernel/usb/hid/Kconfig

menuconfig USB_DFU
	bool "Device firmware upgrade (DFU) support"
	select CRC32

if USB_DFU

choice
	prompt "DFU protocol"
	help
	  You can only compile one protocol at a time.  The DFU mode
	  firmware should be put into the boot section in your hardware
	  while the runtime firmware could be put with the other interface
	  classes to form a USB composite device.

config DFU_RUNTIME
	bool "Runtime"

config DFU_DFUMODE
	bool "DFU mode"
	depends SYS_NOIRQ
	help
	  Since DFU interface has only one control endpoint which does not
	  require interval polling mechanism, it is safe to force USB
	  device stack running without timer support.

config DFU_FULLCMD
	bool "Full command set"

endchoice

config DFU_AUTO_RESET
	bool "Automatically reset after detach/manifestation"
	default y

endif

menuconfig USB_PN53X
	bool "NXP PN53X NFC device support"
	select PN53X

if USB_PN53X

endif

endif
```

## kernel/usb/hid/Kconfig
```kconfig
#
# HID Interfaces
#

menuconfig USB_HID
	bool "Human interface device (HID) support"

if USB_HID

config HID_DURATION
	bool "Enable HID duration support"
	depends TICK

config HID_MAX_REPORTS
	int "Number of HID reports (1~2)"
	range 1 2
	default 1
	help
	  Currently, we only support 2 kind of HID reports:
	    Keyboard (HID_KBD): Keyboard
	    Display (HID_LCD): Alphanumeric display
	  Since report drivers can be disabled, you can also reduce
	  number of reports here to save memory.
	  If you are not sure, say 1 here.

config HID_KBD
	bool "HID keyboard support"
	select KBD

endif
```

## kernel/usb/msd/Kconfig
```kconfig
#
# MSD Interfaces
#

menuconfig USB_MSD
	bool "Mass storage device (MSD) support"
	select USBD_XFR_MASS

if USB_MSD

choice
	prompt "MSD protocol selection"

#config MSD_CBI
#	bool "Control-bulk-interrupt"
#	depends EXPERIMENTAL

config MSD_BBB
	bool "Bulk-only"
	select MATH_MOD32
	help
	  Used for flash drives.

endchoice

choice
	prompt "MSD subclass selection"

config MSD_SCSI
	bool "SCSI transport command set"
	select SCSI
	select SCSI_TARGET
	select SCSI_BQUE
	select USBD_XFR_SYNC if MSD_BBB
	select USBD_BULK if MSD_BBB
	help
	  Used for SCSI storage devices.

endchoice

choice
	prompt "Hi > Di operation"
	depends MSD_BBB
	default MSD_BBB_LESS_PADDING
	help
	  Describe how device should act on Hi (host expects to receive
	  data from the devices) > Di (device intentds to send data to the
	  host) condition.

config MSD_BBB_LESS_PADDING
	bool "Padding up to dCBWDataTransferLegnth"
	help
	  The device may send fill data to padup to a total of
	  dCBWDataTransferLength.

config MSD_BBB_LESS_HALTING
	bool "Halting the Bulk-In pipe"
	help
	  If the device actually transfers less data than the host
	  indicated, then:
	    The device may end the transfer with a short packet.
	    The device shall stall the Bulk-In pipe.

endchoice

choice
	prompt "Base managed task attributes"
	depends MSD_SCSI
	default MSD_SCSI_SIMPLE

config MSD_SCSI_SIMPLE
	bool "SIMPLE"

config MSD_SCSI_ORDERED
	bool "ORDERED"

endchoice

endif
```

## kernel/usb/scd/Kconfig
```kconfig
#
# SCD Interfaces
#

menuconfig USB_SCD
	bool "Smart card device (SCD) support"
	select SCS

if USB_SCD

choice
	prompt "Version"
	default SCD_CCID

config SCD_CCID
	bool "Chip circuit interface (CCID)"
	select SCD_BULK
	select SCS
	select IFD

config SCD_ICCD
	bool "Integrated circuit card (ICCD)"

endchoice

config SCD_BULK
	bool "Enable bulk IN/OUT endpoint"
	default y

config SCD_INTERRUPT
	bool "Enable interrupt IN endpoint"
	default y
	help
	  This function may not required as our CCID has implemented
	  message queuing.  Some host side CCID drivers may require this
	  function.
	  If this option is enabled, CCID firmware can report slot status
	  changes and hardware errors through this optional interrupt
	  endpoint.
	  If you are not sure, say Y here.

choice
	prompt "SCD escape command vendor"
	default SCD_ESC_NONE

config SCD_ESC_NONE
	bool "None"

config SCD_ESC_ACR122
	bool "ACR122"

endchoice

if SCD_CCID

config CCID_INTERRUPT_HWERR
	bool "CCID hardware error interrupt support"
	depends SCD_INTERRUPT
	help
	  This feature is implemented but never used by any other modules
	  in this implementation.
	  If you are not sure, say N here.

config CCID_ABORT
	bool "Enable abort command support"

config CCID_SECURE
	bool "CCID secure command support"
	depends LCD && KBD
	default y
	help
	  This function is implemented according to what CCID specified.
	  If you are searching for a PC/SC part 10 support, this
	  implementation does not meet the requirement.
	  In order to enabling your hardware with this function,
	  A. Keyboard form factor is expected to follow EMV keypad layout
	     specification;
	  B. Keyboard driver is expected to present specified ascii codes
	     for the following key strokes:
	     1. cancel button: ESC (0x1B);
	     2. enter/OK button: CR (0x0D).

endif

if SCD_ICCD

choice
	prompt "ICCD lower"
	default ICCD_COS

config ICCD_COS
	bool "COS"
	select SCS
	select COS

config ICCD_SCD
	bool "SCS Cards"
	select SCS
	select SCS_CARD

endchoice

config ICCD_OLDVER
	bool "Enable old version number"

endif

endif
```

## lib/Kconfig
```kconfig
#
# Library Features
#

menu "Library setup"

menu "Bit-wise operations"

config BIT_FLS8
	bool "fls8"

config BIT_FLS16
	bool "fls16"

config BIT_FLS32
	bool "fls32"

config BIT_FLS64
	bool "fls64"

config BIT_FFS16
	bool "ffs16"

config BIT_FFS32
	bool "ffs32"

config BIT_FFS64
	bool "ffs64"

config BIT_HWEIGHT32
	bool "hweight32"

config BIT_HWEIGHT64
	bool "hweight64"

endmenu

menu "Bitmap operations"

config ARCH_HAS_BITS_PER_UNIT_16
	bool
	select BIT_FFS16
	select BIT_FLS16

config ARCH_HAS_BITS_PER_UNIT_32
	bool
	select BIT_FFS32
	select BIT_FLS32

config ARCH_HAS_BITS_PER_UNIT_64
	bool
	select BIT_FFS64
	select BIT_FLS64

config BIT_FIND_CLEAR
	bool "find_clear_bit"

endmenu

menu "Mathematic operations"

config MATH_GCD32
	bool "gcd32u"
	select MATH_MOD32

config MATH_MOD32
	bool "mod32u"

config MATH_MUL32
	bool "mul32u"

config MATH_MUL64
	bool "mul64u"

config MATH_DIV32
	bool "div32u"

config MATH_DIV64
	bool "div64u"

config MATH_MOD64
	bool "mod64u"

endmenu

menu "Checksum algorithms"

config CRC16_CCITT
	bool "CRC16 CCITT"

config CRC32
	bool "CRC32"

endmenu

config MATH_TAYLOR
	bool "Math lib based on Taylor series"

config STDLIB
	bool

menu "Print operations"

config PRINT_VSNPRINTF
	bool "vsnprintf"
	select STDLIB
	select MATH_MOD64
	select MATH_DIV64

config PRINT_SNPRINTF
	bool "snprintf"
	select PRINT_VSNPRINTF

config PRINT_VPRINTF
	bool "vprintf"
	select PRINT_VSNPRINTF

config PRINT_SPRINTF
	bool "sprintf"
	select PRINT_VSNPRINTF

config PRINT_VPRINTF
	bool "vprintf"
	select PRINT_VSNPRINTF

config PRINT_PRINTF
	bool "printf"
	select PRINT_VPRINTF

config PRINT_FP
	bool "floating point"

endmenu

menu "String operations"

config STRING_STRNCMP
	bool "strncmp"
	select STDLIB

config STRING_STRNCPY
	bool "strncpy"
	select STDLIB

config STRING_STRTOUL
	bool "strtoul"
	select STDLIB

config STRING_STRTOULL
	bool "strtoull"
	select STDLIB
	select MATH_MOD64
	select MATH_DIV64

config STRING_STRTOD
	bool "strtod"
	select STDLIB
	depends FP

config STRING_UUID
	bool "uuid"
	select PRINT_SNPRINTF

config STRING_GETOPT
	bool "getopt"
	select PRINT_PRINTF

config STRING_BYTELIST
	bool "byte list"

endmenu

menu "Time opeartions"

config TIME_CLOCK
	bool "clock"
	select MATH_DIV32

endmenu

menu "Cryptographic algorithms"

config CRYPTO_RAND
	bool "rand/srand"

endmenu

source lib/font/Kconfig

endmenu
```

## lib/font/Kconfig
```kconfig
#
# Font configuration
#
#
# Font Features
#

menuconfig FONTS
	bool "Compiled-in fonts"

if FONTS

choice
	prompt "Default font"
	default FONT_8x8

config FONT_8x8
	bool "VGA 8x8 font"

config FONT_8x16
	bool "VGA 8x16 font"

config FONT_6x11
	bool "Mac console 6x11 font (not supported by all drivers)"

config FONT_7x14
	bool "console 7x14 font (not supported by all drivers)"

config FONT_PEARL_8x8
	bool "Pearl (old m68k) console 8x8 font"

config FONT_ACORN_8x8
	bool "Acorn console 8x8 font"

config FONT_MINI_4x6
	bool "Mini 4x6 font"

config FONT_SUN8x16
	bool "Sparc console 8x16 font"

config FONT_SUN12x22
	bool "Sparc console 12x22 font (not supported by all drivers)"

config FONT_10x18
	bool "console 10x18 font (not supported by all drivers)"

endchoice

endif
```

## tests/Kconfig
```kconfig
#
# Firmware Tests
#

config TEST_VERBOSE
	bool "Enable verbosity in tests"

menuconfig TEST_BENCH
	bool "CPU remote/local test bench tests"
	select CRYPTO_RAND
	select STRING_STRNCMP
	select BIT_HWEIGHT64
	select PAGE

if TEST_BENCH

choice
	prompt "Test bench type"

config TEST_BENCH_LOCAL
	bool "Local CPU bench"
	help
	  The bench runs on the SMP boot core, testing other SMP cores as
	  long as the SMP boot core itself.

config TEST_BENCH_REMOTE
	bool "Remote CPU bench"
	help
	  The bench runs on a special boot core, which has no coherence
	  with other SMP cores and is responsible for power managing other
	  SMP cores.

endchoice

config TEST_BENCH_DIDT
	bool "Enable dI/dT power calibration mode"
	depends !SYS_NOIRQ
	select TIMER
	select TIMER_31BIT
	help
	  Allows multiple CPUs to execute tests simultaneously, and
	  repeatedly using timer. This mode is useful for power stress
	  tests.

config TEST_BENCH_START_DELAY
	int "Start delay alignment"
	depends SMP
	default 64
	help
	  In order to align all CPUs to execute tests simultaneously, CPUs
	  may start run after aligning current time to a start delay
	  interval. This should be a power of 2 value.

config TEST_BENCH_DEBUG
	bool "Enable bench debugging messages"

source tests/bench/Kconfig

endif

menuconfig TEST_LITMUS
	bool "Enable memory model litmus tests"
	select FP
	select STRING_STRTOD
	select TIME_CLOCK
	select CRYPTO_RAND
	select HEAP
	select TEST_BENCH

if TEST_LITMUS

config TEST_LITMUS_FINISH
	bool "Enable board finish after tesing"
	select FINISH

config TEST_LITMUS_CPU_CUSTOMIZED
	bool "Enable customized CPU mask"
	select BIT_HWEIGHT64
	help
	  Litmus source code is generated by configured CPU numbers. So
	  when it is meant to be tested using non-coutiguous core IDs, it
	  requires build time configurations to be aligned to the CPU
	  mask settings.

if TEST_LITMUS_CPU_CUSTOMIZED

config TEST_LITMUS_MAX_CPUS
	int "Number of CPUs"

config TEST_LITMUS_CPU_MASK
	hex "CPU masks"

endif

config TEST_LITMUS_DEBUG
	bool "Enable litmus debugging messages"

endif

config TEST_MEMTESTER
	bool "Enable memtester support"
	select STRING_GETOPT
	select STRING_STRTOULL
	select CRYPTO_RAND

if TEST_MEMTESTER

config MEMTESTER_NARROW_WRITES
	bool "Enable narrow writes support"

config MEMTESTER_PAGE
	bool "Enable page size (4K) boundary check"
	default y
	help
	  It is safer to enable 4K boundary check.

endif

config TEST_ESPI
	bool "Enable espi test"
```
