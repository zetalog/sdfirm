## tests/bench/Kconfig
```kconfig
#
# Firmware Tests
#

menu "Standard benchmark tests"

menuconfig DHRYSTONE
	bool "Dhrystone"
	select TIME_CLOCK

if DHRYSTONE

choice
	prompt "Dhrystone run rules"

config DHRYSTONE_GROUND_RULES
	bool "Ground rules"
	select DHRYSTONE_NO_INLINE
	help
	  - Seperate compilation;
	  - No procedure merging;
	  - Otherwise, compiler optimization are allowed but should be
	    indicated;
	  - default results are those without register declarations.

config DHRYSTONE_BEST_EFFORT
	bool "Best effort"
	select DHRYSTONE_REG
	select CC_OPT_SPEED

endchoice

config DHRYSTONE_REPEATS
	int "Dhyrstone number of runs"
	range 5000 5000000 if DHRYSTONE_TIME_CLOCK
	range 500 5000000 if DHRYSTONE_TIME_TSC
	default 5000

config DHRYSTONE_WARMUPS
	int "Dhrystone number of warmup runs"
	range 1 100
	default 1

config DHRYSTONE_TIME
	bool "Run dhrystone a specific time slot"

choice
	prompt "Time measure API"
	default DHRYSTONE_TIME_TSC

config DHRYSTONE_TIME_CLOCK
	bool "clock()"

config DHRYSTONE_TIME_TSC
	bool "tick()"

endchoice

config DHRYSTONE_TIMEOUT
	int "Dhrystone timeout (ticks or clocks)"
	depends DHRYSTONE_TIME
	range -1 1000000
	default -1

config DHRYSTONE_TSC_TOO_SMALL
	int "Too small ticks"
	depends DHRYSTONE_TIME_TSC
	default 2

config DHRYSTONE_REG
	bool "Use registers as dhrystone data"
	depends DHRYSTONE_BEST_EFFORT
	default y

config DHRYSTONE_NO_INLINE
	bool "Disallow inline function merging"
	depends DHRYSTONE_GROUND_RULES

choice
	prompt "Percpu mechanism"
	default DHRYSTONE_BENCH_PERCPU

config DHRYSTONE_BENCH_PERCPU
	bool "Bench percpu allocation"

config DHRYSTONE_GENERIC_PERCPU
	bool "SMP percpu variable"

config DHRYSTONE_SPECIFIC_PERCPU
	bool "Specific percpu arrary"

endchoice

endif

menuconfig LINPACK
	bool "Linpack"
	select FP
	select PRINT_SPRINTF

if LINPACK

config LINPACK_CALIBRATION_TIMEOUT
	int "Linpack calibration timeout (usecs)"
	range 1 1000000
	default 1

config LINPACK_CALIBRATION_REPEATS
	int "Linpack calibration repeats"
	range 1 10
	default 1

choice
	prompt "Percpu mechnism"
	default LINPACK_BENCH_PERCPU

config LINPACK_BENCH_PERCPU
	bool "Bench percpu allocation"

config LINPACK_GENERIC_PERCPU
	bool "SMP percpu allocation"

config LINPACK_SPECIFIC_PERCPU
	bool "Specific percpu array"

endchoice

endif

menuconfig COREMARK
	bool "CoreMark"
	select FP
	select PRINT_SPRINTF

if COREMARK

choice
	prompt "Run type"
	default COREMARK_RUN_PERFORMANCE

config COREMARK_RUN_PERFORMANCE
	bool "Performance"

config COREMARK_RUN_VALIDATION
	bool "Validation"

config COREMARK_RUN_PROFILE
	bool "Profile"

endchoice

choice
	prompt "Seed method"
	default COREMARK_SEED_VOLATILE

config COREMARK_SEED_VOLATILE
	bool "Volatile"

config COREMARK_SEED_ARG
	bool "Arguments"

config COREMARK_SEED_FUNC
	bool "Function"

endchoice

choice
	prompt "Memory method"
	default COREMARK_MEM_STATIC

config COREMARK_MEM_STATIC
	bool "Static"

config COREMARK_MEM_STACK
	bool "Stack"

config COREMARK_MEM_MALLOC
	bool "Malloc"
	depends HEAP

endchoice

choice
	prompt "Percpu mechanism"
	default COREMARK_STATIC_PERCPU

config COREMARK_STATIC_PERCPU
	bool "SMP percpu variable"

config COREMARK_STATIC_SPECIFIC
	bool "Specific percpu arrary"

endchoice

choice
	prompt "Time measure API"
	default COREMARK_TIME_TSC

config COREMARK_TIME_CLOCK
	bool "clock()"

config COREMARK_TIME_TSC
	bool "tick()"

endchoice

config COREMARK_ITERATIONS
	int "Iterations"
	default 0
	help
	  By default, the benchmark will run between 10-100 seconds. And
	  ITERATIONS is set to the 0. To override, use ITERATIONS=N

config COREMARK_TOTAL_DATA_SIZE
	int "Total size of data"
	default 2000 if !COREMARK_RUN_PROFILE
	default 1200 if COREMARK_RUN_PROFILE
	help
	  If not using malloc or command line arguments are not supported,
	  the buffer size for the algorithms must be defined via the
	  compiler define TOTAL_DATA_SIZE.  TOTAL_DATA_SIZE must be set to
	  2000 bytes (default) for standard runs.  The default for such a
	  target when testing different configurations could be...

config COREMARK_DEBUG
	bool "Enable debug run"

config COREMARK_PRINT_ARGS
	bool "Enable printing of CoreMark arguments"
	depends COREMARK_SEED_ARG

endif

menuconfig MEMSTREAM
	bool "Memory Stream"

if MEMSTREAM

config MEMSTREAM_STATIC_ARRAY
	bool "Use static array (rather than allocate dynamically)"
	default y

config MEMSTREAM_ARRAY_SIZE
	int "Array size"
	range 1000 8000000
	default 200000

config MEMSTREAM_NTIMES
	int "Running times"
	range 1 16
	default 2

config MEMSTREAM_TIME_ON
	bool "Turn on time operations"
	default n

endif

endmenu

source tests/bench/algo/Kconfig
source tests/bench/sanity/Kconfig
```

## tests/bench/algo/Kconfig
```kconfig
#
# Algorithm Tests
#

menuconfig TEST_ALGO
	bool "Simple algorithm tests"

if TEST_ALGO

config SHA256
	bool "256-bit SHA algorithm"

if SHA256

config SHA256_TEST_CNT 
	int "Count of tests"
	range 1 6
	default 2

endif

config MD5
	bool "MD5 algorithm"

if MD5

config MD5_TEST_CNT 
	int "Count of tests"
	range 1 6
	default 2

endif

config HANOITOWER
	bool "Hanoi Tower"

if HANOITOWER

config HANOITOWER_DEPTH
	int "Hanoi tower depth (the number of disks)"
	range 1 16
	default 4

endif

source tests/bench/algo/cfft/Kconfig
source tests/bench/algo/jpgenc/Kconfig
source tests/bench/algo/gen_ann/Kconfig

endif
```

## tests/bench/algo/gen_ann/Kconfig
```kconfig
config GENANN
	bool "General ANN and mini-test"

	select MATH_TAYLOR

if GENANN

config GENANN_BUF_ONE_PAGE
	bool "Allocate one page as data buffer"
	default y

config GENANN_LOOKUP_SIZE
	int "Lookup size of ANN"
	range 4 4096
	default 8 

config GENANN_TEST_BASIC
	bool "Run sub-test basic"
	default y

config GENANN_TEST_XOR
	bool "Run sub-test xor"
	default y

config GENANN_TEST_BACKPROP
	bool "Run sub-test backprop"
	default y

config GENANN_TEST_TRAIN_AND
	bool "Run sub-test train_and"
	default y

config GENANN_TEST_TRAIN_OR
	bool "Run sub-test train_or"
	default y

endif
```

## tests/bench/algo/jpgenc/Kconfig
```kconfig
config JPGENC
	bool "Jpeg Encoder"

if JPGENC

config JPGENC_SMALL_IMAGE
	bool "Use small image"
	default y

#config JPGENC_HEAP_MEM
	#bool "Use memory from heap"
	#default n

endif
```

## tests/bench/c_fft/Kconfig
```kconfig
config C_FFT
	bool "C-Implementations of FFT"
	# TODO select double floating-point
	select MATH_TAYLOR

if C_FFT

config C_FFT_VALUE_CNT
	int "Value count of FFT test"
	range 1 64
	default 30

endif
```

## tests/bench/cfft/Kconfig
```kconfig
config CFFT
	bool "C-Implementations of FFT"
	# TODO select double floating-point
	select MATH_TAYLOR

if CFFT

config CFFT_VALUE_CNT
	int "Value count of FFT test"
	range 1 64
	default 30

endif
```

## tests/bench/coremark/Kconfig
```kconfig
#
# CoreMark Tests
#

menuconfig COREMARK
	bool "CoreMark"

if COREMARK

config COREMARK_FORCE_VERY_QUICK
	bool "Use minimal data size and iteration count to run quickly"

config COREMARK_RUN_CNT
	int "How many times to run those iterations"
	default 3

config COREMARK_SIMPLE_REPORT
	bool "Give report of simple format"
	default y

config COREMARK_ITERATION_CNT
	int "CoreMark iterations count"
	depends !COREMARK_FORCE_VERY_QUICK
	default 200

endif
```

## tests/bench/sanity/Kconfig
```kconfig
#
# Sanity Tests
#

menuconfig TEST_SANITY
	bool "Sanity check tests"

if TEST_SANITY

menuconfig TLB_TEST
	bool "Test TLB flush"

if TLB_TEST

config TLB_TEST_FLUSH_RANGE
	bool "Test flush range"
	default y

config TLB_TEST_FLUSH_ALL
	bool "Test flush all"

endif

endif
```

## tests/raven/Kconfig
```kconfig
menuconfig RAVEN
	bool "ARM64 CPU verification (RAVEN)"
	depends ARM64

if RAVEN

config RAVEN_GLOBAL_VAR
	bool "Use global variables shared between CPUs"
	help
	  The test cases require to access shared global variables
	  between CPUs to create cache hit/miss.
	  Or the test cases are written with accessing shared global
	  variables, and are supposed to change the variables to the
	  same value on different CPUs, and the test results depend
	  on whether reading the variables return the expected
	  changed value.
	  Either way, means the cases are required to be run on CPUs
	  simultaneously.

config RAVEN_EXEC_VAR
	bool "Use global executable area"
	select RAVEN_GLOBAL_VAR
	help
	  The IU test cases require to access shared global variables
	  between CPUs that can be modified to contain executable
	  instructions and will jump the address to execute.

config RAVEN_PERCPU_VAR
	bool "Use per-CPU global variables"
	depends EXPERIMENTAL
	help
	  The test cases use per-cpu global variables to achieve
	  parallelism between CPUs.

config RAVEN_IU
	bool "ARM64 CPU instruction unit (IU) tests"
	depends ARM64

config RAVEN_IU_EXEC
	bool "ARM64 instruction unit (IU) executable tests"
	depends RAVEN_IU
	depends RAVEN_EXEC_VAR
	select MMU_SELF_MODIFY

config RAVEN_XU
	bool "ARM64 CPU execution unit (XU) tests"
	depends ARM64

config RAVEN_XU_SYNC
	bool "ARM64 execution unit (XU) synchronous tests"
	depends RAVEN_XU
	depends RAVEN_GLOBAL_VAR

config RAVEN_SU
	bool "ARM64 CPU storage unit (SU) tests"
	depends ARM64

config RAVEN_SU_SYNC
	bool "ARM64 storage unit (SU) synchronous tests"
	depends RAVEN_SU
	depends RAVEN_GLOBAL_VAR

config RAVEN_SU_PERCPU
	bool "ARM64 storage unit (SU) parallelized tests"
	depends RAVEN_SU
	depends RAVEN_PERCPU_VAR

config RAVEN_L2_SYNC
	bool "ARM64 CPU L2 cache (L2) synchronous tests"
	depends ARM64
	depends RAVEN_GLOBAL_VAR

endif
```

## tests/riscv/Kconfig
```kconfig
menu "RISCV system tests"

source tests/riscv/isa/Kconfig
source tests/riscv/litmus/Kconfig
source tests/riscv/iommu/Kconfig
source tests/riscv/nexus/Kconfig
source tests/riscv/trace/Kconfig

endmenu
```

## tests/riscv/iommu/Kconfig
```kconfig
#
# RISCV IOMMU Tests
#

menuconfig TESTS_IOMMU_RISCV
	bool "RISC-V IOMMU reference model tests"

if TESTS_IOMMU_RISCV

endif
```

## tests/riscv/litmus/Kconfig
```kconfig
#
# RISCV Litmus Tests
#

menuconfig TESTS_LITMUS_RISCV
	bool "RISC-V memory model litmus tests"
	depends TEST_LITMUS

if TESTS_LITMUS_RISCV

choice
	prompt "Select a LITMUS_RISCV test"
	default LITMUS_RISCV_DUMMY

config LITMUS_RISCV_DUMMY
	bool "Dummy"

config LB_2B_amoadd_2D_data_2D_amoadd_2E_rl_2B_amoadd_2E_aq_2D_data_2D_amoadd
        bool "LB_2B_amoadd_2D_data_2D_amoadd_2E_rl_2B_amoadd_2E_aq_2D_data_2D_amoadd"

config WRC_2B_fence_2E_rw_2E_rws_2B_fence_2E_rw_2E_rwsxx
        bool "WRC_2B_fence_2E_rw_2E_rws_2B_fence_2E_rw_2E_rwsxx"

endchoice
source tests/riscv/litmus/Kconfig.litmus

endif
```

## tests/riscv/nexus/Kconfig
```kconfig
#
# RISCV NEXUS Tests
#

menuconfig TESTS_NEXUS_RISCV
	bool "RISC-V NEXUS trace reference model tests"

if TESTS_NEXUS_RISCV

endif
```

## tests/riscv/trace/Kconfig
```kconfig
#
# RISCV Trace Tests
#

menuconfig TESTS_TRACE_RISCV
	bool "RISC-V Trace tests"

if TESTS_TRACE_RISCV

endif
```
