## arch/riscv/Kconfig
```kconfig
#
# For a description of the syntax of this configuration file,
# see Documentation/kbuild/kconfig-language.txt.
#

mainmenu "Small Device Firmware Configuration"

config 128BIT
	bool

config 64BIT
	select ARCH_HAS_BITS_PER_UNIT_64
	bool

config 32BIT
	select ARCH_HAS_BITS_PER_UNIT_32
	bool

config RISCV
	bool
	select RISCV_A if SMP
	select RISCV_SV if MMU
	select RISCV_F if (FP && CPU_F)
	select RISCV_D if (FP && CPU_D)
	select ARCH_HAS_THREAD
	select STRING_STRNCMP if FDT
	select PRINT_SNPRINTF if FDT
	default y
	# even on 32-bit, physical (and DMA) addresses are > 32-bits

config FDT_BUILTIN
	bool

source "init/Kconfig"

menu "RISCV system options"

choice
	prompt "RISCV system type"
	default ARCH_VEGA

config ARCH_DUOWEN
	bool "SmarCo MC Duowen"
	select ARCH_IS_TICKLESS
	select ARCH_HAS_TSC
	select ARCH_HAS_TSC_CONST
	select ARCH_HAS_IRQC
	select ARCH_HAS_CLK
	select ARCH_HAS_CLINT
	select ARCH_HAS_PLIC
	select ARCH_HAS_PLIC_EOI_EARLY
	select ARCH_HAS_GPIO
	select ARCH_HAS_DDR
	select ARCH_HAS_DDR_SPD
	select ARCH_HAS_PCI
	select ARCH_HAS_SD
	select ARCH_HAS_I2C
	select ARCH_HAS_SPI
	select ARCH_HAS_DMAC
	select ARCH_HAS_IOMMU
	select ARCH_HAS_FDT
	select ARCH_HAS_NOVEC
	select ARCH_HAS_APB_40
	select ARCH_HAS_SSI_FIFO
	select ARCH_HAS_SSI_XFER_32
	select ARCH_HAS_SSI_FRF
	select ARCH_HAS_SSI_SPI
	select ARCH_HAS_SSI_SPI_1WIRE
	select ARCH_HAS_RAS
	select ARCH_HAS_NOC
	select ARCH_HAS_ETH
	select ARCH_HAS_BOOT0
	select ARCH_HAS_BOOT1
	select ARCH_HAS_BOOT2
	select DUOWEN_TMR
	select DUOWEN_SCSR
	select RISCV_COUNTERS if SBI
	select FDT_BUILTIN if SBI_FDT
	select CLINT if DUOWEN_APC
	select PLIC if !SYS_NOIRQ
	select CRCNTL
	select DUOWEN_GPIO if GPIO
	select DUOWEN_UART if CONSOLE || DEBUG_PRINT
	select DUOWEN_SSI_FLASH if SPI_MASTER
	select DUOWEN_SD if MMCSD
	select DUOWEN_PCIE if PCI
	select DUOWEN_I2C if I2C_MASTER
	select DUOWEN_DDR if DDR
	select DUOWEN_DMAC if DMA
	select DUOWEN_SMMU_SV if IOMMU
	select VAISRA_RAS if RAS
	help
	  This enables support for smart core (SmarCo) duowen riscv cluster
	  platforms.

config ARCH_DPU
	bool "SmarCo DPU"
	select ARCH_IS_TICKLESS
	select ARCH_HAS_CLINT if DPU_RES
	select ARCH_HAS_TSC
	select ARCH_HAS_TSC_CONST
	select ARCH_HAS_GPT
	select ARCH_HAS_IRQC
	select ARCH_HAS_CLK if !DPU_SIM_CLK
	select ARCH_HAS_GPIO
	select ARCH_HAS_I2C
	select ARCH_HAS_SPI
	select ARCH_HAS_DMAC
	select ARCH_HAS_DDR
	select ARCH_HAS_DDR_SPD
	select ARCH_HAS_PCI
	select ARCH_HAS_PLIC
	select ARCH_HAS_FDT
	select ARCH_HAS_PLIC_EOI_EARLY
	select ARCH_HAS_NOVEC
	select ARCH_HAS_APB_40
	select ARCH_HAS_BOOT0 if DPU_APC
	select ARCH_HAS_BOOT1 if DPU_APC
	select ARCH_HAS_BOOT2 if DPU_APC
	select DPU_TCSR
	select DPU_TMR
	select DPU_CLINT if DPU_RES
	select RI5CY_FIRQ if (!SYS_NOIRQ && DPU_CV32E40P)
	select FDT_BUILTIN if SBI_FDT
	select DPU_PLIC if !SYS_NOIRQ
	select DPU_PLL if CLK
	select DPU_GPIO if GPIO
	select DPU_SSI_FLASH if SPI_MASTER
	select DPU_UART if CONSOLE || DEBUG_PRINT
	select DPU_I2C if I2C_MASTER
	select DPU_DDR if DDR
	select DPU_PCI_SUBSYS if PCI
	select RI5CY_PC if (PERF && DPU_CV32E40P)
	select HPM if (PERF && DPU_CVA6)
	help
	  This enables support for smart core (SmarCo) DPU platform.

config ARCH_VAISRA
	bool "SmarCo MC Vaisra"
	select CPU_VAISRA
	select ARCH_HAS_NOVEC
	select ARCH_IS_TICKLESS
	select ARCH_HAS_TSC
	select ARCH_HAS_TSC_CONST
	select ARCH_HAS_GPT
	select ARCH_HAS_IRQC
	select ARCH_HAS_CLINT
	select ARCH_HAS_FDT
	select RISCV_COUNTERS if SBI
	select CLINT
	select VAISRA_TBOX if SYS_IRQ
	select VAISRA_TBOX if SHUTDOWN
	select VAISRA_UART if CONSOLE || DEBUG_PRINT
	help
	  This enables support for smart core (SmarCo) vaisra riscv CPU
	  (core of DUOWEN) bench platforms.

config ARCH_VIRAPA
	bool "SmarCo MP Virapa"
	select CPU_VIRAPA
	select ARCH_HAS_NOVEC
	select ARCH_IS_TICKLESS
	select ARCH_HAS_TSC
	select ARCH_HAS_TSC_CONST
	select ARCH_HAS_GPT
	select ARCH_HAS_IRQC
	select ARCH_HAS_CLINT
	select ARCH_HAS_FDT
	select RISCV_COUNTERS if SBI
	select CLINT
	select VAISRA_TBOX if SYS_IRQ
	select VAISRA_TBOX if SHUTDOWN
	select VIRAPA_UART if CONSOLE || DEBUG_PRINT
	help
	  This enables support for smart core (SmarCo) varapa riscv CPU
	  (core of GUANGMU) bench platforms.
	  Note that this test bench will be greatly changed when more
	  features are added to virapa via small projects (virapa_rvh,
	  virapa_rvv, virapa_imsic...). Currently there is only virapa_chi
	  project feature implemented in this test bench.

config ARCH_UNLEASHED
	bool "SiFive HiFive Unleashed (FU540)"
	select ARCH_IS_TICKLESS
	select ARCH_HAS_TSC
	select ARCH_HAS_TSC_CONST
	select ARCH_HAS_IDLE
	select ARCH_HAS_GPT
	select ARCH_HAS_GPIO
	select ARCH_HAS_CLK
	select ARCH_HAS_CLINT
	select ARCH_HAS_PLIC
	select ARCH_HAS_IRQC
	select ARCH_HAS_SPI
	select ARCH_HAS_SD
	select PLIC if !SYS_NOIRQ
	select PRCI if CLK
	select SIFIVE_UART if UART || DEBUG_PRINT || CONSOLE
	select SIFIVE_QSPI if SPI
	select UNLEASHED_SDCARD if MMCSD
	select ARCH_HAS_FDT
	select CLINT
	select RISCV_SV if MMU
	help
	  This enables support for SiFive Freedom U540 SoC support.

config ARCH_K210
	bool "Kendryte K210"
	select CPU_U54
	select ARCH_IS_TICKLESS
	select ARCH_HAS_TSC
	select ARCH_HAS_TSC_CONST
	select ARCH_HAS_IDLE
	select ARCH_HAS_GPT
	select ARCH_HAS_GPIO
	select ARCH_HAS_CLK
	select ARCH_HAS_CLINT
	select ARCH_HAS_PLIC
	select ARCH_HAS_IRQC
	select ARCH_HAS_FDT
	select K210_SYSCTL if CLK
	select PLIC if !SYS_NOIRQ
	select CLINT
	select FPIOA if GPIO
	select UARTHS if UART || DEBUG_PRINT || CONSOLE
	help
	  This enables support for Kendryte K210 SoC support.

config ARCH_VEGA
	bool "Open-ISA VEGA-Lite (RV32M1)"
	select RISCV_VIRQ
	select ARCH_IS_TICKLESS
	select ARCH_HAS_TSC
	select ARCH_HAS_TSC_CONST
	select ARCH_HAS_GPT
	select ARCH_HAS_GPIO
	select ARCH_HAS_IDLE
	select ARCH_HAS_CLK
	select ARCH_HAS_IRQC
	select LPUART if UART || DEBUG_PRINT || CONSOLE
	select IRQC_EVENT if !SYS_NOIRQ
	select VEGA_CLOCK_DIST if CLK
	select MATH_DIV32
	select MATH_MOD32
	select BIT_FLS16
	help
	  This enables support for NXP, Open-ISA IoT platforms.

config ARCH_K1MAX
	bool "Spacemit K1MAX"
	select CPU_SPACEMIT
	select ARCH_IS_MMIO_32BIT
	select ARCH_IS_TICKLESS
	select ARCH_HAS_NOVEC
	select ARCH_HAS_TSC
	select ARCH_HAS_TSC_CONST
	select ARCH_HAS_GPT
	select ARCH_HAS_IRQC
	select ARCH_HAS_CLINT
	select ARCH_HAS_PLIC
	select ARCH_HAS_FDT
	select ARCH_HAS_UART
	select ARCH_HAS_CLK
	select ARCH_HAS_CLK_GENERIC
	select ARCH_HAS_BOOT0 if !CPU_CVA6
	select ARCH_HAS_BOOT1 if !CPU_CVA6
	select ARCH_HAS_BOOT2 if !CPU_CVA6
	select CLINT
	select PLIC if !SYS_NOIRQ
	select ARCH_HAS_NOC if K1M_SOC || K1M_K1X
	select K1MATRIX_CRU
	select K1M_UART if CONSOLE || DEBUG_PRINT
	help
	  This enables support for spacemit k1max IoT platform.

config ARCH_K1X
	bool "Spacemit K1X"
	select CPU_SPACEMIT
	select ARCH_IS_MMIO_32BIT
	select ARCH_IS_TICKLESS
	select ARCH_HAS_NOVEC
	select ARCH_HAS_TSC
	select ARCH_HAS_TSC_CONST
	select ARCH_HAS_GPT
	select ARCH_HAS_IRQC
	select ARCH_HAS_CLINT
	select ARCH_HAS_PLIC
	select ARCH_HAS_FDT
	select ARCH_HAS_UART
	select ARCH_HAS_CLK
	select ARCH_HAS_CLK_GENERIC
	select ARCH_HAS_BOOT0
	select ARCH_HAS_BOOT1
	select ARCH_HAS_BOOT2
	select CLINT
	select PLIC if !SYS_NOIRQ
	select ARCH_HAS_NOC if K1M_SOC || K1M_K1X
	select K1X_UART if CONSOLE || DEBUG_PRINT
	help
	  This enables support for spacemit k1max IoT platform.

config ARCH_K1MXLITE
	bool "SpacemiT K1MXLite Family"
	select CPU_SPACEMIT
	select ARCH_IS_MMIO_32BIT
	select ARCH_IS_TICKLESS
	select ARCH_HAS_NOVEC
	select ARCH_HAS_TSC
	select ARCH_HAS_TSC_CONST
	select ARCH_HAS_GPT
	select ARCH_HAS_IRQC
	select ARCH_HAS_CLINT
	select ARCH_HAS_PLIC
	select ARCH_HAS_FDT
	select ARCH_HAS_UART
	select ARCH_HAS_NOC
	select ARCH_HAS_PCI
	select ARCH_HAS_CLK
	select ARCH_HAS_LPC
	select ARCH_HAS_KCS
	select ARCH_HAS_CLK_GENERIC
	select ARCH_HAS_BOOT0
	select ARCH_HAS_BOOT1
	select ARCH_HAS_BOOT2
	select ARCH_HAS_PMU if K1MXLITE
	select ARCH_HAS_CLINT_MULTI if K1MXLITE_D2D && (K1MXLITE_BBL || K1MXLITE_TB)
	select CLINT
	select PLIC if !SYS_NOIRQ
	select K1MXLITE_UART if CONSOLE || DEBUG_PRINT
	select K1MXLITE_LPC if LPC
	select K1MXLITE_KCS if KCS
	help
	  This enables support for SpacemiT K1MXLite server platforms.

config ARCH_K1MATRIX
	bool "SpacemiT K1Matrix Family"
	select ARCH_IS_MMIO_32BIT
	select ARCH_IS_TICKLESS
	select ARCH_HAS_NOVEC
	select ARCH_HAS_TSC
	select ARCH_HAS_TSC_CONST
	select ARCH_HAS_GPT
	select ARCH_HAS_IRQC
	select ARCH_HAS_ACLINT
	select ARCH_HAS_PLIC if K1MATRIX_RMU
	select ARCH_HAS_AIA_IMSIC if K1MATRIX_APU
	select ARCH_HAS_AIA_APLIC if K1MATRIX_APU
	select ARCH_HAS_FDT
	select ARCH_HAS_UART
	select ARCH_HAS_NOC
	select ARCH_HAS_PCI
	select ARCH_HAS_CLK
	select ARCH_HAS_LPC
	select ARCH_HAS_KCS
	select ARCH_HAS_ESPI
	select ARCH_HAS_CLK
	select ARCH_HAS_CLK_GENERIC
	select ARCH_HAS_BOOT0
	select ARCH_HAS_BOOT1
	select ARCH_HAS_BOOT2
	select ARCH_HAS_I2C
	select ARCH_HAS_DDR_SPD
	select ARCH_HAS_PMU if K1MATRIX
	select ACLINT
	select PLIC if !SYS_NOIRQ && K1MATRIX_RMU
	select AIA_APLIC if !SYS_NOIRQ && K1MATRIX_APU
	select K1MATRIX_UART if CONSOLE || DEBUG_PRINT
	select K1MATRIX_CRU if CLK
	select K1MATRIX_LPC if LPC
	select K1MATRIX_ESPI if ESPI
	select K1MATRIX_KCS if KCS_BMC
	select K1MATRIX_I2C if I2C
	help
	  This enables support for SpacemiT K1Matrix server platforms.

config ARCH_COREV
	bool "OpenHW Group Core-V Family"
	select RISCV_VIRQ
	select ARCH_IS_TICKLESS
	select ARCH_HAS_TSC
	select ARCH_HAS_TSC_CONST
	select ARCH_HAS_GPT
	select ARCH_HAS_IDLE
	select ARCH_HAS_IRQC
	select ARCH_HAS_UART
	select COREV_TIMER
	select COREV_PRINT if UART || DEBUG_PRINT || CONSOLE
	#select IRQC_EVENT if !SYS_NOIRQ
	help
	  This enables support for OpenHW Group verification platform.
	  Which runs PULP CV32E40P (ri5cy) and CVA6 (ariane) CPU benches.

config ARCH_SPIKE
	bool "RISC-V ISA simulator (spike)"
	select ARCH_IS_TICKLESS
	select ARCH_HAS_TSC
	select ARCH_HAS_TSC_CONST
	select ARCH_HAS_GPT
	select ARCH_HAS_IRQC
	select ARCH_HAS_UART
	select ARCH_HAS_NOVEC
	select ARCH_HAS_FDT
	select ARCH_HAS_HTIF
	select ARCH_HAS_NS16550
	select ARCH_HAS_CONSOLE_EARLY
	select SPIKE_UART if UART || DEBUG_PRINT || CONSOLE
	select SPIKE_CLINT if !SYS_NOIRQ
	help
	  This enables support for simulated riscv platforms.

config ARCH_VIRT
	bool "QEMU RISC-V VIRT platform"
	select ARCH_IS_TICKLESS
	select ARCH_HAS_NOVEC
	select ARCH_HAS_TSC
	select ARCH_HAS_TSC_CONST
	select ARCH_HAS_GPT
	select ARCH_HAS_CLINT
	select ARCH_HAS_PLIC
	select ARCH_HAS_IRQC
	select ARCH_HAS_NS16550
	select ARCH_HAS_FDT
	select CLINT
	select PLIC if !SYS_NOIRQ
	select VIRT_UART if UART || DEBUG_PRINT || CONSOLE
	help
	  This enables support for RISC-V VIRT platform.

endchoice

source "arch/riscv/common/Kconfig"
source "arch/riscv/sbi/Kconfig"
source "arch/riscv/fdt/Kconfig"

endmenu

source "arch/riscv/mach-duowen/Kconfig"
source "arch/riscv/mach-dpu/Kconfig"
source "arch/riscv/mach-vaisra/Kconfig"
source "arch/riscv/mach-virapa/Kconfig"
source "arch/riscv/mach-unleashed/Kconfig"
source "arch/riscv/mach-k210/Kconfig"
source "arch/riscv/mach-vega/Kconfig"
source "arch/riscv/mach-k1max/Kconfig"
source "arch/riscv/mach-k1x/Kconfig"
source "arch/riscv/mach-k1mxlite/Kconfig"
source "arch/riscv/mach-k1matrix/Kconfig"
source "arch/riscv/mach-corev/Kconfig"
source "arch/riscv/mach-spike/Kconfig"
source "arch/riscv/mach-virt/Kconfig"

source "kernel/Kconfig"
source "drivers/Kconfig"

menu "Test setup"
source "tests/Kconfig"
source "tests/riscv/Kconfig"
endmenu

source "lib/Kconfig"
source "init/Kconfig.debug"
```

## arch/riscv/acpi/Kconfig
```kconfig
#
# Advance configuration and power management interface (ACPI)
#

if ACPI

menu "RISCV specific ACPI options"

endmenu

endif
```
