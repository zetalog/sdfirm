## arch/mcs51/mach-at8xc5122/Kconfig
```kconfig
#
# For a description of the syntax of this configuration file,
# see scripts/kbuild/config-language.txt.
#

menu "Atmel AT8XC5122 board options"

choice
	prompt "CPU clock source"
	default CPU_AT8XC5122_PLL

config CPU_AT8XC5122_PLL
	bool "PLL"

config CPU_AT8XC5122_OSC
	bool "On-chip oscillator"
	depends EXPERIMENTAL

endchoice

choice
	prompt "On-chip oscillator frequency"
	depends CPU_AT8XC5122_OSC

config OSC_AT8XC5122_FREQ_24M
	depends !USB_AT8XC5122
	bool "24M"

config OSC_AT8XC5122_FREQ_48M
	bool "48M"

endchoice

config CPU_AT8XC5122_X2
	bool "Enable CPU X2 mode"
	depends CPU_AT8XC5122_OSC
	help
	  Only in this mode, the peripherals can be resumed independent of
	  the global system suspended state.

choice
	prompt "CPU frequency fed by PLL"
	depends CPU_AT8XC5122_PLL

config CPU_AT8XC5122_FREQ_24M
	bool "24M"

config CPU_AT8XC5122_FREQ_48M
	bool "48M"

endchoice

menuconfig GPT_AT8XC5122
	bool "Atmel AT8XC5122 general purpose timer support"
	depends TIMER || TICK
	select ARCH_HAS_GPT
	default y

if GPT_AT8XC5122
endif

menuconfig UART_AT8XC5122
	bool "Atmel AT8XC5122 serial port support"
	depends UART
	select ARCH_HAS_UART
	default y

if UART_AT8XC5122

config UART_AT8XC5122_TIMER1
	bool "Enable timer1 baudrate generator"
	depends EXPERIMENTAL
	help
	  Default select the internal baud rate generator in mode0.
	  Enable this will use Timer1 as baud rate generator source.

endif

menuconfig KBD_AT8XC5122
	bool "Atmel AT8XC5122 keyboard controller support"
	depends KBD
	default y
	help
	  This driver can only support such keyboards whose column
	  scanners are assigned to some P5 PINs, part of which should be
	  used as the row scanners to enable keyboard line interrupts
	  (KBE).

if KBD_AT8XC5122
choice
	prompt "Layout"
	default KBD_AT8XC5122_ROW4_COL4

config KBD_AT8XC5122_ROW2_COL6
	bool "2 rows, 6 columns (NUMs+ENT+ESC)"

config KBD_AT8XC5122_ROW4_COL4
	bool "4 rows, 4 columns (NUMs+OP+ENT+ESC)"

config KBD_AT8XC5122_ROW6_COL2
	bool "6 rows, 2 columns (NUMs+ENT+ESC)"

endchoice

choice
	prompt "Row scanner"
	default KBD_ATAT8XC5122_ROW_LOW

config KBD_AT8XC5122_ROW_HIGH
	bool "higher PINs (x~7)"

config KBD_AT8XC5122_ROW_LOW
	bool "lower PINs (0~x)"

endchoice

config KBD_AT8XC5122_ROW_INV
	bool "Inversed row index"

config KBD_AT8XC5122_COL_INV
	bool "Inversed column index"

config KBD_AT8XC5122_MAX_ROWS
	int "Number of key rows"
	range 1 2 if KBD_AT8XC5122_ROW2_COL6
	range 1 4 if KBD_AT8XC5122_ROW4_COL4
	range 1 6 if KBD_AT8XC5122_ROW6_COL2
	depends KBD
	default 2 if KBD_AT8XC5122_ROW2_COL6
	default 4 if KBD_AT8XC5122_ROW4_COL4
	default 6 if KBD_AT8XC5122_ROW6_COL2

config KBD_AT8XC5122_MAX_COLS
	int "Number of key columns"
	range 1 6 if KBD_AT8XC5122_ROW2_COL6
	range 1 4 if KBD_AT8XC5122_ROW4_COL4
	range 1 2 if KBD_AT8XC5122_ROW6_COL2
	depends KBD
	default 6 if KBD_AT8XC5122_ROW2_COL6
	default 4 if KBD_AT8XC5122_ROW4_COL4
	default 2 if KBD_AT8XC5122_ROW6_COL2
endif

menuconfig USB_AT8XC5122
	bool "Atmel AT8XC5122 USB controller support"
	depends USB
	select ARCH_HAS_USB_DEV
	select ARCH_IS_USBD_ENDP_TXCMPL
	default y

if USB_AT8XC5122
config USB_AT8XC5122_MAX_ENDPS
	int "Number of endpoints (1~7)"
	range 1 7
	depends USB
	default 7

if USB_AT8XC5122
endif

endif

menuconfig IFD_AT8XC5122
	bool "Atmel AT8XC5122 smart card interface block (SCIB) support"
	depends SCS
	select ARCH_HAS_IFD
	select ARCH_HAS_IFD_PRES_IRQ
	default y

if IFD_AT8XC5122
config IFD_AT8XC5122_MAX_DATA
	int "Maximum data baud rates in bps"
	range 9600 921600
	default 115200
	help

config IFD_AT8XC5122_MAX_FREQ
	int "Maximum clock frequency in KHz"
	range 1000 8000
	default 4000
	help

choice
	prompt "CPRES detected on card presence"
	default IFD_AT8XC5122_PRES_LOW
	help
	  Card presence detection can be done through CPRES pin.  Card
	  slot mechanical may various board by board, CARDDET bit in
	  SCICR register can be used to detect card presence.  Please
	  choose correct detector sense for your board.
	  If PRESIT interrupt is enabled, choice here will also lead to
	  correct CPLEV configuration.

config IFD_AT8XC5122_PRES_LOW
	bool "Low"
	help
	  Card insertion will cause card presence switch in the slot to be
	  closed, and CPRES will be pulled down.

config IFD_AT8XC5122_PRES_HIGH
	bool "High"
	help
	  Card insertion will cause card presence switch in the slot to be
	  opened, and CPRES will be pulled up.

endchoice

config IFD_AT8XC5122_PRES_EXTERNAL
	bool "External pullup on card presence input"
	help
	  The internal pullup (weak pullup) on CPRES input can be
	  disconnected to reduce the consumption.  In this case, an
	  external resistor must be externally tied to VCC.
	  If unsure, say N.

endif

menuconfig DSU_AT8XC5122
	bool "Atmel AT8XC5122 DSU bootloader support"
	depends EXPERIMENTAL

endmenu
```
