## arch/arm64/mach-sunxi/Kconfig
```kconfig
#
# For a description of the syntax of this configuration file,
# see scripts/kbuild/config-language.txt.
#

if ARCH_SUNXI

config SUNXI_HIGH_SRAM
	bool
	default n
	help
	  Older Allwinner SoCs have their mask boot ROM mapped just below
	  4GB, with the first SRAM region being located at address 0.
	  Some newer SoCs map the boot ROM at address 0 instead and move
	  the SRAM to 64KB, just behind the mask ROM.
	  Chips using the latter setup are supposed to select this option
	  to adjust the addresses accordingly.

config SUNXI_DE2
	bool

config SUN6I
	bool

config SUN8I
	bool

config SUN50I
	bool
	select SUNXI_DE2
	select SUNXI_HIGH_SRAM

config SUNXI_H3_H5
	bool
	select SUN8I
	select SUNXI_DE2

config SUN50I_H5
	bool
	select SUNXI_H3_H5
	select SUNXI_HIGH_SRAM

menu "Allwinnder ARM SoC options"

config SUNXI_BOOT0_RMR
	bool
	select ARCH_HAS_BOOT0
	help
	  Insert some ARM32 code at the very beginning of the binary
	  entry. Which uses an RMR register write to bring the core
	  into AARCH64 mode.

choice
	prompt "SUNXI board"
	help
	  Selects CPUs that compiled sdfirm should run against.

config SUNXI_H5_NANOPI
	bool "NanoPi NEO2"
	select SUN50I_H5

endchoice

choice
	prompt "SUNXI program stage"
	help
	  Selects start point of the SUNXI firmware.

config SUNXI_SPL
	bool "Secondary program loader (SPL)"
	select SUNXI_BOOT0_RMR
	select ARCH_HAS_BOOT_LOAD
	select BFM
	help
	  Enable behavior support of u-boot SPL.

endchoice

config SUNXI_CCU
	bool "Clock control unit (CCU) support"

config GPIO_SUNXI
	bool "SUNXI gpio controller support"
	select STRING_STRTOUL

menuconfig UART_SUNXI
	bool "SUNXI uart controller support"
	depends UART || DEBUG_PRINT || CONSOLE
	depends !ARM_DCC
	select ARCH_HAS_NS16550
	select NS16550
	select ARCH_HAS_NS16550_MEM32
	select GPIO
	default y
	help

if UART_SUNXI

choice
	prompt "UART console port"

config UART_SUNXI_CON0
	bool "UART0"

config UART_SUNXI_CON1
	bool "UART1"

config UART_SUNXI_CON2
	bool "UART2"

config UART_SUNXI_CON3
	bool "UART3"

endchoice

choice
	prompt "UART compatibility"
	default UART_SUNXI_16550

config UART_SUNXI_16540
	bool "16540"
	select ARCH_HAS_NS16550_FIFO_0
	select ARCH_HAS_NS16540

config UART_SUNXI_16550
	bool "16550"
	select ARCH_HAS_NS16550_FIFO_64

endchoice

endif

menuconfig SMHC_SUNXI
	bool "SUNXI SD/MMC host controller (SMHC) support"
	select GPIO

if SMHC_SUNXI

config ARCH_HAS_SMHC_SUNXI_3
	bool

choice
	prompt "Boot SMHC slot"

config SMHC_SUNXI_BOOT_0
	bool "SMHC0"

config SMHC_SUNXI_BOOT_1
	bool "SMHC1"

config SMHC_SUNXI_BOOT_2
	bool "SMHC2"

config SMHC_SUNXI_BOOT_3
	bool "SMHC3"
	depends ARCH_HAS_SMHC_SUNXI_3

endchoice

config SMHC_1_PINS
	string "SMHC1 pins"
	depends SMHC_SUNXI_BOOT_1

config SMHC_2_PINS
	string "SMHC2 pins"
	depends SMHC_SUNXI_BOOT_2

config SMHC_3_PINS
	string "SMHC3 pins"
	depends SMHC_SUNXI_BOOT_3

endif

endmenu

endif
```

## arch/avr/Kconfig
```kconfig
#
# For a description of the syntax of this configuration file,
# see Documentation/kbuild/kconfig-language.txt.
#

mainmenu "Small Device Firmware Configuration"

config AVR
	bool
	default y
	help

source "init/Kconfig"

menu "AVR system options"

choice
	prompt "AVR system type"
	default ARCH_AT90USB1287

config ARCH_AT90USB1287
	bool "Ateml AT90USB1287"
	select CPU_ATMEGA128
	select ARCH_IS_TICKLESS
	select GPT_AT90USB1287 if TIMER
	select ARCH_HAS_TSC
	select ARCH_HAS_WDT
	help
	  This enables support for systems based on AT90USBKey.

config ARCH_AT90SCR100
	bool "Ateml AT90SCR100"
	select CPU_ATMEGA128
	select GPT_AT90SCR100 if TIMER
	select ARCH_IS_TICKLESS
	select ARCH_HAS_TSC
	select ARCH_HAS_WDT
	help
	  This enables support for systems based on AT90SCRdr.

endchoice

source arch/avr/common/Kconfig

menu "Compiler options"

config CC_ISR_VECTOR
	bool "Enable compiler vectors"

endmenu

endmenu

source "arch/avr/mach-at90usb1287/Kconfig"
source "arch/avr/mach-at90scr100/Kconfig"

source "appl/Kconfig"
source "kernel/Kconfig"
source "drivers/Kconfig"
source "lib/Kconfig"
source "init/Kconfig.debug"
```

## arch/avr/common/Kconfig
```kconfig
config CPU_8
	bool
	default y

config AVR_ENHANCED
	bool

config AVR_TINY
	bool

config AVR_MEGA
	bool

config AVR_2_BYTE_PC
	bool

config AVR_3_BYTE_PC
	bool

choice
	prompt "Processor type"

config CPU_ATTINY1
	bool "Support ATTINY1x processor"
	select CPU_8v1
	select AVR_2_BYTE_PC
	select AVR_TINY
	help

config CPU_ATTINY2
	bool "Support ATTINY2x processor"
	select CPU_8v2
	select AVR_2_BYTE_PC
	select AVR_TINY
	help

config CPU_ATTINY4
	bool "Support ATTINY4x processor"
	select CPU_8v25
	select AVR_2_BYTE_PC
	select AVR_TINY
	help

config CPU_ATTINY8
	bool "Support ATTINY8x processor"
	select CPU_8v25
	select AVR_2_BYTE_PC
	select AVR_TINY
	help

config CPU_ATTINY16
	bool "Support ATTINY16x processor"
	select CPU_8v35
	select AVR_2_BYTE_PC
	select AVR_MEGA
	help

config CPU_ATMEGA60
	bool "Support ATMEGA60 processor"
	select CPU_8v3
	select AVR_2_BYTE_PC
	select AVR_MEGA
	help

config CPU_ATMEGA10
	bool "Support ATMEGA10 processor"
	select CPU_8v31
	select AVR_2_BYTE_PC
	select AVR_MEGA
	help

config CPU_ATMEGA8
	bool "Support ATMEGA8x processor"
	select CPU_8v4
	select AVR_ENHANCED
	select AVR_2_BYTE_PC
	select AVR_MEGA
	help

config CPU_ATMEGA16
	bool "Support ATMEGA16x processor"
	select CPU_8v5
	select AVR_ENHANCED
	select AVR_2_BYTE_PC
	select AVR_MEGA
	help

config CPU_ATMEGA32
	bool "Support ATMEGA32x processor"
	select CPU_8v5
	select AVR_ENHANCED
	select AVR_2_BYTE_PC
	select AVR_MEGA
	help

config CPU_ATMEGA64
	bool "Support ATMEGA64x processor"
	select CPU_8v5
	select AVR_ENHANCED
	select AVR_2_BYTE_PC
	select AVR_MEGA
	help

config CPU_ATMEGA128
	bool "Support ATMEGA128x processor"
	select CPU_8v51
	select AVR_ENHANCED
	select AVR_2_BYTE_PC
	select AVR_MEGA
	help

config CPU_ATMEGA256
	bool "Support ATMEGA256x processor"
	select CPU_8v6
	select AVR_ENHANCED
	select AVR_3_BYTE_PC
	select AVR_MEGA
	help

endchoice

config CPU_8v6
	bool

config CPU_8v51
	bool

config CPU_8v5
	bool

config CPU_8v4
	bool

config CPU_8v35
	bool

config CPU_8v31
	bool

config CPU_8v3
	bool

config CPU_8v25
	bool

config CPU_8v2
	bool

config CPU_8v1
	bool
```

## arch/avr/mach-at90scr100/Kconfig
```kconfig
#
# For a description of the syntax of this configuration file,
# see scripts/kbuild/config-language.txt.
#

if ARCH_AT90SCR100

menu "Atmel AT90SCR100 board options"

choice
	prompt "CPU frequency"
	default CPU_AT90SCR100_FREQ_8M
	help
	  These choices are applied to low power crystal oscillator clock
	  source.

config CPU_AT90SCR100_FREQ_8M
	bool "8MHz"

config CPU_AT90SCR100_FREQ_16M
	bool "16MHz"

config CPU_AT90SCR100_FREQ_24M
	bool "24MHz"

endchoice

choice
	prompt "Cycle counter frequency"
	default TSC_AT90SCR100_FREQ_125K

config TSC_AT90SCR100_FREQ_125K
	bool "125KHz"

config TSC_AT90SCR100_FREQ_375K
	bool "375KHz"

config TSC_AT90SCR100_FREQ_1M
	bool "1MHz"

config TSC_AT90SCR100_FREQ_8M
	bool "8MHz"

endchoice

menuconfig GPT_AT90SCR100
	bool "Atmel AT90SCR100 general purpose support"
	depends TIMER
	select ARCH_HAS_GPT
	default y

if GPT_AT90SCR100

choice
	prompt "General purpose timer frequency"
	default GPT_AT90SCR100_FREQ_125K

config GPT_AT90SCR100_FREQ_24K
	depends on CPU_AT90SCR100_FREQ_24M
	bool "24KHz"

config GPT_AT90SCR100_FREQ_125K
	depends on !CPU_AT90SCR100_FREQ_24M
	bool "125KHz"

config GPT_AT90SCR100_FREQ_188K
	depends on CPU_AT90SCR100_FREQ_24M
	bool "188KHz"

config GPT_AT90SCR100_FREQ_250K
	bool "250KHz"

endchoice

endif

menuconfig UART_AT90SCR100
	bool "Atmel AT90SCR100 serial port support"
	depends UART || DEBUG_PRINT
	select ARCH_HAS_UART
	default y

if UART_AT90SCR100

endif

menuconfig KBD_AT90SCR100
	bool "Atmel AT90SCR100 keyboard controller support"
	depends KBD
	default y

if KBD_AT90SCR100

choice
	prompt "Keyboard layout"
	default KBD_AT90SCR100_ROW4_COL4

config KBD_AT90SCR100_ROW4_COL4
	bool "4 rows, 4 columns (NUMs+OP+ENT+ESC)"

endchoice

choice
	prompt "Keyboard Column Pinout"
	default KBD_AT90SCR100_COL_LOW

config KBD_AT90SCR100_COL_LOW
	bool "Pin is located low"

config KBD_AT90SCR100_COL_HIGH
	bool "Pin is located high"

endchoice

config KBD_AT90SCR100_COL_OFFSET
	int "Offset of column pin (0~7)"
	range 0 7
	depends KBD_AT90SCR100_COL_HIGH
	default 0

choice
	prompt "Keyboard Row Pinout"
	default KBD_AT90SCR100_ROW_LOW

config KBD_AT90SCR100_ROW_LOW
	bool "Pin is located low"

config KBD_AT90SCR100_ROW_HIGH
	bool "Pin is located high"

endchoice

config KBD_AT90SCR100_ROW_OFFSET
	int "Offset of column pin (0~7)"
	range 0 7
	depends KBD_AT90SCR100_ROW_HIGH
	default 0

config KBD_AT90SCR100_MAX_ROWS
	int "Number of key rows (1~4)"
	range 1 4
	depends KBD
	default 4

config KBD_AT90SCR100_MAX_COLS
	int "Number of key columns (1~5)"
	range 1 5
	depends KBD
	default 4

endif

menuconfig USB_AT90SCR100
	bool "Atmel AT90SCR100 USB controller support"
	depends USB
	select ARCH_HAS_USB_HCD
	select ARCH_HAS_USB_DEV
	default y

if USB_AT90SCR100

config USB_AT90SCR100_MAX_ENDPS
	int "Number of endpoints (1~7)"
	range 1 7
	depends USB
	default 7

endif

menuconfig IFD_AT90SCR100
	bool "Atmel AT90SCR100 smart card interface block (SCIB) support"
	select ARCH_HAS_IFD
	depends SCS
	default y

if IFD_AT90SCR100

config IFD_AT90SCR100_MAX_DATA
	int "Maximum data baud rates in bps"
	range 9600 921600
	default 115200
	help

choice
	prompt "Card presence detection"
	default IFD_AT90SCR100_PRES_LOW
	help
	  Card presence detection can be done through CPRES pin.  Card
	  slot mechanical may various board by board, CARDDET bit in
	  SCICR register can be used to detect card presence.  Please
	  choose correct detector sense for your board.
	  If PRESIT interrupt is enabled, choice here will also lead to
	  correct CPLEV configuration.

config IFD_AT90SCR100_PRES_LOW
	bool "Closed - CPRES low"
	help
	  Card insertion will cause card presence switch in the slot to be
	  closed, and CPRES will be pulled down.

config IFD_AT90SCR100_PRES_HIGH
	bool "Opened - CPRES high"
	help
	  Card insertion will cause card presence switch in the slot to be
	  opened, and CPRES will be pulled up.

endchoice

config IFD_AT90SCR100_PRES_EXTERNAL
	bool "External pullup on card presence input"
	help
	  The internal pullup (weak pullup) on CPRES input can be
	  disconnected to reduce the consumption.  In this case, an
	  external resistor must be externally tied to VCC.
	  If unsure, say N.

endif

menuconfig TWI_AT90SCR100
	bool "Atmel AT90SCR100 2-wire serial interface (TWI) support"
	depends I2C
	select BIT_FLS16
	default y

if TWI_AT90SCR100

choice
	prompt "TWI frequency"
	default TWI_AT90SCR100_FREQ_300K
	help

config TWI_AT90SCR100_FREQ_300K
	depends CPU_AT90SCR100_FREQ_24M
	bool "300KHz"

config TWI_AT90SCR100_FREQ_200K
	bool "200KHz"

config TWI_AT90SCR100_FREQ_100K
	bool "100KHz"

endchoice

endif

endmenu

endif
```

## arch/avr/mach-at90usb1287/Kconfig
```kconfig
#
# For a description of the syntax of this configuration file,
# see scripts/kbuild/config-language.txt.
#

if ARCH_AT90USB1287

menu "Atmel AT90USB1287 board options"

choice
	prompt "CPU frequency"
	default CPU_AT90USB1287_FREQ_8M
	help
	  These choices are applied to low power crystal oscillator clock
	  source.

config CPU_AT90USB1287_FREQ_8M
	bool "8MHz"

endchoice

choice
	prompt "Cycle counter frequency"
	default TSC_AT90USB1287_FREQ_125K

config TSC_AT90USB1287_FREQ_125K
	bool "125KHz"

config TSC_AT90USB1287_FREQ_1M
	bool "1MHz"

config TSC_AT90USB1287_FREQ_8M
	bool "8MHz"

endchoice

menuconfig GPT_AT90USB1287
	bool "Atmel AT90USB1287 general purpose timer support"
	depends TIMER
	select ARCH_HAS_GPT
	default y

if GPT_AT90USB1287
endif

menuconfig WDT_AT90USB1287
	bool "Atmel AT90USB1287 watchdog support"
	depends WDT
	default y

if WDT_AT90USB1287
endif

menuconfig LED_AT90USB1287
	bool "Atmel AT90USB1287 led support"
	depends LED
	default y

if LED_AT90USB1287

config LED_AT90USB1287_MAX_LIGHTS
	int "Number of led lights (1~4)"
	range 1 4
	default 4

config LED_AT90USB1287_CROSS_COLORS
	bool "Enable cross colors" if LED_AT90USB1287_MAX_LIGHTS=2
	default y

config LED_AT90USB1287_VAR_COLORS
	bool "Enable variable colors"
	help
	  LEDs can be configured one color per bit if this is disabled.

config LED_AT90USB1287_MAX_COLORS
	int "Number of led colors (1~4)"
	range 1 4
	range 1 16 if LED_AT90USB1287_VAR_COLORS
	default 1

endif

menuconfig UART_AT90USB1287
	bool "Atmel AT90USB1287 serial port support"
	depends UART
	select ARCH_HAS_UART
	default y
	help
	  The baud rate 38400 is recommended to achieve better performance
	  and accuracy on 8MHz frequency configured CPU.

if UART_AT90USB1287

endif

menuconfig SPI_AT90USB1287
	bool "Atmel AT90USB1287 SPI controller support"
	depends SPI
	select ARCH_HAS_SPI
	select BIT_FLS16
	default y

if SPI_AT90USB1287

endif

menuconfig USB_AT90USB1287
	bool "Atmel AT90USB1287 USB controller support"
	depends USB
	select ARCH_HAS_USB_OTG
	default y

if USB_AT90USB1287

config USB_AT90USB1287_DEV
	bool "Atmel AT90USB1287 USB device controller support"
	depends USB_DEV
	default y

if USB_AT90USB1287_DEV

config USB_AT90USB1287_MAX_ENDPS
	int "Number of endpoints (1~7)"
	range 1 7
	default 7

endif

config USB_AT90USB1287_VBUS_SWC
	bool "Disable VBUS hardware control"
	depends USB_HCD

endif

endmenu

endif
```

## arch/mcs51/Kconfig
```kconfig
#
# For a description of the syntax of this configuration file,
# see scripts/kbuild/config-language.txt.
#

mainmenu "Small Device Firmware Configuration"

config MCS51
	bool
	default y
	select CC_ISR_VECTOR

source "init/Kconfig"

menu "MCS51 system options"

choice
	prompt "System type"
	default ARCH_AT8XC5122

config ARCH_AT8XC5122
	bool "Atmel AT8xC5122 based"
#	select ARCH_IS_TICKLESS
	select ARCH_HAS_TSC
	select TICK_PERIODIC if TICK
	select GPT_AT8XC5122 if TIMER || TICK
	select GPIO_AT8XC5122 if GPIO
	select UART_AT8XC5122 if DEBUG_PRINT || UART
	select USB_AT8XC5122 if USB
	select IFD_AT8XC5122 if SCS
	select KBD_AT8XC5122 if KBD

endchoice

endmenu

menu "Compiler options"

config CC_ISR_VECTOR
	bool "Enable compiler vectors"

source "arch/mcs51/mach-at8xc5122/Kconfig"
#source "arch/mcs51/plat-at8051/Kconfig"

endmenu

source "appl/Kconfig"
source "kernel/Kconfig"
source "drivers/Kconfig"
source "lib/Kconfig"
source "init/Kconfig.debug"
```
