## arch/riscv/mach-duowen/Kconfig
```kconfig
#
# For a description of the syntax of this configuration file,
# see scripts/kbuild/config-language.txt.
#

if ARCH_DUOWEN

menu "Smart Core Duowen board options"

choice
	prompt "Programmed CPUs"
	help
	  Selects CPUs that compiled sdfirm should run against.

config DUOWEN_IMC
	bool "IMC - system fabric (SFAB)"
	select CPU_CVA6
	# Allow IMC to test IOMMU in testbench
	select ARCH_HAS_DMAC if DUOWEN_TB
	select ARCH_HAS_PCI if DUOWEN_TB

config DUOWEN_APC
	bool "APC - coherence fabric (CFAB)"
	select CPU_VAISRA
	select VAISRA_PMA
	select ARCH_HAS_DMAC
	select ARCH_HAS_PCI
	select DUOWEN_APC_BOOT_HOOK if (SMP_BOOT && !DUOWEN_SBL_LOAD)
	help
	  It is too late for vaisra to initialize its SMP cores in SBI due
	  to the restrictions of the vaisra atomicity implementation, so
	  they need to be done earlier via bootloader hooks.

endchoice

config DUOWEN_SOC_DUAL
	bool "Enable dual sockets"
	depends SMP_BOOT
	select PCI
	select DUOWEN_PCIE_CHIPLINK

config DUOWEN_BOOT
	bool

config DUOWEN_FIRM
	bool

config DUOWEN_LOAD_ASBL
	bool

config DUOWEN_LOAD_ZSBL
	bool

config DUOWEN_LOAD_FSBL
	bool

config DUOWEN_LOAD_BBL
	bool

choice
	prompt "Program type"

config DUOWEN_ASBL
	bool "APC self-bootloader (ASBL)"
	depends DUOWEN_APC
	select DUOWEN_BOOT
	select DUOWEN_LOAD_ASBL
	select DUOWEN_LOAD_ROM
	select DUOWEN_BOOT_APC
	select XIP
	select LOAD_DATA
	select SYS_ENTR_M
	select SYS_EXIT_M
	select DUOWEN_APC_INIT
	select DUOWEN_NOC
	select DUOWEN_PMA_CPU
	select DUOWEN_PMA_SOC

config DUOWEN_ZSBL
	bool "0-stage ROM bootloader (ZSBL)"
	select DUOWEN_BOOT
	select DUOWEN_LOAD_ZSBL
	select DUOWEN_BOOT_APC if DUOWEN_APC
	select XIP
	select LOAD_DATA
	select SYS_ENTR_M
	select SYS_EXIT_M
	select DUOWEN_SPI_FLASH if !DUOWEN_APC
	select DUOWEN_SSI_FLASH if !DUOWEN_APC
	select DUOWEN_LOAD_ROM if !DUOWEN_APC
	select DUOWEN_APC_INIT if DUOWEN_APC
	select DUOWEN_NOC if DUOWEN_APC
	select DUOWEN_PMA_CPU if DUOWEN_APC
	select DUOWEN_PMA_SOC if DUOWEN_APC
	select DUOWEN_BOOT_PROT if DUOWEN_IMC

config DUOWEN_FSBL
	bool "1-stage programmable bootloader (FSBL)"
	select DUOWEN_BOOT
	select DUOWEN_LOAD_FSBL
	select DUOWEN_BOOT_APC if DUOWEN_APC
	select ARCH_HAS_BOOT_LOAD if !DUOWEN_FSBL_SPI
	select XIP
	select BFM if !DUOWEN_FSBL_SPI
	select SYS_ENTR_M
	select SYS_EXIT_M
	select DUOWEN_DDR
	select DUOWEN_SPI_FLASH
	select DUOWEN_SSI_FLASH
	select DUOWEN_APC_INIT if (DUOWEN_APC && !DUOWEN_SBL_LOAD)
	select DUOWEN_NOC if (DUOWEN_IMC || !DUOWEN_SBL_LOAD)
	select DUOWEN_PMA_CPU if (DUOWEN_APC && !DUOWEN_SBL_LOAD)
	select DUOWEN_PMA_SOC if (DUOWEN_APC && !DUOWEN_SBL_LOAD)
	select DUOWEN_BOOT_PROT if DUOWEN_LOAD_IMC_FIRMWARE

config DUOWEN_BBL
	bool "Berkeley bootloader (BBL)"
	select DUOWEN_BOOT
	select DUOWEN_LOAD_BBL
	select GPIO
	select ARCH_HAS_BOOT_LOAD if !DUOWEN_BBL_SPI
	select XIP if !DUOWEN_BBL_SPI
	select BFM if !DUOWEN_BBL_SPI
	select SYS_ENTR_M
	select SYS_EXIT_M
	select SYS_EXIT_S if SIMULATION
	select SBI
	select SBI_PAYLOAD if !SIMULATION
	select DUOWEN_SPI_FLASH
	select DUOWEN_NOC if !DUOWEN_SBL_LOAD
	select DUOWEN_APC_INIT if !DUOWEN_SBL_LOAD
	select DUOWEN_NOC if !DUOWEN_SBL_LOAD
	select DUOWEN_PMA_CPU if !DUOWEN_SBL_LOAD
	select DUOWEN_PMA_SOC if !DUOWEN_SBL_LOAD
	select DUOWEN_PCIE_SMMU_BYPASS if (DUOWEN_PCIE && !DUOWEN_SMMU)
	select DUOWEN_SBI_DUAL if (DUOWEN_APC && DUOWEN_SOC_DUAL)

config DUOWEN_TB
	bool "Test bench"
	select SYS_ENTR_M
	select SYS_EXIT_M
	select SYS_EXIT_S
	select ARCH_HAS_BOOT_LOAD if (DUOWEN_SIM_LOAD || DUOWEN_SBL_LOAD)

endchoice

menu "Bootloader/firmware options"

config DUOWEN_BOOT_APC
	bool "Enable boot from APC"
	depends DUOWEN_APC
	depends DUOWEN_BOOT
	depends DUOWEN_LOAD_ASBL || DUOWEN_LOAD_ZSBL || DUOWEN_LOAD_FSBL
	help
	  Use internal SRAM as RAM for APC program instead of using DDR.
	  This is normally used for APC ZSBL/FSBL configuration.

config DUOWEN_APC_BOOT_HOOK
	bool "Enable APC boot ROM hooks"
	depends DUOWEN_APC

config DUOWEN_HAS_APC_PARTIAL_GOOD
	bool

config DUOWEN_APC_PARTIAL_GOOD
	bool "Enable pre-set APC partial good"
	depends DUOWEN_LOAD_FSBL
	depends DUOWEN_HAS_APC_PARTIAL_GOOD
	help
	  This is useful for the partial good calibration test program.

if DUOWEN_APC_PARTIAL_GOOD

config DUOWEN_APC_PARTIAL_GOOD_MASK
	hex "Partial good"

config DUOWEN_APC_BOOT_HART_ID
	int "Boot hart ID"
	range 0 15
	default 0

endif

config DUOWEN_FSBL_SPI
	bool "Build SPI flash resident FSBL"
	depends DUOWEN_FSBL

config DUOWEN_BBL_SPI
	bool "Build SPI flash resident BBL"
	depends DUOWEN_BBL

config DUOWEN_SBI_DUAL
	bool "Build dual socket version SBI"
	depends SBI && DUOWEN_APC

config DUOWEN_SBI_DUAL_SPARSE
	bool
	depends !DUOWEN_APC_16
	depends DUOWEN_SBI_DUAL

menuconfig DUOWEN_BOOT_PROT
	bool "Enable boot .data protection"
	depends (DUOWEN_ZSBL && DUOWEN_IMC) || DUOWEN_TB
	help
	  By default, each bootloader's .data section should be in
	  a different memory region. Enable this option only if the next
	  bootloader resides on SRAM low end, and the region is conflict
	  with the current bootloader. However, if the next bootloader
	  occupies the high end of the SRAM region, which is conflict with
	  the stack of the current bootloader, please do not enable this
	  option.
	  If unsure, say 'N'.

if DUOWEN_BOOT_PROT

config DUOWEN_BOOT_PROT_STRONG
	bool "Enable boot .text protection"
	help
	  By default, each bootloader's .text section should be in
	  a different memory region. Enable this option only if the next
	  bootloader resides on SRAM low end, and the region is conflict
	  with the current bootloader. However, if the next bootloader
	  occupies the high end of the SRAM region, which is conflict with
	  the stack of the current bootloader, please do not enable this
	  option.
	  If unsure, say 'N'.

config DUOWEN_BOOT_PROT_TEST
	bool "Enable boot protection test command"
	depends EXPERIMENTAL && COMMAND
	depends DUOWEN_TB
	select DUOWEN_BOOT_DEBUG

endif

config DUOWEN_BOOT_DEBUG
	bool "Enable boot safe debugging messages"

menuconfig DUOWEN_LOAD
	bool "Enable bootloader"
	depends DUOWEN_LOAD_ASBL || DUOWEN_LOAD_ZSBL || DUOWEN_LOAD_FSBL
	help
	  Enable ZSBL/FSBL loader function. The firmware will jump to SPI
	  flash or load next image from SSI flash/SDHC card.

if DUOWEN_LOAD

config DUOWEN_LOAD_FLASH
	bool

config DUOWEN_LOAD_SSI_FLASH
	bool "Enable load from SSI flash"
	depends DUOWEN_SSI_FLASH
	select DUOWEN_LOAD_FLASH

config DUOWEN_LOAD_SD
	bool "Enable load from SD card"
	depends DUOWEN_SD
	select DUOWEN_LOAD_FLASH

config DUOWEN_LOAD_ROM
	bool "Enable load secondary ROM"
	depends (DUOWEN_ZSBL && DUOWEN_IMC) || (DUOWEN_ASBL && !SMP)

config DUOWEN_LOAD_GPT
	bool
	default y if !DUOWEN_LOAD_RAM_BACKDOOR && !DUOWEN_LOAD_DDR_BACKDOOR

config DUOWEN_LOAD_RAM_BACKDOOR
	bool "Enable load to RAM backdoor"
	depends DUOWEN_ZSBL
	depends SIMULATION

config DUOWEN_LOAD_DDR_BACKDOOR
	bool "Enable load to DDR backdoor"
	depends DUOWEN_FSBL || DUOWEN_XSBL
	depends SIMULATION
	help
	  Enabling this to allow BBL to be loaded from the DDR backdoor.
	  This is useful in simulation environment as FSBL can then do
	  nothing for copying BBL.

config DUOWEN_TEST_BACKDOOR
	bool "Enable GPT partition test"
	depends DUOWEN_LOAD_RAM_BACKDOOR || DUOWEN_LOAD_DDR_BACKDOOR
	select DUOWEN_LOAD_GPT
	help
	  When SSI0/SD programs have already been loaded via backdoors,
	  you may still want to test SSI0/SD functionality. Enabling this
	  to do perform a read-only partition file searching as the test.

config DUOWEN_LOAD_IMC_FIRMWARE
	bool "Enable load of IMC firmware"
	depends DUOWEN_FSBL
	help
	  By default, FSBL only loads APC runtime firmware (named as
	  bbl.bin) and IMC will be powered off or left in a WFI loop.
	  Enabling this to allow FSBL to load an IMC runtime firmware
	  (named as imc.bin).

config DUOWEN_BOOT_OFFSET
	hex "SRAM offset for FSBL"
	depends !DUOWEN_BOOT_PROT
	depends DUOWEN_ZSBL
	default 0x0
	help
	  ZSBL loads FSBL to SRAM start addresses, while SRAM may still be
	  used as ZSBL .data/.bss sections during the image loading. This
	  option allows FSBL to be loaded without affecting ZSBL's
	  .data/.bss sections.

endif

endmenu

menu "Simulation options"

choice
	prompt "Frequency plan"

config DUOWEN_ASIC
	bool "Real ASIC"

config DUOWEN_ZEBU
	bool "ZEBU"

endchoice

choice
	prompt "xo_clk frequency"

config DUOWEN_XO_25M
	bool "25MHz"

endchoice

choice
	prompt "Theoretical frequency (zTime)"
	depends DUOWEN_ZEBU

config DUOWEN_ZEBU_FREQ_1991KHZ
	bool "1991Khz"
	depends DUOWEN_APC_4 || DUOWEN_APC_1

config DUOWEN_ZEBU_FREQ_1690KHZ
	bool "1690Khz"
	depends DUOWEN_APC_16

config DUOWEN_ZEBU_FREQ_CUSTOM
	bool "Custom"

endchoice

config DUOWEN_ZEBU_FREQ
	int "Custom theoretical frequency (Khz)"
	depends DUOWEN_ZEBU_FREQ_CUSTOM
	range 1000 4000

choice
	prompt "VAISRA CPUs"
	default DUOWEN_APC_16

config DUOWEN_APC_16
	bool "16"
	depends DUOWEN_IMC || SMP_BOOT
	select DUOWEN_HAS_APC_PARTIAL_GOOD

config DUOWEN_APC_4
	bool "4"
	depends DUOWEN_IMC || SMP_BOOT
	select DUOWEN_SBI_DUAL_SPARSE if DUOWEN_SBI_DUAL

config DUOWEN_APC_1
	bool "1"
	depends DUOWEN_IMC || !SMP_BOOT

endchoice

choice
	prompt "APC layout"
	default DUOWEN_APC_4_3100 if DUOWEN_APC_4

config DUOWEN_APC_4_3100
	bool "Cluster0 3cores, cluster1 1core"
	depends DUOWEN_APC_4

config DUOWEN_APC_4_1111
	bool "Cluster0/1/2/3 1core"
	depends DUOWEN_APC_4

config DUOWEN_APC_4_4000
	bool "Cluster0 4cores"
	depends DUOWEN_APC_4
	select DUOWEN_HAS_APC_PARTIAL_GOOD

config DUOWEN_APC_1_1000
	bool "Cluster0 1core"
	depends DUOWEN_APC_1
	select DUOWEN_HAS_APC_PARTIAL_GOOD

endchoice

choice
	prompt "Testbench residence"
	depends DUOWEN_TB
	default DUOWEN_TB_RAM if DUOWEN_IMC
	default DUOWEN_TB_DDR if DUOWEN_APC

config DUOWEN_TB_RAM
	bool "RAM"

config DUOWEN_TB_DDR
	bool "DDR"

endchoice

config DUOWEN_SIM_LOAD
	bool "Enable loading by simulator"

config DUOWEN_SBL_LOAD
	bool "Enable loading by bootloader (ZSBL/FSBL)"
	depends !DUOWEN_ASBL
	depends !DUOWEN_ZSBL
	depends !DUOWEN_FSBL_SPI
	depends !DUOWEN_BBL_SPI
	default y if DUOWEN_FSBL || DUOWEN_BBL
	help
	  This option is always invisible to ZSBL and visible to non SPI
	  resident FSBL and BBL, TBs.

config DUOWEN_MSG
	bool "Duowen shared message support"
	depends SIMULATION
	help
	  This hardware can only be found in testbench, mostly be used to
	  drive tests and UVM sequences.

config DUOWEN_SIM_ROM_FINISH
	bool "Enable simultion finish for ROMs"
	depends DUOWEN_MSG
	depends DUOWEN_ZSBL || DUOWEN_ASBL
	help
	  Enabling this to finish ZSBL right after testing SSI0/SD
	  flashes. Enabling this to finish ASBL right before booting APCs.

config DUOWEN_SIM_BOOT_CLOCKS
	bool "Enable faster clock/reset booting support"
	help
	  This feature is used in simulation environment to bypass clock
	  framework to make simulation faster.

endmenu

if FDT

menu "Linux device tree options"

config DUOWEN_UART_DTS
	bool "Enable dw-apb-uart driver in DTS"

if DUOWEN_UART_DTS

config DUOWEN_UART_DTS_CON
	bool "Enable dw-apb-uart console in DTS"
	help
	  By default, sbi/hvc0 will be used as console. Enabling this
	  option to allow DTS to report dw-apb-uart as console.

config DUOWEN_UART_DTS_DMA
	bool "Enable dw-apb-uart DMA in DTS"
	select DUOWEN_DMAC_DTS

config DUOWEN_UART_DTS_CLK_FREQ
	bool "Enable static clock frequency in DTS"
	help
	  By default, CRCNTL clocks are defined to enable dynamic clock
	  frequency for Linux kernel driver. Enabling this option to
	  define "clock-frequency" DTS attrbutes to enable static clock
	  frequency for Linux kernel driver.
	  Note that, firmware must enable UART clocks prior than entering
	  Linux if this option is enabled.
	  If unsure, say 'N'.

endif

config DUOWEN_DMAC_DTS
	bool "Enable dw-axi-dmac driver in DTS"

config DUOWEN_I2C_MASTER_DTS
	bool "Enable dw-apb-i2c master driver in DTS"

config DUOWEN_I2C_SLAVE_DTS
	bool "Enable dw-apb-i2c slave driver in DTS"

config DUOWEN_SSI_MASTER_DTS
	bool "Enable dw-apb-ssi driver in DTS"

config DUOWEN_PCIE_DTS
	bool "Enable pcie-designware driver in DTS"

config DUOWEN_SMMU_DTS
	bool "Enable smarco-riscv-smmu driver in DTS"

endmenu

endif

config DUOWEN_APC_INIT
	bool "Duowen vaisra initialization support"
	depends DUOWEN_APC

menu "Duowen physical memory attributes (PMA) support"

config DUOWEN_PMA_CPU
	bool "Enable CPU specific PMA support"
	depends DUOWEN_APC
	select VAISRA_PMA

config DUOWEN_PMA_SOC
	bool "Enable SoC global PMA support"
	select DUOWEN_SMMU if DUOWEN_APC

config DUOWEN_PMA_DEBUG
	bool "Enable debugging messages"
	depends CONSOLE_DEBUG
	depends DUOWEN_PMA_CPU || DUOWEN_PMA_SOC
	depends !SBI

endmenu

menu "Duowen platform level interrupt controller (PLIC) support"

config DUOWEN_PLIC_DUAL
	bool "Enable remote socket IRQs"
	help
	  By default, each PLIC controller manages only local socket IRQs,
	  allowing seperated IRQ domain. Enabling this to allow PLIC to
	  send local IRQs to the remote socket so that remote CPUs could
	  see IRQs shared between the sockets and finally can result in a
	  single shared IRQ domain in the NUMA system configuration.
	  If unsure, say 'N'.

endmenu

menuconfig DUOWEN_NOC
	bool "Duowen network on chip (NoC) support"
	depends DUOWEN_APC || DUOWEN_FSBL
	select ARCH_HAS_NCORE_RECONF
	select NCORE
	select DUOWEN_NOC_INIT_CLOCKS
	select DUOWEN_PCIE_RAMP
	help
	  NoC driver is required by FSBL or BBL before booting into Linux.

if DUOWEN_NOC

config DUOWEN_NOC_INIT_CLOCKS
	bool "Enable initialization of dependent clocks"
	help
	  On some SoC versions, it is required to initialize dependent
	  clocks prior than initializing NoC as these clocks are gated by
	  default on that SoC versions.

config DUOWEN_NOC_DEBUG
	bool "Enable debugging messages"
	depends CONSOLE_DEBUG
	depends !SBI

endif

menuconfig DUOWEN_UART
	bool "Duowen UART controller support"
	select DW_UART
	select GPIO
	select ARCH_HAS_NS16550_FIFO_64
	select ARCH_HAS_DW_UART_FIFO_MEM_USER
	select ARCH_HAS_DW_UART_AFCE_MODE
	select ARCH_HAS_DW_UART_FIFO_ACCESS
	select ARCH_HAS_DW_UART_FIFO_STAT
	select ARCH_HAS_DW_UART_SHADOW
	select ARCH_HAS_DW_UART_ADD_ENCODED_PARAMS

if DUOWEN_UART

choice
	prompt "Console port"
	default DUOWEN_UART_CON0

config DUOWEN_UART_CON0
	bool "UART0"

config DUOWEN_UART_CON1
	bool "UART1"

config DUOWEN_UART_CON2
	bool "UART2"

config DUOWEN_UART_CON3
	bool "UART3"

config DUOWEN_UART_CON4
	bool "UART4"
	depends DUOWEN_SBI_DUAL

config DUOWEN_UART_CON5
	bool "UART5"
	depends DUOWEN_SBI_DUAL

config DUOWEN_UART_CON6
	bool "UART6"
	depends DUOWEN_SBI_DUAL

config DUOWEN_UART_CON7
	bool "UART7"
	depends DUOWEN_SBI_DUAL

endchoice

config DUOWEN_UART_ACCEL
	bool "Enable DUOWEN UART acceleration support"
	depends SIMULATION
	help
	  When this is selected, the UART baudrate generator frequency will
	  be SYSFAB_HALF_CLK/16, making things happening quicker.
	  In case your are using a UART master DPI VIP, selecting this is
	  safe as the VIP cares no about the baudrate.
	  This option is also useful for simulation acceleration.
	  If unsure, say 'N'.

endif

menuconfig DUOWEN_TMR
	bool "Duowen global timer controller (TMR) support"
	help
	  TMR hardware is in the AO clock/power domain, it should be used
	  as boot TSC.

if DUOWEN_TMR

endif

menuconfig CRCNTL
	bool "Duowen clock/reset controller (CRCNTL) support"
	select ARCH_HAS_SBI_CLOCK
	select DW_PLL5GHZ_TSMC12FFC if DUOWEN_PLL_REAL
	select ARCH_HAS_DW_PLL5GHZ_TIMING if DW_PLL5GHZ_TSMC12FFC
	select ARCH_HAS_DW_PLL5GHZ_DYNAMIC if DUOWEN_ASIC
	select DW_PLL5GHZ_TSMC12FFC_REG_ACCESS if DW_PLL5GHZ_TSMC12FFC
	select DW_PLL5GHZ_TSMC12FFC_BYPASS_SYNC if DW_PLL5GHZ_TSMC12FFC
	select CRCNTL_MUX if !DUOWEN_PLL_NONE

if CRCNTL

choice
	prompt "PLL type"

config DUOWEN_PLL_REAL
	bool "Real"
	depends DUOWEN_ASIC
	depends !DUOWEN_LOAD_ROM

config DUOWEN_PLL_FAKE
	bool "Fake"
	help
	  This happens in VCS testbench and ZeBu where PLL frequency is
	  forced by RTL. Note this feature can also be used for real asic
	  where PLL is already configured by previous bootloaders.

config DUOWEN_PLL_NONE
	bool "None"
	depends DUOWEN_LOAD_ROM
	select SD_LEGACY_ONLY if DUOWEN_LOAD_ROM
	help
	  This is used by IMC ROM to omit PLL driver from IMC ROM code.

endchoice

config CRCNTL_MUX
	bool "Enable clock multiplexing support"
	depends !DUOWEN_PLL_NONE
	help
	  In FPGA environment, PLLs are designed to output from the nodes
	  of the clock select gates. In such case, CRCNTL needn't provide
	  clock select gates APIs.
	  If unsure, say 'N'.

config CRCNTL_RESET
	bool "Enable auto reset on gated clock support"
	depends !(DUOWEN_ZEBU && DUOWEN_NOC)

config CRCNTL_TRACE
	bool "Enable clock tree enabling/disabling trace logs"
	depends CONSOLE_DEBUG
	depends !SBI

config DUOWEN_PCIE_RAMP
	bool "Enable PCIe ramp control support"

endif

menuconfig DUOWEN_SCSR
	bool "Duowen system control/status registers support"
	select BIT_FFS16

if DUOWEN_SCSR

endif

config DUOWEN_TLMM
	bool

menuconfig DUOWEN_GPIO
	bool "Duowen GPIO/TLMM controller support"
	select DW_GPIO
	select DUOWEN_TLMM
	select ARCH_HAS_SBI_PINCTRL

if DUOWEN_GPIO

config DUOWEN_GPIO_PORT
	bool "Enable multiple port GPIO support"

endif

menuconfig DUOWEN_I2C
	bool "Duowen I2C master controller support"
	depends I2C_MASTER
	select DW_I2C

if DUOWEN_I2C

endif

menuconfig DUOWEN_SPI_FLASH
	bool "Duowen SPI flash support"
	select MATH_DIV32
	help
	  The DUOWEN SoC contains a random accessible SPI controller that
	  is able to convert generic SPI NOR flashes into random accessible
	  ROM.

if DUOWEN_SPI_FLASH

choice
	prompt "Divider length"
	default DUOWEN_FLASH_DIVIDER_16

config DUOWEN_FLASH_DIVIDER_8
        bool "8-bit"

config DUOWEN_FLASH_DIVIDER_16
        bool "16-bit"

config DUOWEN_FLASH_DIVIDER_24
        bool "24-bit"

config DUOWEN_FLASH_DIVIDER_32
        bool "32-bit"

endchoice

choice
	prompt "SPI select length"
	default DUOWEN_FLASH_SS_8

config DUOWEN_FLASH_SS_8
	bool "8-bit"

config DUOWEN_FLASH_SS_16
        bool "16-bit"

config DUOWEN_FLASH_SS_24
        bool "24-bit"

config DUOWEN_FLASH_SS_32
        bool "32-bit"

endchoice

endif

menuconfig DUOWEN_SSI_FLASH
	bool "Duowen SSI flash support"
	depends SPI_MASTER
	select DW_SSI
	select UEFI
	select UEFI_GPT
	select SPIFLASH_W25Q
	select ARCH_HAS_SSI_FIFO
	select ARCH_HAS_SSI_XFER_32
	select ARCH_HAS_SSI_FRF
	select ARCH_HAS_SSI_SPI
	select ARCH_HAS_SSI_SPI_1WIRE
	select ARCH_HAS_SPIFLASH
	select STRING_UUID
	select GPIO
	select DUOWEN_SSI_FLASH_IRQ if DUOWEN_TB && SYS_IRQ
	help
	  The DUOWN SoC also contains a DW_SSI controller that can be used
	  to interface with the external SSI flashes. However, the
	  controller doesn't support random accessibility.

if DUOWEN_SSI_FLASH

choice
	prompt "Duowen SSI flash"
	default DUOWEN_SSI_FLASH_SPI0

config DUOWEN_SSI_FLASH_SPI0
	bool "SPI0"

config DUOWEN_SSI_FLASH_SPI1
	bool "SPI1"

config DUOWEN_SSI_FLASH_SPI2
	bool "SPI2"

config DUOWEN_SSI_FLASH_SPI3
	bool "SPI3"

endchoice

config DUOWEN_SSI_FLASH_FREQ
	int "Duowen SSI flash frequency"
	range 100000 80000000
	default 50000000
	help
	  The SPINOR flash uses the "EEPROM read" protocol that the CS
	  should be kept active during the entire transaction. However,
	  the DW_ssi controller automatically inactivates the CS pin when
	  the FIFO is run out. That requires the program to run fast
	  enough to fill data into the SPI FIFO. The CS inactivation can
	  be seen if the SPI transaction period is filled up with less APB
	  transactions (rom/ram/ssi accesses).
	  It's tested that 8MHz is working for the case of "ROM booting
	  SSI" in the simulation environment, for the non-simulation
	  environment, it's preferred to use 1MHz by design.

config DUOWEN_SSI_FLASH_IRQ
	bool "Enable special IRQ tests"
	depends SYS_IRQ

endif

menuconfig DUOWEN_SD
	bool "Duowen MSHC controller support"
	select DW_MSHC
	select UEFI
	select UEFI_GPT
	select MTD_MMCARD
	select STRING_UUID
	select GPIO

if DUOWEN_SD

endif

menuconfig DUOWEN_PCIE
	bool "Duowen PCI-Express (PCIe) support"
	select DW_PCIE
	select ARCH_HAS_DW_PCIE_RC
	select ARCH_HAS_DW_PCIE_EP

if DUOWEN_PCIE

choice
	prompt "Default subsystem link mode"
	default DUOWEN_PCIE_LINK_MODE_0 if !DUOWEN_ZEBU
	default DUOWEN_PCIE_LINK_MODE_1 if DUOWEN_ZEBU
	help
	  Give default link mode. However, when chiplink is detected, the
	  PCIe subsystem will automatically use a default link mode
	  suitable for chiplink that contains an x4 channel on the last
	  controller.

config DUOWEN_PCIE_LINK_MODE_0
	bool "x4 x4 x4 x4"

config DUOWEN_PCIE_LINK_MODE_1
	bool "x8 x4 x4"

config DUOWEN_PCIE_LINK_MODE_2
	bool "x8 x8"

config DUOWEN_PCIE_LINK_MODE_3
	bool "x16"

endchoice

config DUOWEN_PCIE_CHIPLINK
	bool "Enable 2 socket chiplink connection"
	select DW_PCIE_SPEED_GEN1 if DUOWEN_ZEBU
	default n

config DUOWEN_PCIE_SMMU_BYPASS
	bool "Bypass PCIe SMMU"
	help
	  By default SMMU driver enables SMMU RISCV mode to feed PMA to
	  the SMMU engine, and this option need not to be enabled.
	  If unsure, say 'N'.

config DUOWEN_PCIE_TEST
	bool "Enable PCIE EP/RC(Root Complex) basic test"
	default n
	help
	  When this option is enabled, basic test on either EP
	  or RC will be implemented, depends on whether DW_PCIE_RC
	  is checked

config DUOWEN_PCIE_DEBUG
	bool "Enable debugging messages"
	depends CONSOLE_DEBUG
	depends !SBI
	default n
	help
          Controls whether to print register configueration information
endif

menuconfig DUOWEN_SMMU
	bool "Duowen SMMU controller support"
	depends DUOWEN_APC
	help
	  Duowen SMMU is an ARM SMMUv2 like IOMMU hardware, with
	  necessary modifications in order to be used in the RISC-V
	  SoC environment.

if DUOWEN_SMMU

config DUOWEN_SMMU_SV
	bool "Enable SMMU translation support"
	depends DUOWEN_TB
	depends RISCV_EXIT_S
	select SMARCO_RVSMMU

endif

menuconfig DUOWEN_DMAC
	bool "Duowen DMA controller support"
	select DW_DMA
	select ARCH_IS_DW_DMA_CHANNEL8
	select ARCH_IS_DW_DMA_HSIF4
	select ARCH_HAS_DW_DMA_IRQ_COMBINED if !DUOWEN_DMAC_IRQ_CHANNEL
	select ARCH_HAS_DW_DMA_IRQ_CHANNEL_COMMONREG if DUOWEN_DMAC_IRQ_CHANNEL
	select ARCH_HAS_DW_DMA_UNALIGNED_XFER
	select ARCH_HAS_DW_DMA_DEBUG_PORTS
	select ARCH_IS_DW_DMA_MSTIF1
	select ARCH_IS_DW_DMA_M_OSR16
	select ARCH_HAS_DW_DMA_M_ENDIAN
	select ARCH_IS_DW_DMA_M_LE
	select ARCH_IS_DW_DMA_M_ADDR49
	select ARCH_IS_DW_DMA_M_DATA256
	select ARCH_IS_DW_DMA_M_BURSTLEN8
	select ARCH_IS_DW_DMA_S_DATA32
	select ARCH_IS_DW_DMA_C_MSIZE32
	select ARCH_IS_DW_DMA_C_BLOCKTS7
	select ARCH_IS_DW_DMA_C_BURSTLEN16

if DUOWEN_DMAC

config DUOWEN_DMAC_IRQ_CHANNEL
	bool "Enable channel based IRQ"
	depends !DUOWEN_BBL

endif

menu "Duowen DDR controller/phy support"

choice
	prompt "DDR model"
	default DUOWEN_DDR_32M if DUOWEN_ASIC && !DUOWEN_DDR
	default DUOWEN_DDR_512G if DUOWEN_ASIC && DUOWEN_DDR
	default DUOWEN_DDR_256M if DUOWEN_ZEBU && !DUOWEN_DDR
	default DUOWEN_DDR_2G if DUOWEN_ZEBU && DUOWEN_DDR

config DUOWEN_DDR_32M
	bool "Fake 32M DDR memory"

config DUOWEN_DDR_64M
	bool "Fake 64M DDR memory"

config DUOWEN_DDR_128M
	bool "Fake 128M DDR memory"

config DUOWEN_DDR_256M
	bool "Fake 256M DDR memory"

config DUOWEN_DDR_512M
	bool "Fake 512M DDR memory"

config DUOWEN_DDR_1G
	bool "Real/fake 1G DDR memory"

config DUOWEN_DDR_2G
	bool "Real/fake 2G DDR memory"

config DUOWEN_DDR_4G
	bool "Real/fake 4G DDR memory"

config DUOWEN_DDR_8G
	bool "Real/fake 8G DDR memory"

config DUOWEN_DDR_16G
	bool "Real/fake 16G DDR memory"

config DUOWEN_DDR_32G
	bool "Real/fake 32G DDR memory"

config DUOWEN_DDR_64G
	bool "Real/fake 64G DDR memory"

config DUOWEN_DDR_128G
	bool "Real/fake 64G DDR memory"

config DUOWEN_DDR_256G
	bool "Real/fake 256G DDR memory"

config DUOWEN_DDR_512G
	bool "Real/fake 512G DDR memory"

endchoice

choice
	prompt "Dual socket memory region in DTS"
	depends DUOWEN_SBI_DUAL && DUOWEN_BBL
	default DUOWEN_DDR_DUAL_SOC0
	help
	  For Linux kernel that only support SV39, only single socket DDR
	  can be used by the kernel early PAGE_OFFSET mapping mechanism so
	  that VA won't be invalid, otherwise VA upper bits cannot be
	  ensured to be all 0s or all 1s.

config DUOWEN_DDR_DUAL_SOC0
	bool "Socket 0 DDR"

config DUOWEN_DDR_DUAL_SOC1
	bool "Socket 1 DDR"

endchoice

menuconfig DUOWEN_DDR
	bool "Duowen DDR memory support"
	depends DDR
	select DW_UMCTL2
	select ARCH_HAS_DW_UMCTL2_DDR2
	select ARCH_HAS_DW_UMCTL2_DDR3
	select ARCH_HAS_DW_UMCTL2_DDR4
	select ARCH_IS_DW_UMCTL2_FREQ_RATIO_HW_2
	select ARCH_IS_DW_UMCTL2_DUAL_HIF
	select ARCH_IS_DW_UMCTL2_BURST_LENGTH_8
	select ARCH_IS_DW_UMCTL2_DATA_WIDTH_64
	select ARCH_IS_DW_UMCTL2_RANK_4
	select ARCH_IS_DW_UMCTL2_FREQ_4
	select ARCH_IS_DW_UMCTL2_CID_WIDTH_0
	select ARCH_IS_DW_UMCTL2_SECDED_ECC
	select ARCH_HAS_DW_UMCTL2_SIDEBAND_ECC
	select ARCH_IS_DW_UMCTL2_FREQ_4
	select DDR3
	select DDR4

if DUOWEN_DDR

config DUOWEN_DDR_SPD_BUS_NUM
	int "I2C Bus (Master) Number for DDR SPDs"
	default 0
	depends I2C && I2C_MASTER

config DUOWEN_DDR_SPD_COUNT
	int "Count of DDR SPDs (DIMMs)"
	default 2
	range 1 8
	depends I2C && I2C_MASTER

config DUOWEN_DDR_RAS
	bool "Duowen DDR RAS enable"

endif

endmenu

menuconfig DUOWEN_ETH
	bool "Duowen ethernet XGMAC/XPCS support"
	select DW_XGMAC
	select ARCH_IS_DW_XPCS_BACKPLANE
	select ARCH_IS_DW_XPCS_SGMII
	select ARCH_HAS_DW_XPCS_EEE
	select ARCH_IS_DW_XPCS_MDIO
	select ARCH_IS_DW_XPCS_PHY_GEN5_16G if DUOWEN_ASIC
	select GPIO

if DUOWEN_ETH

choice
	prompt "PHY mode"
	default DUOWEN_ETH_10000BASE_KR

config DUOWEN_ETH_1000BASE_KX
	bool "clause 70 1000base-kx"
	select ARCH_HAS_DW_XPCS_1000BASE_KX
	select ARCH_HAS_DW_XPCS_AN
	select ARCH_HAS_DW_XPCS_GMII
	select DW_XPCS_AN

config DUOWEN_ETH_10000BASE_KX4
	bool "clause 71 10gbase-kx4"
	select ARCH_HAS_DW_XPCS_10000BASE_KX4
	select ARCH_HAS_DW_XPCS_AN
	select DW_XPCS_AN
	select ARCH_IS_DW_XPCS_XGMII_SDR
	select ARCH_HAS_DW_XPCS_RXAUI

config DUOWEN_ETH_10000BASE_KR
	bool "clause 72 10gbase-kr"
	select ARCH_HAS_DW_XPCS_10000BASE_KR
	select ARCH_HAS_DW_XPCS_AN
	select ARCH_HAS_DW_XPCS_KRTR
	select DW_XPCS_AN
	select ARCH_IS_DW_XPCS_XGMII_SDR
	select ARCH_HAS_DW_XPCS_RXAUI
	select ARCH_HAS_DW_XPCS_FEC
	select ARCH_HAS_DW_XPCS_FEC_FORWARD

config DUOWEN_ETH_5000BASE_KR
	bool "5gbase-kr"
	select ARCH_HAS_DW_XPCS_5000BASE_KR

config DUOWEN_ETH_2500BASE_KX
	bool "2.5gbase-kx"
	select ARCH_HAS_DW_XPCS_2500BASE_KX

config DUOWEN_ETH_10000BASE_RXAUI
	bool "10gbase-rxaui"

config DUOWEN_ETH_SGMII_1000M
	bool "1000M-sgmii"

config DUOWEN_ETH_USXGMII_AN37
	bool "an37-usxgmii"

endchoice

choice
	prompt "Alter reference clock frequency"
	default DUOWEN_ETH_156250KHZ

config DUOWEN_ETH_312500KHZ
	bool "312.5MHz"

config DUOWEN_ETH_156250KHZ
	bool "156.25MHz"

config DUOWEN_ETH_78125KHZ
	bool "78.125KHz"

endchoice

config DUOWEN_ETH_INIT
	bool "Enable board late initialization of ethernet"
	depends !DUOWEN_BBL

config DUOWEN_ETH_GENERIC
	bool "Enable Linux dwmac-generic driver support"
	help
	  By default, dwmac-duowen driver will be used to locate XPCS and
	  probe phy devices.
	  If unsure, say 'N'.

config DUOWEN_ETH_LOOPBACK
	bool "Enable loopback connection"
	depends SIMULATION && !DUOWEN_ETH_MAC2MAC
	help
	  In case there is no real ethernet connected by the XPCS, this
	  option enables testability of sending/receiving packets.

config DUOWEN_ETH_MAC2MAC
	bool "Enable mac-to-mac connection"
	depends DUOWEN_ZEBU
	help
	  Reporting to Linux kernel with fixed-link to enable MAC-to-MAC
	  test environment.

config DUOWEN_ETH_DTS
	bool "Enable stmmac/dwmac driver in DTS"

endif

endmenu

endif
```
