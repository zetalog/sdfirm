## arch/riscv/mach-dpu/Kconfig
```kconfig
#
# For a description of the syntax of this configuration file,
# see scripts/kbuild/config-language.txt.
#

if ARCH_DPU

menu "Smart Core DPU board options"

config DPU_GEN2
	bool "DPU GEN2 chipset"
	help
	  DPU GEN2 tunes GEN1 design with tsensor added and address space
	  layout changed. It also include S-context PLIC IRQ so that it
	  can boot a Linux kernel as its runtime firmware.

config DPU_RES
	bool "DPU GEN2 RISC-V edge server (RES) support"
	select DPU_GEN2
	help
	  A special customized SoC designed to run as RISC-V edge server.

choice
	prompt "Programmed CPUs"

config DPU_IMC
	bool "IMC"

config DPU_APC
	bool "APC"
	select CPU_VAISRA
	select ARCH_HAS_SMP
	depends DPU_RES

endchoice

if DPU_IMC

choice
	prompt "IMC CPU type"
	default DPU_CV32E40P

config DPU_CV32E40P
	bool "RI5CY"
	depends !DPU_GEN2
	select CPU_CV32E40P

config DPU_CVA6
	bool "Ariane"
	select CPU_ARIANE

endchoice

endif

config DPU_BOOT
	bool

config DPU_FIRM
	bool

config DPU_LOAD_ZSBL
	bool
	select DPU_APC_INIT_CPU if DPU_APC
	select DPU_APC_INIT_PMA if DPU_APC

config DPU_LOAD_FSBL
	bool
	select DPU_DDR
	select SPIFLASH_ADDR_4BYTE

config DPU_LOAD_BBL
	bool

choice
	prompt "Program type"

config DPU_BOOT_ROM
	bool "0-stage boot ROM bootloader (ZSBL)"
	select DPU_BOOT
	select DPU_LOAD_ZSBL
	select XIP
	select LOAD_DATA
	select SYS_ENTR_M
	select SYS_EXIT_M
	select DPU_SPI_FLASH
	select DPU_SSI_FLASH
	select DPU_APC_INIT_MSG if DPU_APC && !CONSOLE

config DPU_BOOT_SPI_FLASH
	bool "0-stage/1-stage SPINOR bootloader (ZSBL/FSBL)"
	select ARCH_HAS_BOOT_LOAD if !DPU_BOOT_ROM_EXT
	select DPU_BOOT
	select DPU_LOAD_ZSBL if DPU_BOOT_ROM_EXT
	select DPU_LOAD_FSBL
	select XIP
	select LOAD_DATA
	select SYS_ENTR_M
	select SYS_EXIT_M
	select DPU_DDR
	select DPU_SPI_FLASH
	select DPU_SSI_FLASH

config DPU_BOOT_SSI_FLASH
	bool "1-stage SSI flash bootloader (FSBL)"
	select ARCH_HAS_BOOT_LOAD
	select DPU_BOOT
	select DPU_LOAD_FSBL
	select XIP
	select SYS_ENTR_M
	select SYS_EXIT_M
	select DPU_DDR
	select DPU_SPI_FLASH
	select DPU_SSI_FLASH

config DPU_BOOT_DDR
	bool "Berkeley bootloader (BBL)"
	select ARCH_HAS_BOOT_LOAD
	select DPU_BOOT
	select DPU_LOAD_BBL
	select SYS_ENTR_M
	select SYS_EXIT_M
	select SBI
	select SBI_PAYLOAD

config DPU_FIRM_DDR
	bool "Runtime target firmware (DPU-FW)"
	select ARCH_HAS_BOOT_LOAD
	select DPU_FIRM
	select DPU_LOAD_BBL
	select XIP
	select BFM
	select SYS_ENTR_M
	select SYS_EXIT_M
	select SYS_EXIT_S if (DPU_CVA6 || DPU_APC)
	select SYS_EXIT_U

config DPU_BOOT_RAM
	bool "RAM testbench"
	select ARCH_HAS_BOOT_LOAD
	select DPU_BOOT
	select XIP
	select BFM
	select SYS_ENTR_M
	select SYS_EXIT_M
	select SYS_EXIT_S if (DPU_CVA6 || DPU_APC)
	select SYS_EXIT_U

endchoice

menu "Bootloader/Firmware options"

config DPU_BOOT_ROM_EXT
	bool "Enable external ROM using SPI flash"
	depends DPU_BOOT_SPI_FLASH
	help
	  By default, SPI flash image is loaded by internal ROM, however,
	  it can be used as external ROM using jumpers. This affects APC
	  initialization steps.

config DPU_LOAD
	bool "Enable bootloader"
	depends DPU_LOAD_ZSBL || DPU_LOAD_FSBL

if DPU_LOAD

config DPU_LOAD_SPI_FLASH
	bool "Enable load from SPI flash"
	depends DPU_SPI_FLASH
	depends !DPU_BOOT_SPI_FLASH

config DPU_BOOT_DDR0
	bool "Bootloader jump DDR bank0"
	depends DPU_DDR_BANK0 && !DPU_DDR_INTLV
	depends DPU_LOAD_SSI_FLASH || DPU_LOAD_PCIE_EP
	help
	  When DDR is configured in non-interleave mode, DDR bank0 is
	  located at 0x400000000. This option allows you to load BBL
	  or PCIe programs to the DDR bank0. Note you must also manually
	  change the base address of the loaded program accordingly. e.x.,
	  you need to modify dpuxxx_bbl_defconfig's
	  CONFIG_BOOT_BASE/CONFIG_LOAD_BASE to 0x400000000.

config DPU_BOOT_ADDR
	hex "Bootloader SPI flash jump address"
	range 0x00000000 0x01E00000
	depends DPU_LOAD_SPI_FLASH
	default 0x00000080

choice
	prompt "Storage to load from"
	default DPU_LOAD_SSI_FLASH

config DPU_LOAD_SSI_FLASH
	bool "SSI flash"
	depends DPU_SSI_FLASH

config DPU_LOAD_PCIE_EP
	bool "PCIe EP"
	depends DW_PCIE && !DW_PCIE_RC
	help
	  When the DPU/RES board is used as a PCIe peripheral, programs can be
	  downloaded via PCIe when the booloader is running in PCIe EP mode.

endchoice	

config DPU_BOOT_STACK
	bool "Enable boot from stack"
	depends !SMP
	help
	  By default, each bootloader's .text section should be in
	  a different memory region. Enable this option only if the next
	  bootloader resides on SRAM low end, and the region is conflict
	  with the current bootloader. However, if the next bootloader
	  occupies the high end of the SRAM region, which is conflict with
	  the stack of the current bootloader, please do not enable this
	  option.
	  We could not support this feature when SMP boot is enabled on
	  DPU as we haven't coverted smp_boot_secondary_cpus() to an
	  inlined function.
	  If unsure, say 'N'.

config DPU_BOOT_DEBUG
	bool "Enable boot safe debugging messages"
	depends DPU_UART

config DPU_BOOT_BACKDOOR
	bool "Enable backdoor loading"
	depends DPU_LOAD_SSI_FLASH
	help
	  Enable this feature to skip loading from SSI flash. The image is
	  supposed to have been loaded via simulation backdoor.

endif

config DPU_RES_SLOW
	bool "Enable slower CPU frequency"
	depends DPU_RES
	help
	  1.0GHz for cluster and 500MHz for IMC.

config DPU_DDR_SIZE_CUST
	bool "Enable customized DDR size for DDR firmware"
	depends DPU_BOOT_DDR

config DPU_FIRM_SIZE
	hex "Firmware size"
	depends DPU_FIRM || DPU_DDR_SIZE_CUST

config DPU_BOOT_PE
	bool "DPU process elements (PE)"
	depends DPU_BOOT

config DPU_BOOT_VPU
	bool "DPU vision processor unit (VPU)"
	depends DPU_BOOT

menu "Cluster boot hooks"

if (DPU_APC && DPU_LOAD_ZSBL) || DPU_SIM_APC

config DPU_APC_INIT_CPU
	bool "Enable cluster self-initialization"

config DPU_APC_INIT_PMA
	bool "Enable PMA initialization"
	select DPU_PMA if ARCH_HAS_DPU_PMA_DYNAMIC

endif

if (DPU_APC && DPU_BOOT_ROM) || DPU_SIM_APC

config DPU_APC_INIT_MSG
	bool "Enable boot hint messages"
	depends !CONSOLE
	select DPU_UART

endif

endmenu

endmenu

menu "Simulation options"

if SIMULATION

config DPU_SIM_CLK
	bool "Allow disabling clock framework"
	help
	  On simulation environments, CLK can be opt-off if no need to
	  configure any clocks (forced in test benches).

config DPU_SIM_APC
	bool "Enable cluster self-boot initializations"
	depends DPU_APC
	select DPU_APC_INIT_CPU
	select DPU_APC_INIT_PMA

config DPU_SIM_DDR_BOOT
	bool "Use DDR model for DDR1 to boot"
	depends !DDR
	help
	  The special boot mode is used to perform OS verification in the
	  simulation environment. When it is configured, DDR1 becomes a
	  RAM model, and sizes 512MB. The CPU will boot from the start
	  address of DDR1 (0x08_0000_0000).

config DPU_SIM_DDR_BASE16
	bool "Enable 16G DDR address base"
	depends !DPU_DDR_BANK0
	help
	  Use DDR base is DDR0. This is used when real DDR0 bank is not
	  configured, but fake DDR0 bank exists in the SoC.

config DPU_SIM_DDR_SIZE32
	bool "Enable 32G DDR address size"
	depends !DPU_DDR_BANK1
	help
	  Use both DDR0 and DDR1 address regions. This is used when real
	  DDR1 bank is not configured, but fake DDR1 bank exists in the
	  SoC.

config DPU_SIM_RAM_BOOT_DDR
	bool "Enable tiny RAM bootloader to boot to DDR1"
	depends DPU_BOOT_RAM
	select DPU_SIM_APC if DPU_APC
	help
	  DPU is lack of DDR booting simulation mode support for APC due
	  to the wrong default hardware PMA in some versions; and the
	  hardware doesn't release DDR resets, doesn't accelerate DDR
	  clocks in some testbenches. To work all of the above issues
	  around, RAM boot mode is always used in the testbench DDR booting
	  scenarios, and this RAM bootloader is a very tiny startup program
	  to boot to DDR with all of the required hardware status prepared
	  by the software.

config DPU_SIM_PMA
	bool "Use customized PMA settings"
	depends DPU_SIM_RAM_BOOT_DDR
	depends DPU_APC
	select ARCH_HAS_DPU_PMA_DYNAMIC if DPU_APC
	select DPU_PMA if DPU_APC
	help
	  The default hardware PMA is actually working after performing
	  ECO. Thus in production mode, PMA shouldn't be programmed by the
	  software. However there are versions the PMA is wrong; and there
	  are tests need to be performed to test various PMA settings.
	  To have PMA programmed by the software, PMA should be reset in
	  early boot state (vaisra.S) and re-configured correctly late
	  after preparing necessary software execution environments.
	  After all, this feature is limited to be use with APC RAM boot
	  to DDR bootloader.
	  If unsure, say 'N'.

config DPU_SIM_GPIO_IRQ
	bool "Enable GPIO IRQ testing framework"
	depends DPU_GPIO && SYS_IRQ

config DPU_SIM_SSI_IRQ
	bool "Enable SSI IRQ testing support"
	depends DPU_SSI_FLASH && SYS_IRQ

endif

config DPU_SIM_TSENSOR_IRQ
	bool "Enable thermal sensor IRQ testing support"
	depends DPU_GEN2
	depends SYS_IRQ

endmenu

menuconfig DPU_TCSR
	bool "Top control and status registers (TCSR) support"
	select STRING_STRTOULL if COMMAND

if DPU_TCSR

config DPU_TCSR_LOW_POWER
	bool "Enable bus low power support"

config DPU_TCSR_SIM_FINISH
	bool "Enable simulation finish support"
	depends SIMULATION
	help
	  In simulation environment, enabling this allows to shutdown
	  VCS simulation.

#config DPU_TCSR_SIM_TRACE
#	bool "Enable cluster trace log support"
#	depends DPU_APC
#	help
#	  Currently this zebu trace log feature is only used in the Linux
#	  userspace programs.

endif

config DPU_PLL_INT
	bool

config DPU_PLL_EXT
	bool
	select DW_PLL5GHZ_TSMC12FFC if !DPU_PLL_BYPASS_PLL
	select DW_PLL5GHZ_TSMC12FFC_REG_ACCESS if DW_PLL5GHZ_TSMC12FFC
	select DW_PLL5GHZ_TSMC12FFC_BYPASS_SYNC if DW_PLL5GHZ_TSMC12FFC
#	select ARCH_HAS_DW_PLL5GHZ_DYNAMIC if DPU_RES

menuconfig DPU_PLL
	bool "DPU PLL and clock/reset support"
	select DPU_PLL_INT if (DPU_BOOT_ROM && DPU_RES)
	select DPU_PLL_EXT if !(DPU_BOOT_ROM && DPU_RES)
	select DPU_TCSR_LOW_POWER if DPU_TCSR
	select MATH_DIV32

if DPU_PLL

config DPU_PLL_FREQPLAN_PE
	bool "Enable 7-gear PE frequency plan support"
	help
	  Frequency plan is only prepared for DDR 7-gear. Enable this
	  option to enable PE frequency plan support to match DDR gears.
	  If unsure, say 'N'.

config DPU_PLL_FREQPLAN_PE_HISPEED
	bool "Enable high speed test (2GHz)"
	depends SIMULATION && DPU_PLL_FREQPLAN_PE

config DPU_PLL_FREQPLAN_BUS
	bool "Enable 7-gear bus frequency plan support"
	help
	  Frequency plan is only prepared for DDR 7-gear. Enable this
	  option to enable bus frequency plan support to match DDR gears.
	  If unsure, say 'N'.

config DPU_PLL_BYPASS_PLL
	bool "Allow disabling PLL driver"
	depends SIMULATION
	help
	  On simulation environnments, PLL can be opt-off if no need to
	  configure any PLLs (forced in test benches). Due to enabling of
	  clock framework, some APIs that obtain clock frequencies can
	  still work in this configuration.

endif

config ARCH_HAS_DPU_PMA_DYNAMIC
	bool

menuconfig DPU_PMA
	bool "DPU cluster PMA support"
	depends DPU_APC
	depends ARCH_HAS_DPU_PMA_DYNAMIC
	select VAISRA_PMA

if DPU_PMA

config DPU_PMA_DEBUG
	bool "Enable debugging messages"
	depends CONSOLE_DEBUG
	depends DPU_PMA
	depends !SBI

endif

menuconfig DPU_GPIO
	bool "DPU GPIO controller support"
	select DW_GPIO

if DPU_GPIO

endif

menuconfig DPU_TMR
	bool "DPU RISC-V timer support"
	depends !DPU_RES
	select DPU_TMR_FIRQ if RISCV_VIRQ
	select ARCH_HAS_SBI_TIMER

if DPU_TMR

config DPU_CLINT
	bool "DPU CLINT compatible timer/soft IRQ support"
	depends DPU_RES
	select CLINT

if DPU_CLINT

endif

config DPU_TMR_FIRQ
	bool "Enable extended fast interrupt support"
	depends RISCV_VIRQ
	select RI5CY_FIRQ

config DPU_TMR_CMP_CONST
	bool "Enable constant compare counter support"
	depends SIMULATION
	help
	  Can fixup a shortened timeout value to make RTL simulation
	  faster.

config DPU_TMR_CMP_CONST_TOUT
	hex "Constant compare counter value"
	depends DPU_TMR_CMP_CONST
	range 0x1000 0x10000
	default 0x4000
	help
	  Use the fixed value to be added to the CNT, and set to the
	  CMP register.

endif

menuconfig DPU_PLIC
	bool "DPU RISC-V PLIC support"
	select PLIC
	select DPU_PLIC_FIRQ if RISCV_VIRQ

if DPU_PLIC

config DPU_PLIC_FIRQ
	bool "Enable extended fast interrupt support"
	depends RISCV_VIRQ
	select RI5CY_FIRQ

endif

menuconfig DPU_UART
	bool "DPU UART controller support"
	select DW_UART
	select ARCH_HAS_NS16550_FIFO_16
	select ARCH_HAS_DW_UART_FIFO_MEM_INTERNAL

if DPU_UART

config DPU_UART_VIP
	bool "Enable DPU UART simulation model support"
	depends SIMULATION
	default y
	help
	  When this is selected, the UART baudrate generator frequency will
	  be APB_CLK/16, making things happening quicker when an UART slave
	  VIP is connected. In case your are using a UART master DPI VIP,
	  selecting this is safe as the VIP cares no about the baudrate.
	  If unsure, say 'Y'.

config DPU_UART_DTS
	bool "Enable dw-apb-uart driver in DTS"
	depends FDT

config DPU_UART_DTS_CON
	bool "Enable dw-apb-uart console in DTS"
	depends DPU_UART_DTS
	help
	  By default, sbi/hvc0 will be used as console. Enabling this
	  option to allow DTS to report dw-apb-uart as console.

endif

menuconfig DPU_I2C
	bool "DPU I2C master support"
	select DW_I2C
	depends I2C_MASTER

menuconfig DPU_SPI_FLASH
	bool "DPU SPI flash support"
	select MATH_DIV32
	help
	  The DPU SoC contains a random accessible SPI controller that is
	  able to convert generic SPI NOR flashes into random accessible
	  ROM.

if DPU_SPI_FLASH

choice
	prompt "Divider length"
	default DPU_FLASH_DIVIDER_16

config DPU_FLASH_DIVIDER_8
	bool "8-bit"

config DPU_FLASH_DIVIDER_16
	bool "16-bit"

config DPU_FLASH_DIVIDER_24
	bool "24-bit"

config DPU_FLASH_DIVIDER_32
	bool "32-bit"

endchoice

choice
	prompt "SPI select length"
	default DPU_FLASH_SS_8

config DPU_FLASH_SS_8
	bool "8-bit"

config DPU_FLASH_SS_16
	bool "16-bit"

config DPU_FLASH_SS_24
	bool "24-bit"

config DPU_FLASH_SS_32
	bool "32-bit"

endchoice

endif

menuconfig DPU_SSI_FLASH
	bool "DPU SSI flash support"
	depends SPI_MASTER
	select DW_SSI
	select UEFI
	select UEFI_GPT
	select ARCH_HAS_SSI_FIFO
	select ARCH_HAS_SSI_XFER_32
	select ARCH_HAS_SSI_FRF
	select ARCH_HAS_SSI_SPI
	select ARCH_HAS_SSI_SPI_1WIRE
	select ARCH_HAS_SPIFLASH
	select SPIFLASH_W25Q
	select STRING_UUID
	select ARCH_HAS_SPIFLASH_ADDR_4BYTE if !DPU_BOOT_ROM
	help
	  The DPU SoC also contains a DW_SSI controller that can be used
	  to interface with the external SSI flashes. However, the
	  controller doesn't support random accessibility.

if DPU_SSI_FLASH

config DPU_SSI_FLASH_FREQ
	int "DPU SSI flash frequency"
	range 100000 133000000
	default 50000000
	help
	  The SPINOR flash uses the "EEPROM read" protocol that the CS
	  should be kept active during the entire transaction. However,
	  the DW_ssi controller automatically inactivates the CS pin when
	  the FIFO is run out. That requires the program to run fast
	  enough to fill data into the SPI FIFO. The CS inactivation can
	  be seen if the SPI transaction period is filled up with less APB
	  transactions (rom/ram/ssi accesses).
	  It's tested that 8MHz is working for the case of "ROM booting
	  SSI" in the simulation environment, for the non-simulation
	  environment, it's preferred to use 1MHz by design.
	  Most of the product line use 80/104/133MHz clocks.

endif

menu "DPU DDR controller/phy support"

config DPU_DDR_BANK0
	bool "Enable DDR bank 0"
	default y

config DPU_DDR_BANK1
	bool "Enable DDR bank 1"
	default y

config DPU_DDR_INTLV
	bool "Enable interleaved DDR0/DDR1"
	depends DPU_GEN2
	depends SIMULATION || (DPU_DDR_BANK0 && DPU_DDR_BANK1)
	default y

config DPU_DDR
	bool "Enable real DDR support"
	select DW_UMCTL2
	select ARCH_HAS_DW_UMCTL2_DDR2
	select ARCH_HAS_DW_UMCTL2_DDR3
	select ARCH_HAS_DW_UMCTL2_DDR4
	select ARCH_IS_DW_UMCTL2_FREQ_RATIO_HW_2
	select ARCH_IS_DW_UMCTL2_DUAL_HIF
	select ARCH_IS_DW_UMCTL2_BURST_LENGTH_8
	select ARCH_IS_DW_UMCTL2_DATA_WIDTH_64
	select ARCH_IS_DW_UMCTL2_RANK_4
	select ARCH_IS_DW_UMCTL2_FREQ_4
	select ARCH_IS_DW_UMCTL2_CID_WIDTH_0
	select ARCH_IS_DW_UMCTL2_SECDED_ECC
	select ARCH_HAS_DW_UMCTL2_SIDEBAND_ECC
	select MATH_DIV32
	select DDR3
	select DDR4

if DPU_DDR

config DPU_DDR_SPD_BUS_NUM
	int "I2C Bus (Master) Number for DDR SPDs"
	depends I2C && I2C_MASTER
	default 0

config DPU_DDR_SPD_COUNT
	int "Count of DDR SPDs (DIMMs)"
	default 2
	range 1 8
	depends I2C && I2C_MASTER

endif

endmenu

menuconfig DPU_PCI_SUBSYS
	bool "DPU PCIe subsystem support"
	select DW_PCIE
	select ARCH_HAS_DW_PCIE_RC

if DPU_PCI_SUBSYS

config DPU_PCIE_TEST
	bool "Enable PCIE EP/RC(Root Complex) basic test"
	default n
	help
	  When this option is enabled, basic test on either EP
	  or RC will be implemented, depends on whether PCIE_ROLE_RC
	  is checked

if DPU_PCIE_TEST

config DPU_INITIATE_DMA_BY_LOCAL
	bool "Initiate DMA by local when in zebu test"
	default n
	help
	  When this option is enabled, RC alloc and tell EP the allocced addr
	  for DMA through ATU configuration, so that EP can get the RC allocced
	  addr by reading local DDR memroy.

config DPU_TEST_DDR_BY_DMA
	bool "Test DDR through DMA huge data when in zebu test"
	default n
	help
	  When this option is enabled, can verify DDR through DMA huge data.

config DPU_TEST_LINK_SPEED_CHANGE
	bool "Test link speed change"
	default n
	help
	  When this option is enabled, will test link speed change.

endif

endif

endmenu

endif
```
