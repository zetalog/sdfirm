## arch/riscv/mach-dpulp/Kconfig
```kconfig
#
# For a description of the syntax of this configuration file,
# see scripts/kbuild/config-language.txt.
#

if ARCH_DPULP

menu "Smart Core DPULP-LP board options"

config DPULP_BOOT
	bool
	select SPI
	select SPI_MASTER
	select MMCSD
	select CLK if !DPULP_SIM_CLK

config DPULP_LOAD_ZSBL
	bool
	select DPULP_BOOT
	select DPULP_BOOT_CPU
	select DPULP_BOOT_PMA if !ARCH_HAS_VAISRA_PMA_FORCE

config DPULP_LOAD_FSBL
	bool
	select DPULP_BOOT
	select DPULP_DDR

config DPULP_LOAD_BBL
	bool
	select SBI
	select SBI_PAYLOAD

choice
	prompt "Program type"

config DPULP_ZSBL
	bool "0-stage boot ROM bootloader (ZSBL)"
	select DPULP_LOAD_ZSBL
	select XIP
	select LOAD_DATA
	select SYS_ENTR_M
	select SYS_EXIT_M
	select DPULP_HAS_FIRM_RAM

config DPULP_FSBL
	bool "1-stage SSI flash bootloader (FSBL)"
	select ARCH_HAS_BOOT_LOAD
	select DPULP_LOAD_FSBL
	select XIP
	select BFM
	select SYS_ENTR_M
	select SYS_EXIT_M
	select DPULP_HAS_FIRM_RAM

config DPULP_XSBL
	bool "0-stage/1-stage SPINOR bootloader (ZSBL/FSBL)"
	select ARCH_HAS_BOOT_LOAD
	select DPULP_LOAD_ZSBL
	select DPULP_LOAD_FSBL
	select XIP
	select LOAD_DATA
	select SYS_ENTR_M
	select SYS_EXIT_M
	select DPULP_SPI_FLASH
	select DPULP_HAS_FIRM_RAM
	select DPULP_HAS_FIRM_DDR

config DPULP_BBL
	bool "Berkeley bootloader (BBL)"
	select ARCH_HAS_BOOT_LOAD
	select DPULP_LOAD_BBL
	select XIP
	select BFM
	select SYS_ENTR_M
	select SYS_EXIT_M
	select DPULP_HAS_FIRM_DDR

config DPULP_DFW
	bool "DPU runtime firmware (DFW)"
	select ARCH_HAS_BOOT_LOAD
	select XIP
	select BFM
	select SYS_ENTR_M
	select SYS_EXIT_M
	select SYS_EXIT_S
	select SYS_EXIT_U
	select DPULP_HAS_FIRM_RAM
	select DPULP_HAS_FIRM_DDR
	select PCI
	select RIO

config DPULP_TB
	bool "RAM/DDR based Testbench"
	select ARCH_HAS_BOOT_LOAD
	select XIP
	select BFM
	select SYS_ENTR_M
	select SYS_EXIT_M
	select SYS_EXIT_S
	select SYS_EXIT_U
	select DPULP_HAS_FIRM_RAM
	select DPULP_HAS_FIRM_DDR

endchoice

config DPULP_HAS_FIRM_RAM
	bool

config DPULP_HAS_FIRM_DDR
	bool

choice
	prompt "Firmware residency"
	default DPULP_FIRM_DDR

config DPULP_FIRM_DDR
	bool "DDR"
	depends DPULP_HAS_FIRM_DDR

config DPULP_FIRM_RAM
	bool "RAM"
	depends DPULP_HAS_FIRM_RAM

endchoice

menu "Bootloader/Firmware options"

config ARCH_HAS_VAISRA_PMA_FORCE
	bool

if DPULP_LOAD_ZSBL

menu "DPULP Cluster boot hooks"

config DPULP_BOOT_CPU
	bool "Enable CPU self-initialization"

config DPULP_BOOT_PMA
	bool "Enable PMA initialization"
	depends !ARCH_HAS_VAISRA_PMA_FORCE
	select DPULP_PMA

endmenu

endif

menuconfig DPULP_BOOT_PROT
	bool "Enable boot .data protection"
	depends DPULP_ZSBL || DPULP_TB
	help
	  By default, each bootloader's .data section should be in
	  a different memory region. Enable this option only if the next
	  bootloader resides on SRAM low end, and the region is conflict
	  with the current bootloader. However, if the next bootloader
	  occupies the high end of the SRAM region, which is conflict with
	  the stack of the current bootloader, please do not enable this
	  option.
	  If unsure, say 'N'.

if DPULP_BOOT_PROT

config DPULP_BOOT_PROT_STRONG
	bool "Enable boot .text protection"
	help
	  By default, each bootloader's .text section should be in
	  a different memory region. Enable this option only if the next
	  bootloader resides on SRAM low end, and the region is conflict
	  with the current bootloader. However, if the next bootloader
	  occupies the high end of the SRAM region, which is conflict with
	  the stack of the current bootloader, please do not enable this
	  option.
	  If unsure, say 'N'.

config DPULP_BOOT_PROT_TEST
	bool "Enable boot protection test command"
	depends EXPERIMENTAL && COMMAND
	depends DPULP_TB
	select DPULP_BOOT_DEBUG

endif

config DPULP_BOOT_DEBUG
	bool "Enable boot safe debugging messages"

endmenu

menu "Simulation options"

if SIMULATION

config DPULP_SIM_CLK
	bool "Allow disabling clock framework"
	help
	  On simulation environments, CLK can be opt-off if no need to
	  configure any clocks (forced in test benches).

endif

endmenu

menuconfig DPULP_PMA
	bool "DPULP cluster PMA support"
	depends !ARCH_HAS_VAISRA_PMA_FORCE
	select VAISRA_PMA

if DPULP_PMA

config DPULP_PMA_DEBUG
	bool "Enable debugging messages"
	depends CONSOLE_DEBUG
	depends DPULP_PMA
	depends !SBI

endif

menuconfig DPULP_TMR
	bool "DPULP RISC-V timer support"
	select ARCH_HAS_SBI_TIMER

if DPULP_TMR

config DPULP_TMR_CMP_CONST
	bool "Enable constant compare counter support"
	depends SIMULATION
	help
	  Can fixup a shortened timeout value to make RTL simulation
	  faster.

config DPULP_TMR_CMP_CONST_TOUT
	hex "Constant compare counter value"
	depends DPULP_TMR_CMP_CONST
	range 0x1000 0x10000
	default 0x4000
	help
	  Use the fixed value to be added to the CNT, and set to the
	  CMP register.

endif

menuconfig DPULP_TCSR
	bool "Top control and status registers (TCSR) support"
	select STRING_STRTOULL if COMMAND

if DPULP_TCSR

endif

menuconfig DPULP_CRU
	bool "DPULP clock reset unit support"
	select ARCH_HAS_SBI_CLOCK
	select DW_PLL5GHZ_TSMC12FFC
	select ARCH_HAS_DW_PLL5GHZ_TIMING if DW_PLL5GHZ_TSMC12FFC
	select ARCH_HAS_DW_PLL5GHZ_DYNAMIC
	select DW_PLL5GHZ_TSMC12FFC_REG_ACCESS if DW_PLL5GHZ_TSMC12FFC
	select DW_PLL5GHZ_TSMC12FFC_BYPASS_SYNC if DW_PLL5GHZ_TSMC12FFC

if DPULP_CRU

config DPULP_CRU_TRACE
	bool "Enable clock tree enabling/disabling trace logs"
	depends CONSOLE_DEBUG
	depends !SBI

endif

menuconfig DPULP_GPIO
	bool "DPULP GPIO controller support"
	select DW_GPIO

if DPULP_GPIO

endif

menuconfig DPULP_UART
	bool "DPULP UART controller support"
	select DW_UART
	select ARCH_HAS_NS16550_FIFO_16
	select ARCH_HAS_DW_UART_FIFO_MEM_INTERNAL

if DPULP_UART

choice
	prompt "Console port"
	default DPULP_UART_CON0

config DPULP_UART_CON0
	bool "UART0"

config DPULP_UART_CON1
	bool "UART1"

config DPULP_UART_CON2
	bool "UART2"

config DPULP_UART_CON3
	bool "UART3"

endchoice

config DPULP_UART_VIP
	bool "Enable DPULP UART simulation model support"
	depends SIMULATION
	default y
	help
	  When this is selected, the UART baudrate generator frequency will
	  be APB_CLK/16, making things happening quicker when an UART slave
	  VIP is connected. In case your are using a UART master DPI VIP,
	  selecting this is safe as the VIP cares no about the baudrate.
	  If unsure, say 'Y'.

endif

menuconfig DPULP_SPI_FLASH
	bool "DPULP SPI flash support"
	select MATH_DIV32
	help
	  The DPULP SoC contains a random accessible SPI controller that is
	  able to convert generic SPI NOR flashes into random accessible
	  ROM.

if DPULP_SPI_FLASH

choice
	prompt "Divider length"
	default DPULP_FLASH_DIVIDER_16

config DPULP_FLASH_DIVIDER_8
	bool "8-bit"

config DPULP_FLASH_DIVIDER_16
	bool "16-bit"

config DPULP_FLASH_DIVIDER_24
	bool "24-bit"

config DPULP_FLASH_DIVIDER_32
	bool "32-bit"

endchoice

choice
	prompt "SPI select length"
	default DPULP_FLASH_SS_8

config DPULP_FLASH_SS_8
	bool "8-bit"

config DPULP_FLASH_SS_16
	bool "16-bit"

config DPULP_FLASH_SS_24
	bool "24-bit"

config DPULP_FLASH_SS_32
	bool "32-bit"

endchoice

endif

menuconfig DPULP_SSI_FLASH
	bool "DPULP SSI flash support"
	depends SPI_MASTER
	select DW_SSI
	select UEFI
	select UEFI_GPT
	select ARCH_HAS_SSI_FIFO
	select ARCH_HAS_SSI_XFER_32
	select ARCH_HAS_SSI_FRF
	select ARCH_HAS_SSI_SPI
	select ARCH_HAS_SSI_SPI_1WIRE
	select ARCH_HAS_SPIFLASH
	select SPIFLASH_W25Q32
	select STRING_UUID
	help
	  The DPULP SoC also contains a DW_SSI controller that can be used
	  to interface with the external SSI flashes. However, the
	  controller doesn't support random accessibility.

if DPULP_SSI_FLASH

config DPULP_SSI_FLASH_FREQ
	int "DPULP SSI flash frequency"
	range 100000 80000000
	default 50000000
	help
	  The SPINOR flash uses the "EEPROM read" protocol that the CS
	  should be kept active during the entire transaction. However,
	  the DW_ssi controller automatically inactivates the CS pin when
	  the FIFO is run out. That requires the program to run fast
	  enough to fill data into the SPI FIFO. The CS inactivation can
	  be seen if the SPI transaction period is filled up with less APB
	  transactions (rom/ram/ssi accesses).
	  It's tested that 8MHz is working for the case of "ROM booting
	  SSI" in the simulation environment, for the non-simulation
	  environment, it's preferred to use 1MHz by design.

endif

menuconfig DPULP_SD
	bool "DPULP MSHC controller support"
	select DW_MSHC
	select UEFI
	select UEFI_GPT
	select MTD_MMCARD
	select STRING_UUID
	select GPIO

if DPULP_SD

endif

menuconfig DPULP_DDR
	bool "DPU DDR controller/phy support"
	select DW_UMCTL2
	select ARCH_IS_DW_UMCTL2_DATA_WIDTH_64
	select ARCH_IS_DW_UMCTL2_DUAL_HIF
	select MATH_DIV32

if DPULP_DDR

endif

menuconfig DPULP_PCIE
	bool "DPULP PCIe subsystem support"
	select DW_PCIE
	select ARCH_HAS_DW_PCIE_RC

if DPULP_PCIE

endif

menuconfig DPULP_ETH
	bool "DPULP ethernet XGMAC/XPCS support"
	select DW_XGMAC
	select ARCH_IS_DW_XPCS_BACKPLANE
	select ARCH_HAS_DW_XPCS_10000BASE_KX4
	select ARCH_HAS_DW_XPCS_10000BASE_KR
	select ARCH_HAS_DW_XPCS_5000BASE_KR
	select ARCH_HAS_DW_XPCS_2500BASE_KX
	select ARCH_HAS_DW_XPCS_1000BASE_KX
	select ARCH_IS_DW_XPCS_SGMII
	select ARCH_HAS_DW_XPCS_KRTR
	select ARCH_HAS_DW_XPCS_AN
	select ARCH_HAS_DW_XPCS_EEE
	select ARCH_HAS_DW_XPCS_FEC
	select ARCH_HAS_DW_XPCS_FEC_FORWARD
	select ARCH_IS_DW_XPCS_XGMII_SDR
	select ARCH_HAS_DW_XPCS_RXAUI
	select ARCH_IS_DW_XPCS_MDIO
	select ARCH_IS_DW_XPCS_PHY_GEN5_16G
	select GPIO

if DPULP_ETH

choice
	prompt "PHY mode"
	default DPULP_ETH_10000BASE_KR

config DPULP_ETH_10000BASE_KX4
	bool "usxgmii"

config DPULP_ETH_10000BASE_KR
	bool "10gbase-kr"

config DPULP_ETH_10000BASE_RXAUI
	bool "10gbase-rxaui"

config DPULP_ETH_SGMII_1000M
	bool "1000M-sgmii"

config DPULP_ETH_USXGMII_AN37
	bool "an37-usxgmii"

endchoice

choice
	prompt "Alter reference clock frequency"
	default DPULP_ETH_156250KHZ

config DPULP_ETH_312500KHZ
	bool "312.5MHz"

config DPULP_ETH_156250KHZ
	bool "156.25MHz"

config DPULP_ETH_78125KHZ
	bool "78.125KHz"

endchoice

config DPULP_ETH_INIT
	bool "Enable board late initialization of ethernet"
	depends !DPULP_BBL

config DPULP_ETH_GENERIC
	bool "Enable Linux dwmac-generic driver support"
	help
	  By default, dwmac-duowen driver will be used to locate XPCS and
	  probe phy devices.
	  If unsure, say 'N'.

config DPULP_ETH_LOOPBACK
	bool "Enable loopback connection"
	depends SIMULATION && !DPULP_ETH_MAC2MAC
	help
	  In case there is no real ethernet connected by the XPCS, this
	  option enables testability of sending/receiving packets.

config DPULP_ETH_MAC2MAC
	bool "Enable mac-to-mac connection"
	#depends DPULP_ZEBU
	help
	  Reporting to Linux kernel with fixed-link to enable MAC-to-MAC
	  test environment.

config DPULP_ETH_DTS
	bool "Enable stmmac/dwmac driver in DTS"

endif

menuconfig DPULP_RIO
	bool "DPULP RapidIO interconnect support"
	select MOBIVEIL_RAB
	select DW_E16MP_TSMC12FFC
	select ARCH_IS_RAB_SERIAL
	select ARCH_IS_RAB_PAGE_2KB
	select ARCH_HAS_RAB_SRIO_1_25G
	select ARCH_HAS_RAB_SRIO_4X
	select ARCH_IS_RAB_SCS
	select ARCH_HAS_RAB_AET
	select ARCH_HAS_RAB_RIO_50BIT
	select RAB_RIO_50BIT if ARCH_HAS_RAB_RIO_50BIT

if DPULP_RIO

choice
	prompt "PHY serdes reference clock frequency"
	default DPULP_RIO_62500KHZ

config DPULP_RIO_62500KHZ
	bool "62.5MHz"

config DPULP_RIO_78125KHZ
	bool "78.125MHz"

config DPULP_RIO_125000KHZ
	bool "125MHz"

config DPULP_RIO_156250KHZ
	bool "156.25MHz"

endchoice

endif

endmenu

endif
```
