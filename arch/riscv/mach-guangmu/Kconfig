## drivers/clk/Kconfig
```kconfig
#
# For a description of the syntax of this configuration file,
# see scripts/kbuild/config-language.txt.
#

menu "Clock drivers"

config ARCH_HAS_DW_PLL5GHZ_TIMING
	bool

config ARCH_HAS_DW_PLL5GHZ_DYNAMIC
	bool

menuconfig DW_PLL5GHZ_TSMC12FFC
	bool "Synopsys DWC PLL5GHz TSMC12FFCNS support"
	depends CLK
	select MATH_DIV64
	select DW_PLL5GHZ_TSMC12FFC_DYNAMIC if ARCH_HAS_DW_PLL5GHZ_DYNAMIC
	help
	  This clock-multiplying PLL macro-cell is designed for a TSMC 12nm
	  FFC CMOS technology. The PLL topology has an analog loop with a
	  ring oscillator in its core.
	  The PLL has 2 independent output clock channels (R and P), and
	  each channel frequency is obtained from a programmable integer
	  division of the VCO operating frequency. Each output channel
	  division value is the result of a multiplication between two
	  factors, from two different divider values, and the total
	  division ranges from 2 to 4096.
	  The VCO output frequency is also divided by Fractional Division
	  Circuit (ranging from 16 to 1039) before being compared to an
	  input, which in turn can be an integer division (from 1 to 32) of
	  a crystal based, reference input frequency.
	  A built-in gearshift mode during startup promotes faster locking
	  times at the expense of higher jitter at startup or relock
	  phases, but aims locking times below 10μs.

if DW_PLL5GHZ_TSMC12FFC

config DW_PLL5GHZ_TSMC12FFC_RANGE2
	bool "Enable range 2 preference"
	help
	  For 4G-5G range output frequency, both range2 (vco_mode=1) and
	  range 3 (low_freq=1) can match. By default, range 3 is preferred
	  due to lower jitter (high current => lower jitter), however,
	  range 2 can also be preferred due to lower comsuption.
	  If unsure, say 'N'.

config DW_PLL5GHZ_TSMC12FFC_GEAR
	bool "Enable fast startup transition"
	default y if !SIMULATION
	help
	  From Power-down to Normal operation the PLL can transition by a
	  Fast Startup (gear) state when the gear_shift pin is high, or by
	  a Slow Startup state when the gear_shift pin is low. The big
	  difference between fast and slow startups is the time required
	  to lock the phase of the loop (SPO). Fast PLL locking is achieved
	  at the cost of less phase margin and more jitter during the gear
	  state.

config DW_PLL5GHZ_TSMC12FFC_REG_ACCESS
	bool "Enable PLL control register accesses"
	help
	  Normally, PLL control registers are not useful for PLL
	  programming. However there are some tuning facilities can be
	  used to obtain higher performance.
	  If unsure, say 'N'.

if DW_PLL5GHZ_TSMC12FFC_REG_ACCESS

config DW_PLL5GHZ_TSMC12FFC_PRSTDUR
	bool "Enable preset duration adjustment"
	select BIT_FLS32
	select BIT_FLS8
	select MATH_DIV32
	help
	  The t_prst time interval between the end of the power-down
	  state and the start of the internal gearshift state, is required
	  for a proper analog preset, and it precedes a fast loop phase
	  settling. This timing is internally controlled but should be at
	  least 1μs long. The preset duration can be changed via analog
	  bits prstdur at register ANAREG07. The default value equals 64
	  comparison clock intervals, which translates to 3.2μs at a 20MHz
	  comparison frequency and to 1.282μs at 50MHz. For comparison
	  frequencies above 64MHz the prstdur value should be increased.
	  It's safe to leave this feature disabled if your comparison
	  frequency is below 64MHz.
	  If unsure, say 'N'.

config DW_PLL5GHZ_TSMC12FFC_BYPASS_SYNC
	bool "Enable bypass clock resynchronization circuits"
	help
	  In high speed dividers, there are clock resynchronization
	  circuits that require a sampling frequency below 1GHz to operate
	  correctly. This means that if:
                                             --------- ---------
	    Fvco/(2*(2*divvco[3]+2*divvco[2]+divvco[3]*divvco[2])) > 1GHz
	  Then the bit bypass_sync_p inside register "ANAREG06" should be
	  enabled.

config DW_PLL5GHZ_TSMC12FFC_BYPASS_TEST
	bool "Enable test bypass"

endif

config DW_PLL5GHZ_TSMC12FFC_DYNAMIC
	bool "Enable dynamic changing of static PINs"
	depends ARCH_HAS_DW_PLL5GHZ_DYNAMIC
	help
	  According to the databook, vco_mode, lowfreq, prediv,
	  divvcop|r, p|r are "static" PINs that can only be changed
	  before PLL reset.
	  Enabling this option to allow dynamically changing static PINs
	  via a PLL reset.
	  NOTE that this may cause system clock down, thus care should
	  be taken to switch system clocks to an external source before
	  performing this change.

config DW_PLL5GHZ_TSMC12FFC_SOC_TIMING
	bool "Enable SoC timing support"
	depends ARCH_HAS_DW_PLL5GHZ_TIMING
	help
	  In DUOWEN SoC new version, there are timing indicator bits
	  can be used by the software to poll.

config DW_PLL5GHZ_TSMC12FFC_ACCEL
	bool "Enable acceleration for emulation"
	depends SIMULATION && !DW_PLL5GHZ_TSMC12FFC_SOC_TIMING
	help
	  In emulation environment, t_pwrstb, t_trst and t_pwron can be
	  omit to accelerate emulation.
	  If unsure, say 'N'.

config DW_PLL5GHZ_TSMC12FFC_TRACE
	bool "Enable debugging messages"
	depends CONSOLE_DEBUG

endif

menuconfig SC_PLLTS12FFCLAFRAC2
	bool "Silicon creation fractional PLL TSMC 12nm FFC"

if SC_PLLTS12FFCLAFRAC2

config SC_PLLTS12FFCLAFRAC2_FRAC
	bool "Enable fractional mode support"
	help
	  By default, the driver works in integer mode, enabling this to
	  allow 24-bit fractional settings to be enabled.

config SC_PLLTS12FFCLAFRAC2_PRESET
	bool "Enable preset settings support"
	depends SIMULATION
	help
	  This setting enables simulation support using pre-calculated PLL
	  settings in the driver to improve simulation speed.

endif

endmenu
```

## drivers/cos/Kconfig
```kconfig
if COS
menu "COS drivers"

config COS_SCOS
	bool "Small device card operating system (SCOS)"
	default y

endmenu

endif
```
