## arch/riscv/mach-spike/Kconfig
```kconfig
#
# For a description of the syntax of this configuration file,
# see scripts/kbuild/config-language.txt.
#

if ARCH_SPIKE

menu "Simulated RISCV (SPIKE) board options"

choice
	prompt "CPU ISA"
	default SPIKE_CPU64
	help
	  Selects CPUs that compiled sdfirm should run against.

config SPIKE_CPU32
	bool "32-bit CPU"
	select CPU_SPIKE32

config SPIKE_CPU64
	bool "64-bit CPU"
	select CPU_SPIKE64

endchoice

config SPIKE_BOOT_CPU
	bool "Enable first core as boot CPU"
	help
	  That means exclude the 1st core from SMP cores.

config SPIKE_SMP_CPUS
	int "Number of cores per cluster"
	depends SMP
	range 1 4
	default 4

config SPIKE_SMP_CLUSTERS
	int "Number of clusters per rail"
	depends SMP && !SPIKE_BOOT_CPU
	range 1 32
	default 1

config SPIKE_SMP_RAILS
	int "Number of cluster rails"
	depends SMP && !SPIKE_BOOT_CPU
	range 1 32
	default 1

config SPIKE_MEM1_BASE
	hex "Primary memory base address"
	default 0x80000000

config SPIKE_MEM1_SIZE
	hex "Primary memory size"
	default 0x80000000

config SPIKE_MEM2
	bool "Enable secondary memory range"

if SPIKE_MEM2

config SPIKE_MEM2_BASE
	hex "Secondary memory base"
	default 0x00000000

config SPIKE_MEM2_SIZE
	hex "Secondary memory size"
	default 0x80000000

config SPIKE_MEM2_ROM
	bool "Use secondary memory range as ROM"

endif

config SPIKE_ICACHE
	bool "Enable I-cache"

if SPIKE_ICACHE

config SPIKE_ICACHE_W
	hex "I-cache ways"

config SPIKE_ICACHE_S
	hex "I-cache sets"

config SPIKE_ICACHE_B
	hex "I-cache byte"

endif

config SPIKE_DCACHE
	bool "Enable D-cache"

if SPIKE_DCACHE

config SPIKE_DCACHE_W
	hex "D-cache ways"

config SPIKE_DCACHE_S
	hex "D-cache sets"

config SPIKE_DCACHE_B
	hex "D-cache byte"

endif

config SPIKE_L2_CACHE
	bool "Enable L2-cache"
	depends SPIKE_SMP

if SPIKE_L2_CACHE

config SPIKE_L2_CACHE_W
	hex "L2 cache ways"

config SPIKE_L2_CACHE_S
	hex "L2 cache sets"

config SPIKE_L2_CACHE_B
	hex "L2 cache byte"

endif

menu "Peripheral settings"

config SPIKE_CLINT
	bool "Enable CLINT emulation"
	select ARCH_HAS_CLINT
	select CLINT if !SYS_NOIRQ

config SPIKE_CLINT_RTC_FREQ
	int "Clint timer frequency"
	depends SPIKE_CLINT
	default 10000000
	range 10000 10000000
	help
	  In the cycle accurate emulation environment, using a cycle based
	  RTC frequency causes a longer timeout from the real world's
	  perspective. This configuration allows users to select a lower
	  frequency for the RTC to match the speed of the emulation host.

config SPIKE_HTIF
	bool "Enable HTIF emulation"
	select ARCH_HAS_HTIF
	select HTIF if UART || DEBUG_PRINT || CONSOLE

endmenu

menu "Shutdown scheme"

config SPIKE_SHUTDOWN_SPIKE
	bool "Spike HTIF poweroff"
	help
	  Write to HTIF at specific CSR mimpid.
	select SBI_CSR_MIMPID if SBI

if SPIKE_SHUTDOWN_SPIKE

config SPIKE_CSR_MIMPID
	hex "CSR mimpid value identified to Spike"
	default 0x7370696B

endif

config SPIKE_SHUTDOWN_DUOWEN
	bool "Duowen IO write"
	help
	  Write 0x14 to 0xFFFFFFFF00.

config SPIKE_SHUTDOWN_OVPSIM
	bool "OVPSim spin"
	help
	  Spin around write_tohost symbol.

endmenu

choice
	prompt "Program type"

config SPIKE_PK
	bool "Proxy kernel"
	select SYS_ENTR_M
	select SYS_EXIT_M
	select XIP

config SPIKE_BBL
	bool "Berkeley boot loader (BBL)"
	select SYS_ENTR_M
	select SYS_EXIT_M
	select SYS_EXIT_S
	select SBI
	select XIP

endchoice

endmenu

endif
```

## arch/riscv/mach-spike/acpi/Kconfig
```kconfig
menu "ACPI table settings"

config SPIKE_ACPI_MADT
	bool "Enable multiple APIC description table (MADT) support"

config SPIKE_ACPI_RHCT
	bool "Enable RISC-V hart capabilities table (RHCT) support"

config SPIKE_ACPI_RIMT
	bool "Enable RISC-V IOMMU table (RIMT) support"

config SPIKE_ACPI_SRAT
	bool "Enable system resource affinity table (SRAT) support"

config SPIKE_ACPI_SLIT
	bool "Enable system locality distance information table (SLIT) support"

config SPIKE_ACPI_BERT
	bool "Enable boot error record table (BERT) support"

config SPIKE_ACPI_HEST
	bool "Enable hardware error source table (HEST) support"

config SPIKE_ACPI_ERST
	bool "Enable error record serialization table (ERST) support"

config SPIKE_ACPI_EINJ
	bool "Enable error injection table (EINJ) support"

config SPIKE_ACPI_PCCT
	bool "Enable platform communication channel table (PCCT) support"

config SPIKE_ACPI_MCFG
	bool "Enable memory-mepped configuration space base address description table (MCFG) support"

config SPIKE_ACPI_PPTT
	bool "Enable processor properties topology table (PPTT) support"

config SPIKE_ACPI_SPCR
	bool "Enable serial port console redirection table (SPCR) support"

config SPIKE_ACPI_FPDT
	bool "Enable firmware performance data table (FPDT) support"

config SPIKE_ACPI_SPMI
	bool "Enable service processor management interface table (SPMI) support"

endmenu
```

## arch/riscv/mach-stev20/Kconfig
```kconfig
if ARCH_STEV20

menu "Spacemit STEV20 board options"

config STEV20_SOC
	bool

choice
	prompt "Simulation chip"

config STEV20_CPU
	bool "CPU verification TB (X60/X100)"
	help
	  This configuration contains only CPU subsystem running in RTL
	  environment.

config STEV20_PZ1
	bool "Palladium Z1 verification TB (STEV10)"
	select STEV20_SOC
	help
	  This configuration contains SoC configuration running in RTL
	  environment or on palladium Z1 platform.

config STEV20_S2C
	bool "S2C FPGA verification TB (STEV10)"
	select STEV20_SOC
	help
	  This configuration contains S2C FPGA bit related information
	  where pad_clk is fed by S2CCLK1 and cpu_clk might be fed by
	  S2CCLK2.

endchoice

config STEV20_S2C_SPEEDUP
	bool "Speed up configuration on S2C FPGA"
	depends STEV20_S2C && STEV20_SOC_K1X
	help
	  This configuration is only applied on SPACET_K1X, where S2CCLK2
	  is used as CPU clock, when it is configured as 50MHz, CPU clock
	  gets a doubled rate, that is to say, 100MHz.

config STEV20_S2C_SPEEDUP_QUIRK_RDTIME
	bool "Enable RDTIME quirk on S2C FPGA"
	depends STEV20_S2C_SPEEDUP
	depends !RISCV_SSTC

if STEV20_SOC

choice
	prompt "SoC evaluation (STEV10) chip model"

config STEV20_K1PRO
	bool "K1Pro"

config STEV20_K1MAX
	bool "K1Max"

endchoice

endif

config STEV20_SMP_CPUS
	int "Number of cores"
	depends SMP_BOOT
	range 1 32
	default 4

config STEV20_SMP_SPARSE_HART_ID
	bool "Enable sparse hart ID support"
	depends STEV20_SOC
	depends EXPERIMENTAL
	help
	 Requires lots of changes to the software to determine if the ID
	 is a hart ID or a CPU ID.

menuconfig STEV20_PARTIAL_GOOD
	bool "Partial goods"
	select ARCH_HAS_CLINT_CTX

if STEV20_PARTIAL_GOOD

config STEV20_BOOT_HART_ID
	int "Boot hart ID"
	range 0 7
	default 0

config STEV20_PARTIAL_GOOD_MASK
	hex "Good hart mask"
	default 0x0033

endif

choice
	prompt "Program type"

config STEV20_TB
	bool "Test bench"
	select SYS_ENTR_M
	select SYS_EXIT_M
	select SYS_EXIT_S

config STEV20_ZSBL
	bool "ZSBL loader"
	select ARCH_HAS_BOOT_LOAD
	select LOAD_DATA
	select SYS_ENTR_M
	select SYS_EXIT_M
	select XIP
	select STEV20_BOOT

config STEV20_FSBL
	bool "FSBL loader"
	select ARCH_HAS_BOOT_LOAD
	select SYS_ENTR_M
	select SYS_EXIT_M
	select XIP
	select STEV20_BOOT

config STEV20_BBL
	bool "SBI loader"
	select ARCH_HAS_BOOT_LOAD
	select SYS_ENTR_M
	select SYS_EXIT_M
	select SBI
	select SBI_PAYLOAD
	select XIP

endchoice

choice
	prompt "Program residency"

config STEV20_SRAM
	bool "SRAM"
	depends STEV20_TB || STEV20_BBL

config STEV20_DDR
	bool "DDR"
	depends STEV20_TB || STEV20_BBL

endchoice

config STEV20_DDR_SIZE_CUSTOM
	bool "Enable customized DRAM size"
	depends STEV20_DDR

config STEV20_MEM_SIZE
	hex "Memory size"
	default 0x2000000
	depends STEV20_CPU || STEV20_DDR_SIZE_CUSTOM

config STEV20_BOOT
	bool

if STEV20_BOOT

menu "Bootloader options"

choice
	prompt "Boot mode"

config STEV20_BOOT_DDR
	bool "DDR"
	help
	  Boot to the DDR base address, useful for FSBL. Note, depending
	  on the configurations, program may be loaded via back doors, and
	  FSBL may just directly jump to the DDR base address.

endchoice

endmenu

endif

menuconfig STEV20_CCI
	bool "K1MAX cache coherent interconnect support"
	select CCI550
	depends ARCH_HAS_NOC

menuconfig STEV20_TIMER
	bool "K1MAX timer controller support"
	select ARCH_HAS_SBI_TIMER

if STEV20_TIMER

endif

menuconfig STEV20_UART
	bool "K1MAX UART controller support"
	select STEV20_UART_DW if !STEV20_K1X
	select STEV20_K1X_UART if STEV20_K1X

if STEV20_UART

config STEV20_UART_ACCEL
	bool "Enable K1MAX UART acceleration support"
	depends SIMULATION
	help
	  When this is selected, the UART baudrate generator frequency will
	  be Fsrc/80, making things happening quicker.
	  In case your are using a UART master DPI VIP, selecting this is
	  safe as the VIP cares no about the baudrate.
	  This option is also useful for simulation acceleration.
	  If unsure, say 'N'.

endif

config STEV20_UART_DW
	bool
	select DW_UART
	select ARCH_HAS_NS16550_FIFO_64
	select ARCH_HAS_DW_UART_FIFO_MEM_USER
	select ARCH_HAS_DW_UART_AFCE_MODE
	select ARCH_HAS_DW_UART_FIFO_ACCESS
	select ARCH_HAS_DW_UART_FIFO_STAT
	select ARCH_HAS_DW_UART_SHADOW
	select ARCH_HAS_DW_UART_ADD_ENCODED_PARAMS

endmenu

endif
```

## arch/riscv/mach-unleashed/Kconfig
```kconfig
#
# For a description of the syntax of this configuration file,
# see scripts/kbuild/config-language.txt.
#

if ARCH_UNLEASHED

menu "SiFive HiFive Unleashed (FU540) board options"

menu "CPU configuration"

choice
	prompt "RISCV CPU"
	default CPU_E51

config UNLEASHED_E51
	bool "Monitor Core (E51)"
	select CPU_E51

config UNLEASHED_U54
	bool "Application Cores (U54)"
	select CPU_U54

endchoice

if UNLEASHED_U54

config UNLEASHED_U54_HART_MASK
	bool "Select enabled U54 harts"

if UNLEASHED_U54_HART_MASK

config UNLEASHED_U54_HART1
	bool "hartid 1"
	default y

config UNLEASHED_U54_HART2
	bool "hartid 2"
	depends SMP
	default y

config UNLEASHED_U54_HART3
	bool "hartid 3"
	depends SMP
	default y

config UNLEASHED_U54_HART4
	bool "hartid 4"
	depends SMP
	default y

endif

endif

endmenu

menu "System configuration"

choice
	prompt "Program type"

config UNLEASHED_ZSBL
	bool "Zeroth stage boot loader (ZSBL)"
	depends UNLEASHED_E51
	select SYS_ENTR_M
	select SYS_EXIT_M
	select ARCH_HAS_NOVEC
	select XIP
	select LOAD_DATA
	select UNLEASHED_SPINOR

config UNLEASHED_FSBL
	bool "First stage boot loader (FSBL)"
	depends UNLEASHED_E51
	select SYS_ENTR_M
	select SYS_EXIT_M
	select ARCH_HAS_NOVEC
	select ARCH_HAS_BOOT_LOAD
	select XIP
	select UNLEASHED_SPINOR
	select UNLEASHED_SDCARD
	select SIFIVE_DDR
	select SIFIVE_CACHE
	select MMCSD

config UNLEASHED_BBL
	bool "Berkeley boot loader (BBL)"
	depends UNLEASHED_U54
	select SYS_ENTR_M
	select SYS_EXIT_M
	select SYS_EXIT_S
	select SBI
	select ARCH_HAS_NOVEC
	select ARCH_HAS_BOOT_LOAD
	select XIP

endchoice

config UNLEASHED_FSBL_INIT_ONLY
	bool "Initialize DDR/Cache only (no command line)"
	depends UNLEASHED_FSBL
	help
	  This configuration compiles the firmware to only initialize
	  DDR/cache and hang wfi endlessly. Such binary image can be used
	  with GDB as a first stage E51 bootloader, preparing the
	  execution environment for a next stage U54 BBL which requires to
	  run in the DDR region with cache enabled.

choice
	prompt "Frequency of coreclk"

config UNLEASHED_CORECLK_FREQ_10GHZ
	bool "1.0 GHz"

config UNLEASHED_CORECLK_FREQ_15GHZ
	bool "1.5 GHz"

endchoice

choice
	prompt "Console uart port"

config UNLEASHED_CON_UART0
	bool "UART0"

config UNLEASHED_CON_UART1
	bool "UART1"

endchoice

menu "Boot flash device"

config UNLEASHED_FLASH
	bool
	select STRING_UUID
	select SPI

config UNLEASHED_SDCARD
	bool
	select UNLEASHED_FLASH
	select SD
	select SD_SPI

config UNLEASHED_SPINOR
	bool
	select UNLEASHED_FLASH

choice
	prompt "Boot flash controller"
	default UNLEASHED_FLASH_QSPI2 if UNLEASHED_SDCARD

config UNLEASHED_FLASH_QSPI0
	bool "QSPI0"
	depends UNLEASHED_SPINOR

config UNLEASHED_FLASH_QSPI1
	bool "QSPI1"
	depends UNLEASHED_SPINOR

config UNLEASHED_FLASH_QSPI2
	bool "QSPI2"
	depends UNLEASHED_SDCARD

endchoice

config UNLEASHED_SPINOR_RANDOM_ACCESS
	bool "Enable random accesses"
	depends UNLEASHED_SPINOR

choice
	prompt "SPI-NOR flash data width"
	depends UNLEASHED_SPINOR

config UNLEASHED_SPINOR_SINGLE
	bool "Single"

config UNLEASHED_SPINOR_QUAD
	bool "Quad"
	depends UNLEASHED_SPINOR_RANDOM_ACCESS

endchoice

endmenu

endmenu

menuconfig PRCI
	bool "Power reset clocking interrupt (PRCI) support"
	select ARCH_HAS_CLK
	depends CLK

if PRCI

endif

menuconfig SIFIVE_UART
	bool "SiFive UART controller support"
	select ARCH_HAS_UART
	select GPIO
	select CLK
	select MATH_DIV32

if SIFIVE_UART

config SIFIVE_UART_STATUS
	bool "Split TX/RX status from TX/RXDATA register"
	help
	  TXFULL/RXEMPTY bit is in the same register with TXDATA/RXDATA.
	  Thus polling RX status may result in unexpected data FIFO
	  draining. To avoid this, either prepare a software DWORD cache
	  of RXDATA or split the RXDATA register reads. Enabling this
	  option allows us to shrink the DWORD cache of RXDATA.
	  If unsure, say 'N'.

endif

menuconfig SIFIVE_QSPI
	bool "SiFive SPI controller support"
	select GPIO
	select CLK
	select MATH_DIV32

if SIFIVE_QSPI

config SIFIVE_QSPI_STATUS
	bool "Split TX/RX status from TX/RXDATA register"
	help
	  TXFULL/RXEMPTY bit is in the same register with TXDATA/RXDATA.
	  Thus polling RX status may result in unexpected data FIFO
	  draining. To avoid this, either prepare a software DWORD cache
	  of RXDATA or split the RXDATA register reads. Enabling this
	  option allows us to shrink the DWORD cache of RXDATA.
	  If unsure, say 'N'.

endif

menuconfig SIFIVE_DDR
	bool "Enable DDR subsystem support"
	depends UNLEASHED_FSBL

if SIFIVE_DDR

endif

menuconfig SIFIVE_CACHE
	bool "Enable cache controller support"
	depends UNLEASHED_FSBL

if SIFIVE_CCACHE

endif

endmenu

endif
```

## arch/riscv/mach-vaisra/Kconfig
```kconfig
#
# For a description of the syntax of this configuration file,
# see scripts/kbuild/config-language.txt.
#

if ARCH_VAISRA

menu "Smart Core Vaisra bench options"

config VAISRA_SMP_CPUS
	int "Number of cores per cluster"
	depends SMP
	range 1 4
	default 4

config VAISRA_MEM_BASE
	hex "Primary memory base address"
	default 0x80000000

config VAISRA_MEM_SIZE
	hex "Primary memory size"
	default 0x80000000

menu "Peripheral settings"

config VAISRA_UART
	bool "Enable PL011 uart console"
	select ARCH_IS_UART_PL011
	select UART_PL01X

endmenu

choice
	prompt "Program type"

config VAISRA_TB
	bool "Test bench"
	select SYS_ENTR_M
	select SYS_EXIT_M
	select SYS_EXIT_S

config VAISRA_BBL
	bool "Berkeley boot loader (BBL)"
	select ARCH_HAS_BOOT_LOAD
	select SYS_ENTR_M
	select SYS_EXIT_M
	select SYS_EXIT_S
	select SBI
	select XIP
	select BFM

endchoice

menu "Simulation options"

config VAISRA_BOOT_RAM
	bool "Enable booting from RAM"
	select VAISRA_PMA
	help
	  When BOOT_MODE=ram is configured in vaisra_beta environment,
	  vaisra resets from 0x80000000 instead of resetting from internal
	  ROM address.

menuconfig VAISRA_SPIKE
	bool "Compare vaisra program with spike"
	depends SIMULATION
	select ARCH_HAS_HTIF
	select HTIF if SHUTDOWN
	select SBI_CSR_MIMPID if SBI
	help
	  Verification methodology may compare vaisra program execution
	  log with spike commit logs. Enable this to write to HTIF when
	  spike is detected via its MIMPID.

if VAISRA_SPIKE

config VAISRA_SPIKE_MIMPID
	hex "CSR mimpid value identified to spike"
	default 0x7370696B

endif

config VAISRA_OVPSIM
	bool "Compare vaisra program with OVPSim"
	depends SIMULATION
	help
	  Verification methodology may compare vaisra program execution
	  log with OVPSim tracers.

endmenu

endmenu

endif
```
