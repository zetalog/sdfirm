## arch/riscv/mach-vega/Kconfig
```kconfig
#
# For a description of the syntax of this configuration file,
# see scripts/kbuild/config-language.txt.
#

if ARCH_VEGA

menu "Open-ISA VEGA-Lite (RV32M1) board options"

menu "CPU configuration"

choice
	prompt "RISCV CPU"
	default VEGA_RI5CY

config VEGA_RI5CY
	bool "RI5CY"
	select CPU_RI5CY
	select ARCH_HAS_HIVEC

config VEGA_0RISCY
	bool "Zero RISCY"
	select CPU_0RISCY

endchoice

config VEGA_BOOT_CPU
	bool "Configured as boot CPU"
	default y

config VEGA_JTAG_DISABLED
	bool "Disable JTAG PIN outs"

endmenu

menu "Clock configuration"

config SCG_SOSC
	bool "Use external System OSC (RF OSC)"
	default y

if SCG_SOSC

choice
	prompt "Systme OSC frequency"
	default SCG_SOSC_32MHZ

config SCG_SOSC_32MHZ
	bool "32MHz"

config SCG_SOSC_26MHZ
	bool "26MHz"

endchoice

endif

config SCG_ROSC
	bool "Use external 32.768KHz RTC OSC"
	default y

endmenu

menuconfig LPUART
	bool "Low Power UART (LPUART) module support"
	depends UART || DEBUG_PRINT || CONSOLE
	select ARCH_HAS_UART
	select GPIO

if LPUART

choice
	prompt "Console port"
	default LPUART_CON_0

config LPUART_CON_0
	bool "LPUART0"
	depends VEGA_RI5CY

config LPUART_CON_1
	bool "LPUART1"
	depends VEGA_RI5CY

config LPUART_CON_2
	bool "LPUART2"
	depends VEGA_RI5CY

config LPUART_CON_3
	bool "LPUART3"
	depends VEGA_0RISCY

endchoice

choice
	prompt "LPUART0 multiplexing"
	depends LPUART_CON_0
	default LPUART0_PTC_3

config LPUART0_PTA_2
	bool "PortA Mux 2"
	depends !VEGA_JTAG_DISABLED

config LPUART0_PTB_3
	bool "PortB Mux 3"

config LPUART0_PTC_3
	bool "PortC Mux 3"

endchoice

choice
	prompt "LPUART1 multiplexing"
	depends LPUART_CON_1

config LPUART1_PTA_4
	bool "PortA Mux 4"
	depends !VEGA_JTAG_DISABLED

config LPUART1_PTA_2
	bool "PortA Mux 2"

config LPUART1_PTB_3
	bool "PortB Mux 3"

config LPUART1_PTC_2
	bool "PortC Mux 2"

endchoice

choice
	prompt "LPUART2 multiplexing"
	depends LPUART_CON_2

config LPUART2_PTA_2
	bool "PortA Mux 2"

config LPUART2_PTB_2
	bool "PortB Mux 2"

config LPUART2_PTB_3
	bool "PortB Mux 3"

endchoice

choice
	prompt "LPUART3 multiplexing"
	depends LPUART_CON_3

config LPUART3_PTB_3
	bool "PortB Mux 3"

config LPUART3_PTE_3
	bool "PortE Mux 3"

config LPUART3_PTE_2
	bool "PortE Mux 2"

endchoice

config LPUART_FIFO
	bool "Enable FIFO support"

endif

config IRQC_EVENT
	bool "Event unit support"
	depends !SYS_NOIRQ
	select ARCH_HAS_IRQC

endmenu

endif
```

## arch/riscv/mach-virapa/Kconfig
```kconfig
#
# For a description of the syntax of this configuration file,
# see scripts/kbuild/config-language.txt.
#

if ARCH_VIRAPA

menu "Smart Core Virapa(ksa) bench options"

config VIRAPA_SMP_CPUS
	int "Number of cores per cluster"
	depends SMP
	range 1 2
	default 2
	help
	  VIRAPA test bench has only 2 CPUs embedded.

config VIRAPA_MEM_BASE
	hex "Primary memory base address"
	default 0x80000000

config VIRAPA_MEM_SIZE
	hex "Primary memory size"
	default 0x80000000

menu "Peripheral settings"

config VIRAPA_UART
	bool "Enable PL011 uart console"
	select ARCH_IS_UART_PL011
	select UART_PL01X

endmenu

choice
	prompt "Program type"

config VIRAPA_TB
	bool "Test bench"
	select SYS_ENTR_M
	select SYS_EXIT_M
	select SYS_EXIT_S
	select ARCH_HAS_BOOT_LOAD if VIRAPA_SIM_LOAD

config VIRAPA_BBL
	bool "Berkeley boot loader (BBL)"
	select ARCH_HAS_BOOT_LOAD
	select SYS_ENTR_M
	select SYS_EXIT_M
	select SYS_EXIT_S
	select SBI
	select XIP
	select BFM

endchoice

menu "Simulation options"

config VIRAPA_BOOT_RAM
	bool "Enable booting from RAM"
	select VAISRA_PMA
	help
	  When BOOT_MODE=ram is configured in virapa tb environment,
	  virapa resets from 0x80000000 instead of resetting from internal
	  ROM address.

config VIRAPA_SIM_LOAD
	bool "Enable loading by simulator"

endmenu

endmenu

endif
```

## arch/riscv/mach-virt/Kconfig
```kconfig
if ARCH_VIRT

menu "QEMU RISCV (VIRT) board options"

choice
	prompt "CPU ISA"
	default VIRT_CPU64
	help
	  Selects CPUs that compiled sdfirm should run against.

config VIRT_CPU32
	bool "32-bit CPU"
	select CPU_VIRT32

config VIRT_CPU64
	bool "64-bit CPU"
	select CPU_VIRT64

endchoice

config VIRT_SMP_CPUS
	int "Number of cores per cluster"
	depends SMP
	range 1 8
	default 8

config VIRT_MEM_SIZE
	hex "Memory size"
	default 0x80000000

choice
	prompt "Program type"

config VIRT_TB
	bool "Test bench"
	select SYS_ENTR_M
	select SYS_EXIT_M
	select SYS_EXIT_S

config VIRT_BBL
	bool "Berkeley boot loader (BBL)"
	select ARCH_HAS_BOOT_LOAD
	select SYS_ENTR_M
	select SYS_EXIT_M
	select SBI
	select SBI_PAYLOAD
	select XIP

endchoice

config VIRT_UART
	bool "Virtio UART controller (NS16550) support"
	select NS16550

if VIRT_UART

config VIRT_UART_DTS_CON_HVC
	bool "Enable SBI HVC console in DTS"
	depends EXPERIMENTAL
	help
	  By default, Qemu platform uses NS16550 ttyS0 console. Enabling
	  this to switch to use SBI hvc0 console.

endif

endmenu

endif
```

## arch/riscv/sbi/Kconfig
```kconfig
#
# Supervisor Binary Interface (SBI)
#

config ARCH_HAS_SBI_IPI
	bool

config ARCH_HAS_SBI_TIMER
	bool

config ARCH_HAS_SBI_CLOCK
	bool

config ARCH_HAS_SBI_PINCTRL
	bool

menuconfig SBI
	bool "Supervisor binary interface (SBI) support"
	depends RISCV_ENTR_M && !RISCV_VIRQ
	select RISCV_PMP if CPU_PMP
	select CPU_COUNTERS
	select RISCV_COUNTERS
	select BIT_FLS64
	select BIT_FFS32
	select SBI_RISCV_F if RISCV_F
	select SBI_RISCV_D if RISCV_D
	select SBI_RISCV_C if RISCV_C
	select SBI_NEXT_U if !SBI_PAYLOAD && SYS_EXIT_U
	select SBI_NEXT_S if !SBI_PAYLOAD && SYS_EXIT_S
	select SBI_NEXT_M if !SBI_PAYLOAD && SYS_EXIT_M
	select CLK_MNEMONICS if ARCH_HAS_SBI_CLOCK
	select PRINT_SNPRINTF
	select STRING_STRNCPY

if SBI

config SBI_RISCV_F
	bool "Enable single precision FP load/store"

config SBI_RISCV_D
	bool "Enable double precision FP load/store"

config SBI_RISCV_C
	bool "Enable compressed load/store"

config SBI_RISCV_S
	bool "Enable supervisor mode"
	depends RISCV_S

config SBI_RISCV_U
	bool "Enable user mode"

config SBI_NEXT_U
	bool

config SBI_NEXT_S
	bool

config SBI_NEXT_M
	bool

choice
	prompt "Next priviledge level"

# Disabled for the firmware system
config SBI_RISCV_NEXT_U
	bool "U-Mode"
	depends SBI_NEXT_U
	depends !SBI_DYNAMIC

config SBI_RISCV_NEXT_S
	bool "S-Mode"
	depends SBI_NEXT_S
	depends !SBI_DYNAMIC

config SBI_RISCV_NEXT_M
	bool "M-Mode"
	depends SBI_NEXT_M
	depends !SBI_DYNAMIC

endchoice

config SBI_HMO
	bool "Enable hart map offloading (HMO)"

config SBI_BOOT_PRINTS
	bool "Enable SBI boot prints"
	depends CONSOLE_OUTPUT

choice
	prompt "Firmware type"
	default SBI_DEFAULT

config SBI_DEFAULT
	bool "Enable SBI default binary"

config SBI_PAYLOAD
	bool "Enable SBI payload binary"
	depends !SBI_DYNAMIC
	select SBI_RISCV_F
	select SBI_RISCV_D
	select SBI_RISCV_C
	select SBI_RISCV_S if RISCV_S
	select SBI_RISCV_U if RISCV_U
	select SBI_NEXT_S if RISCV_SEE
	select SBI_NEXT_U if RISCV_AEE
	select CONSOLE
	select CONSOLE_OUTPUT
	select CONSOLE_INPUT

config SBI_DYNAMIC
	bool "Enable SBI dynamic binary"
	select SBI_RISCV_F
	select SBI_RISCV_D
	select SBI_RISCV_C
	select SBI_RISCV_S if RISCV_S
	select SBI_RISCV_U if RISCV_U
	select CONSOLE
	select CONSOLE_OUTPUT
	select CONSOLE_INPUT

endchoice

if SBI_PAYLOAD

config SBI_PAYLOAD_PATH
	string "Path to the payload binary"

config SBI_PAYLOAD_ALIGN_RELAXED
	bool "Enable relaxed alignment"

config SBI_PAYLOAD_DUMP
	bool "Enable payload dump test"
	depends CONSOLE_OUTPUT

endif

config SBI_FDT
	bool "Enable SBI device tree binary"
	select FDT if ARCH_HAS_FDT
	help
	  When device tree is enabled in SBI, platform may choose to use
	  builtin FDT via selecting FDT_BUILTIN in the scope of ARCH_xxx.
	  When FDT_BUILTIN is not selected, the register a1 will be
	  assumed to contain a pointer to the FDT provided by the previous
	  firmware.

if SBI_FDT

config SBI_FDT_BUILTIN
	bool "Force builtin flatened device tree"
	select FDT_BUILTIN
	help
	  On platforms that allow previous firmware to pass DTB via the
	  register of a1, users can still force SBI to use a builtin DTB
	  instead.
	  If unsre, say 'N';

endif

config SBI_CSR_MIMPID
	bool "Support reading the mimpid CSR"
	default n

endif
```

## arch/riscv/utils/Kconfig
```kconfig
# SPDX-License-Identifier: BSD-2-Clause

menu "CPPC Device Support"

config FDT_CPPC
	bool "FDT based CPPC drivers"
	depends on FDT
	default n

if FDT_CPPC

config FDT_CPPC_RPMI
	bool "FDT RPMI CPPC driver"
	depends on FDT_MAILBOX && RPMI_MAILBOX
	default n

endif

endmenu
# SPDX-License-Identifier: BSD-2-Clause

menu "HSM Device Support"

config FDT_HSM
	bool "FDT based HSM drivers"
	depends on FDT
	default n

if FDT_HSM

config FDT_HSM_RPMI
	bool "FDT RPMI HSM driver"
	depends on FDT_MAILBOX && RPMI_MAILBOX
	default n

endif

endmenu
# SPDX-License-Identifier: BSD-2-Clause

menu "Mailbox Support"

config FDT_MAILBOX
	bool "FDT based mailbox drivers"
	depends on FDT
	select MAILBOX
	default n

config RPMI_MAILBOX
	bool "RPMI based mailbox drivers"
	select MAILBOX
	default n

config MAILBOX
	bool "Mailbox support"
	default n

if FDT_MAILBOX

config FDT_MAILBOX_RPMI_SHMEM
	bool "RPMI Shared Memory Mailbox Controller"
	depends on RPMI_MAILBOX
	default n

endif

endmenu
# SPDX-License-Identifier: BSD-2-Clause

menu "MPXY Device Support"

config FDT_MPXY
	bool "FDT based MPXY drivers"
	depends on FDT
	default n

if FDT_MPXY

config FDT_MPXY_RPMI_MBOX
	bool "FDT MPXY mailbox client driver"
	depends on FDT_MAILBOX
	default n

endif

endmenu
# SPDX-License-Identifier: BSD-2-Clause

menu "System Reset Support"

config FDT_RESET
	bool "FDT based reset drivers"
	depends on FDT
	default n

if FDT_RESET

config FDT_RESET_ATCWDT200
	bool "Andes WDT FDT reset driver"
	depends on SYS_ATCSMU
	default n

config FDT_RESET_GPIO
	bool "GPIO FDT reset driver"
	depends on FDT_GPIO
	default n

config FDT_RESET_HTIF
	bool "Host transfer interface (HTIF) FDT reset driver"
	select SYS_HTIF
	default n

config FDT_RESET_RPMI
	bool "RPMI FDT reset driver"
	depends on FDT_MAILBOX && RPMI_MAILBOX
	default n

config FDT_RESET_SG2042_HWMON_MCU
	bool "Sophgo SG2042 hwmon MCU FDT reset driver"
	default n

config FDT_RESET_SUNXI_WDT
	bool "Sunxi WDT FDT reset driver"
	default n

config FDT_RESET_SYSCON
	bool "Syscon FDT reset driver"
	depends on FDT_REGMAP
	default n

endif

endmenu
# SPDX-License-Identifier: BSD-2-Clause

menu "System Suspend Support"

config FDT_SUSPEND
	bool "FDT based suspend drivers"
	depends on FDT
	default n

if FDT_SUSPEND

config FDT_SUSPEND_RPMI
	bool "FDT RPMI suspend driver"
	depends on FDT_MAILBOX && RPMI_MAILBOX
	default n

endif

endmenu
```

## drivers/Kconfig
```kconfig
#
# Firmware Drivers
#

menu "Driver setup"

config ARCH_HAS_APB_20
	bool

config ARCH_HAS_APB_30
	bool

config ARCH_HAS_APB_40
	bool

#
# Common to all Synopsys AMBA advance peripherals
#
config ARCH_HAS_DW_AMBA_ADVANCED
	bool

source drivers/clk/Kconfig
source drivers/gpio/Kconfig
source drivers/timer/Kconfig
source drivers/uart/Kconfig
source drivers/i2c/Kconfig
source drivers/spi/Kconfig
source drivers/i3c/Kconfig
source drivers/dma/Kconfig
source drivers/iommu/Kconfig
source drivers/stm/Kconfig

source drivers/lcd/Kconfig
source drivers/video/Kconfig

source drivers/mtd/Kconfig
source drivers/scs/Kconfig
source drivers/mmc/Kconfig
source drivers/ddr/Kconfig
source drivers/spd/Kconfig
source drivers/pci/Kconfig
source drivers/rio/Kconfig

source drivers/noc/Kconfig
source drivers/net/Kconfig
source drivers/phy/Kconfig

source drivers/lpc/Kconfig
source drivers/kcs/Kconfig
source drivers/espi/Kconfig
source drivers/peci/Kconfig
source drivers/mctp/Kconfig

source drivers/pmu/Kconfig
source drivers/ras/Kconfig
source drivers/wdt/Kconfig

endmenu
```
