## arch/riscv/mach-guangmu/Kconfig
```kconfig
if ARCH_GUANGMU

menu "SmarCo GUANGMU board options"

config GM_SMP_CPUS
	int "Number of cores"
	depends SMP
	range 1 16
	default 16

config GM_MEM_SIZE
	hex "Memory size"
	default 0x80000000

choice
	prompt "Program type"

config GM_TB
	bool "Test bench"
	select SYS_ENTR_M
	select SYS_EXIT_M
	select SYS_EXIT_S

config GM_BBL
	bool "SBI loader"
	select ARCH_HAS_BOOT_LOAD
	select SYS_ENTR_M
	select SYS_EXIT_M
	select SBI
	select SBI_PAYLOAD
	select XIP

endchoice

config GM_CRU
	bool "Guangmu clock/reset unit (CRU) configuration"

menuconfig GM_UART
	bool "Guangmu UART controller support"
	select DW_UART_BIRD

endmenu

endif
```

## arch/riscv/mach-k1matrix/Kconfig
```kconfig
if ARCH_K1MATRIX

menu "SpacemiT K1Matrix board options"

choice
	prompt "Simulation chip"

config K1MXLITE
	bool "K1MXLITE test chip"
	help
	  This configuration contains only CPU subsystem running in RTL
	  environment.

endchoice

config K1MATRIX_SMP_CPUS
	int "Number of cores"
	depends SMP_BOOT
	range 1 64
	default 64

choice
	prompt "Program type"

config K1MATRIX_ZSBL
	bool "ZSBL loader"
	select K1MATRIX_ROM if K1MXLITE
	select LOAD_DATA
	select SYS_ENTR_M
	select SYS_EXIT_M
	select XIP

config K1MATRIX_FSBL
	bool "FSBL loader"
	select ARCH_HAS_BOOT_LOAD
	select SYS_ENTR_M
	select SYS_EXIT_M
	select XIP
	select K1MATRIX_BOOT

config K1MATRIX_BBL
	bool "SBI loader"
	select ARCH_HAS_BOOT_LOAD
	select SYS_ENTR_M
	select SYS_EXIT_M
	select SBI
	select SBI_PAYLOAD
	select XIP

config K1MATRIX_TB
	bool "Test bench"
	select SYS_ENTR_M
	select SYS_EXIT_M
	select SYS_EXIT_S
	select XIP

endchoice

if K1MXLITE

config K1MATRIX_ROM
	bool "Enable head 64KB SRAM as ROM support"

choice
	prompt "BOOT mode"

config K1MATRIX_BOOT_LLP
	bool "SRAM0 (LLP)"

config K1MATRIX_BOOT_SYS
	bool "SRAM1 (SYS)"

endchoice

endif

choice
	prompt "Platform type"
	default K1MATRIX_ASIC

config K1MATRIX_ASIC
	bool "ASIC"
	select K1MATRIX_CPRINT if FINISH

config K1MATRIX_FPGA
	bool "FPGA"

endchoice

config K1MATRIX_FPGA_TDM
	bool "FPGA time-division multiplexing (TDM) partition support"
	depends K1MATRIX_FPGA
	default y

if K1MATRIX_TB

choice
	prompt "Testbench residency"
	default K1MATRIX_TB_DDR

config K1MATRIX_TB_ROM
	bool "ROM"
	select LOAD_DATA

config K1MATRIX_TB_SRAM
	bool "SRAM"
	select ARCH_HAS_BOOT_LOAD

config K1MATRIX_TB_DDR
	bool "DDR"
	select ARCH_HAS_BOOT_LOAD

endchoice

endif

menuconfig K1MATRIX_PARTIAL_GOOD
	bool "Partial goods"

if K1MATRIX_PARTIAL_GOOD

config K1MATRIX_BOOT_HART_ID
	int "Boot hart ID"
	range 0 63
	default 0

config K1MATRIX_PARTIAL_GOOD_MASK
	hex "Good hart mask"
	default 0x0000000000030003

endif

config K1MATRIX_D2D
	bool "Enable die2die link support"

config K1MATRIX_DDR_SIZE_CUSTOM
	bool "Enable customized DRAM size"

config K1MATRIX_DDR_SIZE
	hex "Memory size"
	default 0x2000000
	depends K1MATRIX_DDR_SIZE_CUSTOM

config K1MATRIX_BOOT
	bool
	select K1MATRIX_N100
	select K1MATRIX_PCIE if K1MATRIX_D2D

if K1MATRIX_BOOT

menu "Bootloader options"

choice
	prompt "Boot mode"

config K1MATRIX_BOOT_DDR
	bool "DDR"
	help
	  Boot to the DDR base address, useful for FSBL. Note, depending
	  on the configurations, program may be loaded via back doors, and
	  FSBL may just directly jump to the DDR base address.

endchoice

endmenu

endif

config K1MATRIX_CPRINT
	bool "K1Matrix C_Print simulation support"
	depends !K1MATRIX_FPGA

menuconfig K1MATRIX_N100
	bool "K1Matrix N100 on-chip networking support"
	depends ARCH_HAS_NOC

if K1MATRIX_N100

endif

config K1MATRIX_PCIE
	bool "K1Matrix PCIe subsystem support"

menuconfig K1MATRIX_UART
	bool "K1Mmatrix UART controller support"
	select DW_UART
	select DW_UART_DLF
	select ARCH_HAS_DW_AMBA_ADVANCED
	select ARCH_HAS_NS16550_FIFO_64
	select ARCH_HAS_DW_UART_FIFO_MEM_USER
	select ARCH_HAS_DW_UART_AFCE_MODE
	select ARCH_HAS_DW_UART_FIFO_ACCESS
	select ARCH_HAS_DW_UART_FIFO_STAT
	select ARCH_HAS_DW_UART_SHADOW
	select ARCH_HAS_DW_UART_ADD_ENCODED_PARAMS

if K1MATRIX_UART

choice
	prompt "Console port"
	default K1MATRIX_UART_CON0

config K1MATRIX_UART_CON0
	bool "UART0"

config K1MATRIX_UART_CON1
	bool "UART1"

endchoice

config K1MATRIX_UART_ACCEL
	bool "Enable K1Mmatrix UART acceleration support"
	depends SIMULATION
	help
	  When this is selected, the UART baudrate generator frequency will
	  be Fsrc/16, making things happening quicker.
	  In case your are using a UART master DPI VIP, selecting this is
	  safe as the VIP cares no about the baudrate.
	  This option is also useful for simulation acceleration.
	  If unsure, say 'N'.

endif

endmenu

endif
```

## arch/riscv/mach-k1max/Kconfig
```kconfig
if ARCH_K1MAX

menu "Spacemit K1MAX board options"

choice
	prompt "Simulation chip"

config K1M_CPU
	bool "CPU verification TB"

config K1M_SOC
	bool "SoC verification TB"

endchoice

config K1M_SMP_CPUS
	int "Number of cores"
	depends SMP
	range 1 32
	default 4

config K1M_SMP_SPARSE_HART_ID
	bool "Enable sparse hart ID support"
	depends K1M_SOC
	depends EXPERIMENTAL
	help
	 Requires lots of changes to the software to determine if the ID
	 is a hart ID or a CPU ID.

choice
	prompt "Program type"

config K1M_TB
	bool "Test bench"
	select SYS_ENTR_M
	select SYS_EXIT_M
	select SYS_EXIT_S

config K1M_BBL
	bool "SBI loader"
	select ARCH_HAS_BOOT_LOAD
	select SYS_ENTR_M
	select SYS_EXIT_M
	select SBI
	select SBI_PAYLOAD
	select XIP

endchoice

choice
	prompt "Program residency"

config K1M_SRAM
	bool "SRAM"
	depends K1M_TB || K1M_BBL

config K1M_DDR
	bool "DDR"
	depends K1M_TB || K1M_BBL

endchoice

config K1M_MEM_SIZE
	hex "Memory size"
	default 0x2000000
	depends K1M_CPU || K1M_DDR

menuconfig K1M_CCI
	bool "K1MAX cache coherent interconnect support"
	select CCI550
	depends ARCH_HAS_NOC

menuconfig K1M_TIMER
	bool "K1MAX timer controller support"
	select ARCH_HAS_SBI_TIMER

if K1M_TIMER

endif

menuconfig K1M_UART
	bool "K1MAX UART controller support"
	select DW_UART
	select ARCH_HAS_NS16550_FIFO_64
	select ARCH_HAS_DW_UART_FIFO_MEM_USER
	select ARCH_HAS_DW_UART_AFCE_MODE
	select ARCH_HAS_DW_UART_FIFO_ACCESS
	select ARCH_HAS_DW_UART_FIFO_STAT
	select ARCH_HAS_DW_UART_SHADOW
	select ARCH_HAS_DW_UART_ADD_ENCODED_PARAMS

if K1M_UART

config K1M_UART_ACCEL
	bool "Enable K1MAX UART acceleration support"
	depends SIMULATION
	help
	  When this is selected, the UART baudrate generator frequency will
	  be Fsrc/80, making things happening quicker.
	  In case your are using a UART master DPI VIP, selecting this is
	  safe as the VIP cares no about the baudrate.
	  This option is also useful for simulation acceleration.
	  If unsure, say 'N'.

endif

endmenu

endif
```

## arch/riscv/mach-k1mxlite/Kconfig
```kconfig
if ARCH_K1MXLITE

menu "SpacemiT K1MXLite board options"

choice
	prompt "Simulation chip"

config K1MXLITE
	bool "K1MXLITE test chip"
	help
	  This configuration contains only CPU subsystem running in RTL
	  environment.

config K1MXLITEIOMMU
	bool "K1MXLITEIOMMU: for iommu"
	select ARCH_HAS_IOMMU
	select ARCH_HAS_DMAC
	select CPU_ZIOMMU if K1MXLITE_IOMMU
	select K1MXLITE_DMAR if IOMMU
	select K1MXLITE_DMAC if DMAC
	select K1MXLITE_BMU if PERF
	help
	  This configuration contains server SoC design.

endchoice

config K1MXLITE_SMP_CPUS
	int "Number of cores"
	depends SMP_BOOT
	range 1 64
	default 64

config K1MXLITE_NUMA
	bool

choice
	prompt "Program type"

config K1MXLITE_ZSBL
	bool "ZSBL loader"
	select K1MXLITE_ROM if K1MXLITE
	select LOAD_DATA
	select SYS_ENTR_M
	select SYS_EXIT_M
	select XIP

config K1MXLITE_FSBL
	bool "FSBL loader"
	select ARCH_HAS_BOOT_LOAD
	select SYS_ENTR_M
	select SYS_EXIT_M
	select XIP
	select K1MXLITE_BOOT

config K1MXLITE_BBL
	bool "SBI loader"
	select ARCH_HAS_BOOT_LOAD
	select SYS_ENTR_M
	select SYS_EXIT_M
	select SBI
	select SBI_PAYLOAD
	select XIP
	select K1MXLITE_NUMA if K1MXLITE_D2D
	select CLINT_MULTI if K1MXLITE_D2D

config K1MXLITE_TB
	bool "Test bench"
	select SYS_ENTR_M
	select SYS_EXIT_M
	select SYS_EXIT_S
	select XIP

endchoice

config K1MXLITE_ROM
	bool "Enable head 64KB SRAM as ROM support"

choice
	prompt "BOOT mode"

config K1MXLITE_BOOT_LLP
	bool "SRAM0 (LLP)"

config K1MXLITE_BOOT_SYS
	bool "SRAM1 (SYS)"
	depends K1MXLITE

endchoice

choice
	prompt "Platform type"
	default K1MXLITE_ASIC

config K1MXLITE_ASIC
	bool "ASIC"
	select K1MXLITE_CPRINT if FINISH

config K1MXLITE_FPGA
	bool "FPGA"

endchoice

config K1MXLITE_FPGA_TDM
	bool "FPGA time-division multiplexing (TDM) partition support"
	depends K1MXLITE_FPGA
	default y

if K1MXLITE_TB

choice
	prompt "Testbench residency"
	default K1MXLITE_TB_DDR

config K1MXLITE_TB_ROM
	bool "ROM"
	select LOAD_DATA

config K1MXLITE_TB_SRAM
	bool "SRAM"
	select ARCH_HAS_BOOT_LOAD

config K1MXLITE_TB_DDR
	bool "DDR"
	select ARCH_HAS_BOOT_LOAD
	select K1MXLITE_NUMA if K1MXLITE_D2D

endchoice

endif

menuconfig K1MXLITE_PARTIAL_GOOD
	bool "Partial goods"

if K1MXLITE_PARTIAL_GOOD

config K1MXLITE_BOOT_HART_ID
	int "Boot hart ID"
	range 0 63
	default 0

config K1MXLITE_PARTIAL_GOOD_MASK
	hex "Good hart mask"
	default 0x0000000000030003

endif

config K1MXLITE_D2D
	bool "Enable die2die link support"

config K1MXLITE_DDR_SIZE_CUSTOM
	bool "Enable customized DRAM size"

config K1MXLITE_DDR_SIZE
	hex "Memory size"
	default 0x2000000
	depends K1MXLITE_DDR_SIZE_CUSTOM

config K1MXLITE_BOOT
	bool
	select K1MXLITE_N100
	select K1MXLITE_PCIE if K1MXLITE_D2D
	select N100_CCIX if K1MXLITE_D2D

if K1MXLITE_BOOT

menu "Bootloader options"

choice
	prompt "Boot mode"

config K1MXLITE_BOOT_DDR
	bool "DDR"
	help
	  Boot to the DDR base address, useful for FSBL. Note, depending
	  on the configurations, program may be loaded via back doors, and
	  FSBL may just directly jump to the DDR base address.

endchoice

endmenu

endif

config K1MXLITE_CPRINT
	bool "K1MXLite C_Print simulation support"
	depends !K1MXLITE_FPGA

menuconfig K1MXLITE_N100
	bool "K1MXLite N100 on-chip networking support"
	select ARCH_HAS_N100
	select ARCH_HAS_N100_CCIX
	select N100
	select N100_CCIX if K1MXLITE_D2D
	depends ARCH_HAS_NOC

if K1MXLITE_N100

endif

config K1MXLITE_PCIE
	bool "K1MXLite PCIe subsystem support"

menuconfig K1MXLITE_UART
	bool "K1Mmatrix UART controller support"
	select DW_UART
	select DW_UART_DLF
	select ARCH_HAS_DW_AMBA_ADVANCED
	select ARCH_HAS_NS16550_FIFO_64
	select ARCH_HAS_DW_UART_FIFO_MEM_USER
	select ARCH_HAS_DW_UART_AFCE_MODE
	select ARCH_HAS_DW_UART_FIFO_ACCESS
	select ARCH_HAS_DW_UART_FIFO_STAT
	select ARCH_HAS_DW_UART_SHADOW
	select ARCH_HAS_DW_UART_ADD_ENCODED_PARAMS

if K1MXLITE_UART

choice
	prompt "Console port"
	default K1MXLITE_UART_CON0

config K1MXLITE_UART_CON0
	bool "UART0"

config K1MXLITE_UART_CON1
	bool "UART1"

endchoice

config K1MXLITE_UART_ACCEL
	bool "Enable K1Mmatrix UART acceleration support"
	depends SIMULATION
	help
	  When this is selected, the UART baudrate generator frequency will
	  be Fsrc/16, making things happening quicker.
	  In case your are using a UART master DPI VIP, selecting this is
	  safe as the VIP cares no about the baudrate.
	  This option is also useful for simulation acceleration.
	  If unsure, say 'N'.

endif

menuconfig K1MXLITE_DMAR
	bool "Enable K1MXLite DMA remapping support"
	depends ARCH_HAS_IOMMU

if K1MXLITE_DMAR

config K1MXLITE_SMMU
	bool

choice
	prompt "IOMMU specification"

config K1MXLITE_IOMMU
	bool "RISC-V IOMMU"
	select RISCV_ZIOMMU
	select IOMMU_PGTABLE_RISCV

config K1MXLITE_SMMUv2
	bool "ARM SMMUv2"
	select SMMU_MMU500
	select IOMMU_PGTABLE_ARMv8
	select K1MXLITE_SMMU

config K1MXLITE_SMMUv3
	bool "ARM SMMUv3"
	select SMMU_MMU600
	select IOMMU_PGTABLE_ARMv8
	select K1MXLITE_SMMU

endchoice

endif

menuconfig K1MXLITE_DMAC
	bool "Enable K1MXLite DMA channel support"
	depends ARCH_HAS_DMAC

if K1MXLITE_DMAC

endif

menuconfig K1MXLITE_BMU
	bool "Enable K1MXLite bus monitor unit (BMU) support"
	depends ARCH_HAS_PMU
	select BIT_HWEIGHT32

menuconfig K1MXLITE_MBOX
	bool "Enable K1MXLite mailbox support"

menuconfig K1MXLITE_LPC
	bool "Enable K1MXLite low pin count bridge (LPC) support"
	depends ARCH_HAS_LPC
	select SPACEMIT_LPC

menuconfig K1MXLITE_KCS
	bool "Enable K1MXLite Keyboard Controller Style (KCS) support"
	depends ARCH_HAS_KCS
	select KCS_MICROSEMI_CORELPC

endmenu

endif
```

## arch/riscv/mach-k1x/Kconfig
```kconfig
if ARCH_K1X

menu "Spacemit K1X board options"

config K1M_K1X
	bool

config K1X_S2C
	bool "S2C FPGA verification for K1-X"
	select K1M_K1X
	help
	  This configuration contains S2C FPGA bit developed by dev-A-dep.
	  Where:
	         CPU clk: S2CCLK_3(20M) /2 10M
            BUS(CCI) clk: S2CCLK_4(10M)
	         DDR clk: S2CCLK_1(20M) /4 5M (dfi, axi)
	    BUS(NCI) clk: S2CCLK_5(30M)
	        UART clk: S2CCLK_2(29M) /2 14.75M
	         PIC clk: S2CCLK_4(10M)

if K1M_K1X

choice
	prompt "SoC evaluation chip model"

config K1M_SOC_K1X
	bool "K1-X"

endchoice

endif

config K1X_SMP_CPUS
	int "Number of cores"
	depends SMP
	range 1 32
	default 4

config K1X_SMP_SPARSE_HART_ID
	bool "Enable sparse hart ID support"
	depends K1M_K1X
	depends EXPERIMENTAL
	help
	 Requires lots of changes to the software to determine if the ID
	 is a hart ID or a CPU ID.

menuconfig K1X_PARTIAL_GOOD
	bool "Partial goods"
	select ARCH_HAS_CLINT_CTX

if K1X_PARTIAL_GOOD

config K1X_BOOT_HART_ID
	int "Boot hart ID"
	range 0 7
	default 0

config K1X_PARTIAL_GOOD_MASK
	hex "Good hart mask"
	default 0x0033

endif

choice
	prompt "Program type"

config K1X_TB
	bool "Test bench"
	select SYS_ENTR_M
	select SYS_EXIT_M
	select SYS_EXIT_S

config K1X_BBL
	bool "SBI loader"
	select ARCH_HAS_BOOT_LOAD
	select SYS_ENTR_M
	select SYS_EXIT_M
	select SBI
	select SBI_PAYLOAD
	select XIP

endchoice

choice
	prompt "Program residency"

config K1X_SRAM
	bool "SRAM"
	depends K1X_TB || K1X_BBL

config K1X_DDR
	bool "DDR"
	depends K1X_TB || K1X_BBL

endchoice

config K1X_DDR_HIGH
	bool "Use high range of DDR DRAM"
	depends K1M_K1X

config K1X_DDR_SIZE_CUSTOM
	bool "Enable customized DRAM size"
	depends K1X_DDR

config K1X_MEM_SIZE
	hex "Memory size"
	default 0x2000000
	depends K1X_CPU || K1X_DDR_SIZE_CUSTOM

menuconfig K1X_CCI
	bool "K1MAX cache coherent interconnect support"
	select CCI550
	depends ARCH_HAS_NOC

menuconfig K1X_TIMER
	bool "K1MAX timer controller support"
	select ARCH_HAS_SBI_TIMER

if K1X_TIMER

endif

menuconfig K1X_UART
	bool "K1MAX UART controller support"
	select K1M_K1X_UART if K1M_K1X

if K1X_UART

config K1X_UART_ACCEL
	bool "Enable K1MAX UART acceleration support"
	depends SIMULATION
	help
	  When this is selected, the UART baudrate generator frequency will
	  be Fsrc/80, making things happening quicker.
	  In case your are using a UART master DPI VIP, selecting this is
	  safe as the VIP cares no about the baudrate.
	  This option is also useful for simulation acceleration.
	  If unsure, say 'N'.

endif

config K1M_K1X_UART
	bool
	select NS16550
	select ARCH_HAS_NS16550
	select ARCH_HAS_NS16550_MEM32

endmenu

endif
```

## arch/riscv/mach-k210/Kconfig
```kconfig
#
# For a description of the syntax of this configuration file,
# see scripts/kbuild/config-language.txt.
#

if ARCH_K210

menu "Kendryte K210 board options"

choice
	prompt "Program type"

config K210_BBL
	bool "Berkeley boot loader (BBL)"
	select SYS_ENTR_M
	select SYS_EXIT_M
	select SYS_EXIT_S
	select SBI
	select ARCH_HAS_NOVEC
	select ARCH_HAS_BOOT_LOAD
	select XIP

endchoice

menuconfig K210_SYSCTL
	bool "System control (SYSCTL) support"
	select ARCH_HAS_CLK
	depends CLK

if K210_SYSCTL

endif

menu "Pad pin settings"

menuconfig FPIOA
	bool "Field Programmable GPIO Array (FPIOA) support"

if FPIOA

endif

menuconfig GPIOHS
	bool "High speed GPIO controller (GPIOHS) support"

if GPIOHS

endif

endmenu

menu "Serial port settings"

menuconfig UARTLS
	bool "Low speed UART controller (UART) support"

if UARTLS

endif

menuconfig UARTHS
	bool "High speed UART controller (UARTHS) support"
	select ARCH_HAS_UART
	select GPIO
	select CLK

if UARTHS

endif

endmenu

endmenu

endif
```
