local &image
local &bp
local &arguments
local &cmm_dir
local &top_dir
local &sym_dir
local &saved_dir

entry %line &arguments

&saved_dir=os.pwd()

&cmm_dir=os.pwd()
cd &cmm_dir/..
&top_dir=os.pwd()
&sym_dir=string.split("&top_dir","\",-1)

&image=STRing.SCANAndExtract(string.lwr("&arguments"), "image=", "sdfirm")
&bp=STRing.SCANAndExtract(string.lwr("&arguments"), "bp=", "system_init")

sys.down
sys.up

r /spotlight
d.l
cd &top_dir
data.load &image /StripPart "&sym_dir" /Path &top_dir
mode.HLL
b.d /all
IF (("&bp"!=""))
(
    b.s &bp
    go
)

cd &saved_dir
