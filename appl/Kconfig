## arch/arm64/common/Kconfig
```kconfig
# QDF2400
config CPU_QDF2400
	bool
	select CPU_64v8_1
	help
	  1 Cortex-A53 (IMC) + many Cortex-A57 (APC).

# VExpress
config CPU_VEXPRESS
	bool
	select CPU_64v8_1
	help
	  4 Cortex-A53.

# Figure out what processor architecture version we should be using.
# This defines the compiler instruction set which depends on the machine type.

config CPU_64v7
	bool
	select CPU_64v7_VE

# Virtualization extension
config CPU_64v7_VE
	bool
	depends CPU_64v7

config CPU_64v8
	bool
	select CPU_64v7
	select CPU_64v8_TZ

config CPU_64v8_0
	bool
	select CPU_64v8

config CPU_64v8_1
	bool
	select CPU_64v8_0
	select CPU_64v8_1_ATOMICS
	select CPU_64v8_1_SIMD
	select CPU_64v8_1_LOR
	select CPU_64v8_1_HPD
	select CPU_64v8_1_PAN
	select CPU_64v8_1_VHE

config CPU_64v8_2
	bool
	select CPU_64v8_1
	select CPU_64v8_RAS
	select CPU_64v8_2_ATS1E1
	select CPU_64v8_2_UAO
	select CPU_64v8_2_DCPoP
	select CPU_64v8_2_TTCNP
	select CPU_64v8_2_TTS2UXN
	select CPU_64v8_2_IESB

# TrustZone
config CPU_64v8_TZ
	bool
	depends CPU_64v8

# Reliability Availability and Serviceability Extension
config CPU_64v8_RAS
	bool
	depends CPU_64v8

# CAS atomics support
config CPU_64v8_1_ATOMICS
	bool
	depends CPU_64v8_1

config CPU_64v8_1_SIMD
	bool
	depends CPU_64v8_1

# Limited ordering regions
config CPU_64v8_1_LOR
	bool
	depends CPU_64v8_1

# Hierarchical permission disable
config CPU_64v8_1_HPD
	bool
	depends CPU_64v8_1

# Hardware management of Access flag and Dirty state
config CPU_64v8_1_TTHM
	bool
	depends CPU_64v8_1

# Privileged access never
config CPU_64v8_1_PAN
	bool
	depends CPU_64v8_1

# 16-bit VMID
config CPU_64v8_1_VMID16
	bool
	depends CPU_64v8_1

# Virtualization Host Extensions
config CPU_64v8_1_VHE
	bool
	depends CPU_64v8_1

# ARMv8.1 PMU Extension
config CPU_64v8_1_PMU
	bool
	depends CPU_64v8_1

# Statistical Profiling Extension
config CPU_64v8_2_SPE
	bool
	select CPU_64v8_2

# Scalable Vector Extension
config CPU_64v8_2_SVE
	bool
	select CPU_64v8_2

config CPU_64v8_2_ATS1E1
	bool
	depends CPU_64v8_2

# SIMD Dot Product
config CPU_64v8_2_DotProd
	bool
	depends CPU_64v8_2

# Half-precision floating-point data processing
config CPU_64v8_2_FP16
	bool
	depends CPU_64v8_2

# Load/Store Multiple atomicity and ordering controls
config CPU_64v8_2_LSMAOC
	bool
	depends CPU_64v8_2

# PSTATE override of Unprivileged Load/Store
config CPU_64v8_2_UAO
	bool
	depends CPU_64v8_2

# Data cache clean to Point of Persistence
config CPU_64v8_2_DCPoP
	bool
	depends CPU_64v8_2

# VMID-aware PIPT instruction cache
config CPU_64v8_2_VPIPT
	bool
	depends CPU_64v8_2

# Translation table page-based hardware attributes
config CPU_64v8_2_TTPBHA
	bool
	depends CPU_64v8_2

# Large VA (LVA) support
config CPU_64v8_2_LVA
	bool
	depends CPU_64v8_2

# Large PA (LPA) support
config CPU_64v8_2_LPA
	bool
	depends CPU_64v8_2

# Translation table Common not private translations
config CPU_64v8_2_TTCNP
	bool
	depends CPU_64v8_2

# Translation table stage 2 Unprivileged Execute-never
config CPU_64v8_2_TTS2UXN
	bool
	depends CPU_64v8_2

config CPU_64v8_2_DEBUG
	bool
	depends CPU_64v8_2

# PC Sample-based Profiling
config CPU_64v8_2_PC_SAMPLE
	bool
	depends CPU_64v8_2

# Implicit error synchronization event
config CPU_64v8_2_IESB
	bool
	depends CPU_64v8_2

config CPU_BIG_ENDIAN
	bool "Build big-endian kernel"
	depends on ARCH_SUPPORTS_BIG_ENDIAN
	help
	  Say Y if you plan on running a kernel in big-endian mode.

config NR_CPUS
	int "Maximum number of CPUs (1-4096)"
	range 1 4096
	# These have to remain sorted largest to smallest
	default "48"

choice
	prompt "System security (TrustZone)"
	default TZ_NORMAL

config TZ_SECURE
	bool "Secure world" if CPU_64v8_TZ

config TZ_NORMAL
	bool "Normal world"

endchoice

choice
	prompt "System priviledge"
	default SYS_KERNEL if TZ_NORMAL
	default SYS_MONITOR if TZ_SECURE

# Disabled for the firmware system
#config SYS_USER
#	bool "User mode"

config SYS_KERNEL
	bool "Privileged (kernel) mode"
	select SYS_GUEST if !SYS_HYPERVISOR

config SYS_MONITOR
	bool "Monitor mode"
	depends TZ_SECURE
	depends !BOOTLOADER

endchoice

config SYS_GUEST
	bool
	depends !SYS_HYPERVISOR && SYS_KERNEL

menuconfig SYS_HYPERVISOR
	bool "Hypervisor optimization support"
	depends TZ_NORMAL && SYS_KERNEL
	depends CPU_64v7_VE
	depends !BOOTLOADER

if SYS_HYPERVISOR

config SYS_HOST
	bool "Host OS optimization support"
	depends CPU_64v8_1_VHE

endif

config PSCI
	bool "Power State Coordination Interface (PSCI) support"
	depends SYS_MONITOR || BOOT_LINUX

choice
	prompt "Interrupt controller"

config GIC
	bool "GIC"
	depends on CPU_64v8
	select ARCH_HAS_IRQC
	help
	  The GIC architecture describes an interrupt controller for use with
	  one or more processors that comply with ARM A or R architecture
	  profiles.

endchoice

if GIC

menu "Generic Interrupt Controller (GIC) support"

config ARCH_HAS_GICv2
	bool

config ARCH_HAS_GICv3
	bool

choice
	prompt "GIC architecture"

config GICv2
	bool "GICv2"
	depends ARCH_HAS_GICv2
	help
	  GIC v2 (IHI0028B) architecture specification.

config GICv3
	bool "GICv3"
	depends ARCH_HAS_GICv3
	help
	  GIC v3 (IHI0069D) architecture specification.

endchoice

config GICv2_IRQ_NS
	bool "Enable non-secure IRQ"
	depends GICv2

config GIC_IRQ_GROUPING
	bool "Interrupt grouping"
	depends on ARM_TRUSTZONE
	help
	  Interrupt grouping is present in GICv2 implementations and in GICv1
	  implementations that include the GIC security extensions.

endmenu

endif

menuconfig VMSA
	bool "Virtual Memory System Architecture (VMSA) support"
	select ARCH_HAS_MMU_4K	# bits = level * 9 + 12
	select ARCH_HAS_MMU_16K	# bits = level * 11 + 14
	select ARCH_HAS_MMU_64K	# bits = level * 13 + 16
	select ARCH_HAS_MMU_3L if MMU_4K_PAGE && VMSA_VA_4GB	# 32-bits
	select ARCH_HAS_MMU_3L if MMU_4K_PAGE && VMSA_VA_64GB	# 36-bits
	select ARCH_HAS_MMU_4L if MMU_4K_PAGE && VMSA_VA_1TB	# 40-bits
	select ARCH_HAS_MMU_4L if MMU_4K_PAGE && VMSA_VA_16TB	# 44-bits
	select ARCH_HAS_MMU_4L if MMU_4K_PAGE && VMSA_VA_256TB	# 48-bits
	select ARCH_HAS_MMU_2L if MMU_16K_PAGE && VMSA_VA_4GB	# 32-bits
	select ARCH_HAS_MMU_2L if MMU_16K_PAGE && VMSA_VA_64GB	# 36-bits
	select ARCH_HAS_MMU_3L if MMU_16K_PAGE && VMSA_VA_1TB	# 40-bits
	select ARCH_HAS_MMU_3L if MMU_16K_PAGE && VMSA_VA_16TB	# 44-bits
	select ARCH_HAS_MMU_4L if MMU_16K_PAGE && VMSA_VA_256TB	# 48-bits
	select ARCH_HAS_MMU_2L if MMU_64K_PAGE && VMSA_VA_4GB	# 32-bits
	select ARCH_HAS_MMU_2L if MMU_64K_PAGE && VMSA_VA_64GB	# 36-bits
	select ARCH_HAS_MMU_2L if MMU_64K_PAGE && VMSA_VA_1TB	# 40-bits
	select ARCH_HAS_MMU_3L if MMU_64K_PAGE && VMSA_VA_16TB	# 44-bits
	select ARCH_HAS_MMU_3L if MMU_64K_PAGE && VMSA_VA_256TB	# 48-bits
	select ARCH_HAS_MMU_3L if MMU_64K_PAGE && VMSA_VA_4PB	# 52-bits

if VMSA

choice
	prompt "Maximum input address size"
	default VMSA_VA_256TB
	help
	  This option defines stage 1 translation input address size.

config VMSA_VA_4GB
	bool "<=4GB"

config VMSA_VA_64GB
	bool "<=64GB"

config VMSA_VA_1TB
	bool "<=1TB"

config VMSA_VA_16TB
	bool "<=16TB"

config VMSA_VA_256TB
	bool "<=256TB"

config VMSA_VA_4PB
	bool "<=4PB"
	depends MMU_64K_PAGE && CPU_64v8_2_LVA

endchoice

config VMSA_ADDRESS_TAGGING
	bool "Address tagging support"

config VMSA_VA_2_RANGES
	bool "Two VA ranges support"
	depends (SYS_KERNEL && !SYS_HYPERVISOR) || SYS_HOST

endif

menu "External Debug support"

config ARM_DCC
	bool "Debug Communications Channel (DCC) support"
	select ARCH_HAS_UART
	help
	  The Debug Communications Channel, DCC, is a channel for passing
	  data between the PE and an external agent, such as a debugger.
	  The DCC provides a communications channel between:
	  * An external debugger, described as the debug host.
	  * The debug implementation on the PE, described as the debug
	    target.
	  The DCC can be used:
	  * As a 32-bit full-duplex channel.
	  * As a 64-bit half-duplex channel.
	  The DCC is an essential part of Debug state operation and can
	  also be used in Non-debug state.

endmenu

menuconfig PMU
	bool "Performance Monitor Unit (PMU) support"
	depends on CPU_64v8
	select ARCH_HAS_PMU

if PMU

choice
	prompt "PMU architecture"
	default PMUv3

config PMUv3
	bool "PMUv3"

endchoice

endif

source "arch/arm64/common/coresight/Kconfig"

menu "ARM CoreLink peripheral support"

config UART_PL01X
	bool "PrimeCell UART (PL01x) support"
	select ARCH_HAS_UART
	help
	  PrimeCell UART (PL010/PL011) offers similar functionality to the
	  industry-standard 16C550 UART.

if UART_PL01X

config ARCH_IS_UART_PL010
	bool

config ARCH_IS_UART_PL011
	bool

choice
	prompt "PL01x architecture"

config UART_PL010
	bool "PL010"
	depends ARCH_IS_UART_PL010

config UART_PL011
	bool "PL011"
	depends ARCH_IS_UART_PL011

endchoice

config UART_PL01X_SBSA
	bool "PL01X Server Base System Architecture (SBSA) subset"
	select ARCH_IS_UART_PL011
	help
	  Select this to exclude non-SBSA required features.

endif

endmenu

config CPU_BIG_ENDIAN
	bool "Build big-endian kernel"
	depends on ARCH_SUPPORTS_BIG_ENDIAN
	help
	  Say Y if you plan on running a kernel in big-endian mode.
	  Note that your board must be properly built and your board
	  port must properly enable any big-endian related features
	  of your chipset/board/processor.
```

## arch/arm64/common/coresight/Kconfig
```kconfig
config CORESIGHT
	bool "ARM CoreSight architecture support"

if CORESIGHT

config CORESIGHT_VERBOSE
	bool "Enable log verbosity"
	help
	  Print detailed enumeration logs.

config CORESIGHT_DBG_CPUv80A
	bool "ARM CoreSight Processor Core v8.0A Debug support"
	depends CPU_v80A
	help
	  DEVARCH.archid=0x6A15.

config CORESIGHT_ETM
	bool "ARM CoreSight Embedded Trace Macrocell (ETM) support"
	help
	  DEVARCH.archid=0x4A13.

config CORESIGHT_STM
	bool "ARM CoreSight System Trace Macrocell (STM) support"
	help
	  DEVARCH.archid=0x0A63.

config CORESIGHT_PMU
	bool "ARM CoreSight Performance Monitor Unit (PMU) support"
	help
	  DEVARCH.archid=0x2A16.

config CORESIGHT_CTI
	bool "ARM CoreSight Cross Trigger Interface (CTI) support"

config CORESIGHT_TPIU
	bool "ARM CoreSight Trace Port Interface Unit (TPIU) support"
	help
	  DEVTYPE.major=1, DEVTYPE.sub=1.

config CORESIGHT_ETB
	bool "ARM CoreSight Embedded Trace Buffer (ETB) support"
	help
	  DEVTYPE.major=1, DEVTYPE.sub=2.

config CORESIGHT_FUNNEL
	bool "ARM CoreSight Funnel/Router support"
	help
	  DEVTYPE.major=2, DEVTYPE.sub=1.

config CORESIGHT_REPLICATOR
	bool "ARM CoreSight Replicator support"
	help
	  DEVTYPE.major=2, DEVTYPE.sub=2.

config CORESIGHT_TMC
	bool "ARM CoreSight Trace Memory Controller (TMC) support"
	help
	  DEVTYPE.major=2, DEVTYPE.sub=3.

endif
```

## arch/arm64/mach-gem5/Kconfig
```kconfig
#
# For a description of the syntax of this configuration file,
# see scripts/kbuild/config-language.txt.
#

if ARCH_GEM5

menu "GEM5 VExpress_EMM64 board options"

config GEM5_ROM_AS_RAM
	bool "Use VExpress_EMM64 ROM as RAM"
	select XIP
	help
	  As VExpress_EMM64 ROM (0x0000000-0x4000000) supports XIP, this
	  option stops firmware from re-locating from ROM to RAM and allows
	  page allocator to allocate from ROM. So it is only suitable for
	  simulation environment.

config GEM5_RAM_DEFAULT
	bool "Enable default VExpress_EMM64 RAM"
	help
	  VExpress_EMM64 RAM resides at 0x80000000-0xA0000000. Enable this
	  option allows page allocator to allocate from this region. This
	  option also forces firmware to re-locate from ROM to RAM if
	  GEM5_ROM_AS_RAM is not selected.

config GEM5_RAM_BASE
	hex "Base physical address of RAM"
	default 0
	depends !GEM5_RAM_DEFAULT
	help
	  This option is useful for RTL simulation environment where the
	  RTL simulation configuration may differ from the default GEM5
	  VExpress_EMM64 configuration. Note that if RAM base is not set to
	  0, 0 based region will be treated as ROM and XIP, firmware may
	  still boot from ROM and is re-located to RAM, and page allocator
	  won't allocate from ROM region.

config GEM5_RAM_BITS
	hex "Physical memory bits of RAM"
	default 24
	help
	  This option is useful for RTL simulation environment.
	  Bit shift N of RAM memory size. Memory size will be 2^N.

config UART_GEM5
	bool "AMBA PL011 uart controller support"
	depends !ARM_DCC
	select UART_PL01X
	select UART_PL011
	default y
	help

endmenu

endif
```

## arch/arm64/mach-qdf2400/Kconfig
```kconfig
#
# For a description of the syntax of this configuration file,
# see scripts/kbuild/config-language.txt.
#

if ARCH_QDF2400

menu "Qualcomm Centriq 2400 board options"

choice
	prompt "Programmed CPUs"
	help
	  Selects CPUs that compiled sdfirm should run against.

config QDF2400_IMC
	bool "IMC"
	select ARCH_HAS_GICv2

config QDF2400_APC
	bool "APC"
	select ARCH_HAS_GICv3

endchoice

menu "Pseudo partial good settings"

config QDF2400_PSEUDO_CPU_MASK
	bool "Enable pseudo CPU mask"

if QDF2400_PSEUDO_CPU_MASK

choice
	prompt "Pseudo CPU mask"
	default QDF2400_CPU_6_CORES

config QDF2400_CPU_48_CORES
	bool "48 CPU cores"

config QDF2400_CPU_6_CORES
	bool "6 CPU cores"

config QDF2400_CPU_USER_CORES
	bool "User defined"

endchoice

config QDF2400_CPU_MASK
	hex "CPU mask"
	depends QDF2400_CPU_USER_CORES
	default 0xFFFFFFFFFFFF

endif

config QDF2400_PSEUDO_LLC_MASK
	bool "Enable pseudo L3 mask"

if QDF2400_PSEUDO_LLC_MASK

choice
	prompt "Pseudo L3 mask"
	default QDF2400_L3_24_INTERLEAVES

config QDF2400_LLC_24_INTERLEAVES
	bool "24 L3 interleaves"

config QDF2400_LLC_USER_INTERLEAVES
	bool "User defined"

endchoice

config QDF2400_LLC_MASK
	hex "L3 mask"
	depends QDF2400_LLC_USER_INTERLEAVES
	default 0xFFFFFF

endif

config QDF2400_PSEUDO_DDR_MASK
	bool "Enable pseudo DDR mask"
	depends !DDR

if QDF2400_PSEUDO_DDR_MASK

config QDF2400_DDR_12_SLOTS
	bool "12 DDR slots"
	default y

config QDF2400_DDR_MASK
	hex "DDR mask" if !QDF2400_DDR_12_SLOTS
	default 0xFFF

endif

config QDF2400_PSEUDO_PERIPH_MASK
	bool "Enable pseudo peripheral mask"
	help
	  System fabric is always enabled, and not configurable.

if QDF2400_PSEUDO_PERIPH_MASK

config QDF2400_PERIPH_PCIE0
	bool "PCIe 0"

config QDF2400_PERIPH_PCIE1
	bool "PCIe 1"

config QDF2400_PERIPH_HDMA
	bool "HiDMA"

config QDF2400_PERIPH_SATA
	bool "SATA"

endif

endmenu

config GPIO_TLMM
	bool "Qualcomm Top Level Module Multiplexer (TLMM) support"

config UART_QUART
	bool "Qualcomm QUART (dragonfly) controller support"
	depends !ARM_DCC
	select ARCH_HAS_UART
	select GPIO_TLMM
	default y
	help
	  QDF2400 contains 8 Qualcomm UART controllers instantiated in BAM
	  Low-Speed Peripheral devices.

if UART_QUART

config QUART_BLSP0
	bool "QUARTs in BAM Low-Speed Peripheral (BLSP) 0"
	default y

config QUART_BLSP3
	bool "QUARTs in BAM Low-Speed Peripheral (BLSP) 3"
	select UART_PL01X
	select UART_PL01X_SBSA
	default y

choice
	prompt "UART for debug consoles"
	help
	  Select UART port used for DEBUG_PRINT and CONSOLE.

config QUART_BLSP0_0
	bool "QUART0 (I0_BLSP UART0)"
	depends QUART_BLSP0

config QUART_BLSP0_1
	bool "BLSP0 UART1"
	depends QUART_BLSP0

config QUART_BLSP0_2
	bool "BLSP0 UART2"
	depends QUART_BLSP0

config QUART_BLSP0_3
	bool "BLSP0 UART3"
	depends QUART_BLSP0

config QUART_BLSP3_0
	bool "BLSP3 UART0"
	depends QUART_BLSP3

config QUART_BLSP3_1
	bool "BLSP3 UART1"
	depends QUART_BLSP3

config QUART_BLSP3_2
	bool "BLSP3 UART2"
	depends QUART_BLSP3

config QUART_BLSP3_3
	bool "BLSP3 UART3"
	depends QUART_BLSP3

endchoice

config QUART_AMPLIFIED_BAUDRATE
	bool "Enable amplified baudrate mode"
	help
	  Emulators actually hook UART register reads/writes to implement
	  UART consoles, thus an amplified baudrate can help them to
	  perform faster.
	  By selecting this configuration, QUART driver will try to use
	  a clock source that have the highest frequency.

endif

endmenu

endif
```
