## appl/Kconfig
```kconfig
#
# Firmware Appliance
#

menu "Appliance types"

config LCD_EZIO
	bool "EZIO terminal (LCD/Keypad) module"
	select TERM
	select KBD
	select UART

if LCD_EZIO

config EZIO_UART_PORT
	int "Asynchronous UART port"
	range 0 9
	default 1

endif

endmenu
```

## arch/arm/Kconfig
```kconfig
#
# For a description of the syntax of this configuration file,
# see Documentation/kbuild/kconfig-language.txt.
#

mainmenu "Small Device Firmware Configuration"

config ARM
	bool
	default y
	help

source "init/Kconfig"

menu "ARM system options"

choice
	prompt "ARM system type"
	default ARCH_LM3S9B92

config ARCH_LM3S9B92
	bool "Luminary Stellaris LM3S9B92"
	select CPU_CORTEXM3
	select ARCH_IS_TICKLESS if !TICK_LM3S9B92_PERIODIC
	select ARCH_HAS_TSC
	select ARCH_HAS_IDLE
	select GPT_LM3S9B92 if TIMER
	select UART_LM3S9B92 if UART || DEBUG_PRINT || CONSOLE
	select GPIO_LM3S9B92 if GPIO
	select SSI_LM3S9B92 if SPI
	select FLASH_LM3S9B92 if MTD_FLASH
	select LED_LM3S9B92 if LED
	select USB_LM3S9B92 if USB
	select USB_LM3S9B92_DEV if USB_DEV
	select IFDS_LM3S9B92 if IFD_SERIAL
	help
	  This enables support for systems based on LM3S9B92.

config ARCH_LM3S3826
	bool "Luminary Stellaris LM3S3826"
	select CPU_CORTEXM3
	select GPT_LM3S3826 if TIMER
	select ARCH_IS_TICKLESS if !TICK_LM3S3826_PERIODIC
	select ARCH_HAS_TSC
	select ARCH_HAS_IDLE
	select GPIO_LM3S3826 if GPIO
	select GPT_LM3S3826 if TIMER
	select UART_LM3S3826 if UART || DEBUG_PRINT || CONSOLE
	select KBD_LM3S3826 if KBD
	select SSI_LM3S3826 if SPI

config ARCH_VEXPRESSA9
	bool "ARM Versatile Express for Cortex-A9"
	select CPU_CORTEXA9
	select ARCH_HAS_TSC
	select UART_VEXPRESSA9 if UART || DEBUG_PRINT || CONSOLE
	help
	  Can be found in QEMU, a combination of Motherboard Express uATX and
	  CoreTile Express A9.

endchoice

source arch/arm/common/Kconfig

menu "Compiler options"

config ARM_THUMB2
	bool "Compile the firmware in thumb mode"
	depends on CPU_32v7 || CPU_32v7M || CPU32_v6T2
	select ARM_EABI
	select ARM_ASM_UNIFIED
	help
	  By enabling this option, the kernel will be compiled in
	  thumb mode. A compiler/assembler that understand the unified
	  ARM-thumb syntax is needed.
	  If unsure, say N.

config ARM_ASM_UNIFIED
	bool

config ARM_EABI
	bool "Use the ARM EABI application binary interface"
	help
	  This option allows for the firmware to be compiled using the latest
	  ARM ABI (aka EABI).

endmenu

endmenu

source "arch/arm/mach-lm3s9b92/Kconfig"
source "arch/arm/mach-lm3s3826/Kconfig"
source "arch/arm/mach-vexpressa9/Kconfig"

source "appl/Kconfig"
source "kernel/Kconfig"
source "drivers/Kconfig"
source "lib/Kconfig"
source "init/Kconfig.debug"
```

## arch/arm/common/Kconfig
```kconfig
config ARM_TRUSTZONE
	bool
	depends on CPU_32v6KZ || CPU_32v7
	help

choice
	prompt "Security system type (TrustZone)"
	default ARM_UNTRUSTED

config ARM_MONITOR
	bool "Secure monitor" if ARM_TRUSTZONE

config ARM_TRUSTED
	bool "Secure world system" if ARM_TRUSTZONE

config ARM_UNTRUSTED
	bool "Normal world system"

endchoice

choice
	prompt "Interrupt controller"

config GIC
	bool "Generic Interrupt Controller (GIC)"
	select ARCH_HAS_VIC
	depends on CPU_32v7
	help
	  The GIC architecture describes an interrupt controller for use with
	  one or more processors that comply with ARM A or R architecture
	  profiles.

if GIC

config GIC_IRQ_GROUPING
	bool "Interrupt grouping"
	depends on ARM_TRUSTZONE
	help
	  Interrupt grouping is present in GICv2 implementations and in GICv1
	  implementations that include the GIC security extensions.

endif

config NVIC
	bool "Nested Vectored Interrupt Controller (NVIC)"
	select ARCH_HAS_VIC
	depends on CPU_32v6T2 || CPU_32v7M
	help
	  The NVIC provides configurable interrupt handling abilities to the
	  Cortex M processors, facilitates low-latency exception and interrupt
	  handling, and controls power management.

endchoice

menu "CoreLink peripherals"

config UART_PL01X
	bool "PrimeCell UART (PL01x)"
	select ARCH_HAS_UART
	help
	  PrimeCell UART (PL010/PL011) offers similar functionality to the
	  industry-standard 16C550 UART.

endmenu

# Cortex-M3
config CPU_CORTEXM3
	bool
	select CPU_32v7M
	select NVIC
	help

# Cortex-A9
config CPU_CORTEXA9
	bool
	select CPU_32v7
	select GIC
	help

# Figure out what processor architecture version we should be using.
# This defines the compiler instruction set which depends on the machine type.
config CPU_32v4
	bool
	help
	  Includes only the ARM instruction set.

config CPU_32v4T
	bool
	help
	  Adds the Thumb instruction set.

config CPU_32v5T
	bool
	help
	  Adds CLZ and BKPT.

config CPU_32v5TE
	bool
	help
	  Adds PLD, LDRD, STRD, MCRR, MRRC, enhances DSP algorithms.

config CPU_32v5TEJ
	bool
	help
	  Adds BXJ and Jazelle architecture extension.

config CPU_32v6
	bool
	help
	  Adds many new instructions to ARM instruction set and formalizes and
	  revises the memory model and the Debug architecture.

config CPU_32v6K
	bool
	help
	  Adds multi-processing instructions and extra memory model features.

config CPU_32v6T2
	select ARM_THUMB2
	bool
	help
	  Introduces Thumb-2 technology.

config CPU_32v6KZ
	bool
	select ARM_TRUSTZONE
	help
	  ARMv6K with optional Security Extension.

config CPU_32v7
	bool
	select ARM_TRUSTZONE

config CPU_32v7M
	bool
	select ARM_THUMB2

config CPU_BIG_ENDIAN
	bool "Build big-endian kernel"
	depends on ARCH_SUPPORTS_BIG_ENDIAN
	select ARCH_IS_BIG_ENDIAN
	help
	  Say Y if you plan on running a kernel in big-endian mode.
	  Note that your board must be properly built and your board
	  port must properly enable any big-endian related features
	  of your chipset/board/processor.
```

## arch/arm/mach-lm3s3826/Kconfig
```kconfig
#
# For a description of the syntax of this configuration file,
# see scripts/kbuild/config-language.txt.
#

if ARCH_LM3S3826

menu "TI LM3S3826 board options"

choice
	prompt "System clock derivation"
	default CPU_LM3S3826_FREQ_PLL
	help
	  These choices are applied to system clock.

config CPU_LM3S3826_PLL
	bool "PLL"
	help
	  System clock derives from PLL output.

config CPU_LM3S3826_MOSC
	bool "MOSC"
#	depends !USB_LM3S3826
	help
	  System clock derives from MOSC.
	  The LM3S3826 datasheet says the USB controller could not
	  function correct when the system clock is running at a frequency
	  that is less than 20MHz.  If it is true for your board,
	  uncomment the dependancy above.

endchoice

choice
	prompt "Main oscillator frequency"
	default CPU_LM3S3826_MOSC_16M

config CPU_LM3S3826_MOSC_16M
	bool "16MHz"

endchoice

choice
	prompt "PLL divided frequency"
	depends CPU_LM3S3826_PLL
	default CPU_LM3S3826_PLL_50M
	help
	  These choices are applied to system clock.
	  Note that though the PLL frequency is 400MHz, the derivable
	  value has been divided by 2 as 200MHz.

config CPU_LM3S3826_PLL_50M
	bool "50MHz"

config CPU_LM3S3826_PLL_40M
	bool "40MHz"

config CPU_LM3S3826_PLL_25M
	bool "25MHz"

config CPU_LM3S3826_PLL_20M
	bool "20MHz"

endchoice

config TICK_LM3S3826_PERIODIC
	bool "Enable SysTick as periodic tick (HZ)"
	depends EXPERIMENTAL
	select TICK
	select TICK_PERIODIC
	select TSC_LM3S3826_GPT1
	select MATH_MUL32
	help
	  Since HZ interrupt is not non-maskable, this may not be the best
	  choice for the timing implementation.

config TSC_LM3S3826_GPT1
	bool "Enable GPT1 as 32bit TSC device"
	depends TICK_LM3S3826_PERIODIC
	help
	  This is possible if we us SysTick as HZ generator.  If this
	  configuration is not enabled, TSC will be implemented using
	  SysTick.  Thus, this option may only useful if SysTick is
	  configured as a HZ generator.

menuconfig GPIO_LM3S3826
	bool "TI LM3S3826 general purpose IO support"
	depends GPIO
	default y

if GPIO_LM3S3826

config GPIO_LM3S3826_AHB
	bool "Enable AHB access for GPIO registers"
	help
	  The GPIO modules may be accessed via two different memory
	  apertures. The legacy aperture APB (Advanced Peripheral Bus) is
	  backwards-compatible with previous Stellaris parts.
	  The other aperture AHB (Advanced High-Performance Bus), offers
	  the same register map but provides better back-to-back access
	  performance than the APB bus. These apertures are mutually
	  exclusive.
	  The aperture enabled for a given GPIO port is controlled by the
	  appropriate bit in the GPIOHBCTL register.

endif

menuconfig KBD_LM3S3826
	bool "TI LM3S3826 keyboard controller support"
	depends GPIO
	depends KBD
	default n
	help
	  This driver can only support four independent keyboard, when the
	  button is pressed, it be pulled up to the external VCC and the
	  button is released, it be pulled down to the internal GND.

if KBD_LM3S3826
choice
	prompt "Layout"
	default n

config KBD_LM3S3826_SINGLE_PORT
	bool "PORTA PIN7~4"
	depends !ARCH_HAS_SPI

config KBD_LM3S3826_DOUBLE_PORT
	bool "PORTA PIN7~6 and PORTB PIN3~2"
	depends !ARCH_HAS_I2C

endchoice

endif

menuconfig GPT_LM3S3826
	bool "TI LM3S3826 general purpose timer support"
	depends TIMER
	select ARCH_HAS_GPT
	default y

if GPT_LM3S3826

endif

menuconfig UART_LM3S3826
	bool "TI LM3S3826 UART controller support"
	select GPIO
	select ARCH_HAS_UART
	select MATH_MOD32
	select MATH_MUL32
	depends UART || DEBUG_PRINT
	default y

if UART_LM3S3826

choice
	prompt "UART1 Mux"
	default UART_LM3S3826_UART1_PD2

config UART_LM3S3826_UART1_PA0
	bool "RX=PA0 TX=PA1"

config UART_LM3S3826_UART1_PB0
	bool "RX=PB0 TX=PB1"

config UART_LM3S3826_UART1_PB4
	bool "RX=PB4 TX=PB5"

config UART_LM3S3826_UART1_PC6
	bool "RX=PC6 TX=PC7"

config UART_LM3S3826_UART1_PD0
	bool "RX=PD0 TX=PD1"

config UART_LM3S3826_UART1_PD2
	bool "RX=PD2 TX=PD3"

endchoice

choice
	prompt "UART2 Mux"
	default UART_LM3S3826_UART2_PB4

config UART_LM3S3826_UART2_PD0
	bool "RX=PD0 TX=PD1"

config UART_LM3S3826_UART2_PB4
	bool "RX=PB4 TX=PE4"

endchoice

endif

menuconfig SSI_LM3S3826
	bool "TI LM3S3826 SSI controller support"
	depends SPI
	select GPIO
	select BIT_FLS16
	select ARCH_HAS_SPI
	default y

if SSI_LM3S3826

endif

endmenu

endif
```

## arch/arm/mach-lm3s9b92/Kconfig
```kconfig
#
# For a description of the syntax of this configuration file,
# see scripts/kbuild/config-language.txt.
#

if ARCH_LM3S9B92

menu "TI LM3S9B92 board options"

choice
	prompt "Chip PINs packaging"
	default PIN_LM3S9B92_100LQFP

config PIN_LM3S9B92_100LQFP
	bool "100LQFP"

config PIN_LM3S9B92_108BGA
	bool "108BGA"

endchoice

choice
	prompt "System clock derivation"
	default CPU_LM3S9B92_FREQ_PLL
	help
	  These choices are applied to system clock.

config CPU_LM3S9B92_PLL
	bool "PLL"
	help
	  System clock derives from PLL output.

config CPU_LM3S9B92_MOSC
	bool "MOSC"
#	depends !USB_LM3S9B92
	help
	  System clock derives from MOSC.
	  The LM3S9B92 datasheet says the USB controller could not
	  function correct when the system clock is running at a frequency
	  that is less than 20MHz.  If it is true for your board,
	  uncomment the dependancy above.

endchoice

choice
	prompt "Main oscillator frequency"
	default CPU_LM3S9B92_MOSC_16M

config CPU_LM3S9B92_MOSC_16M
	bool "16MHz"

endchoice

choice
	prompt "PLL divided frequency"
	depends CPU_LM3S9B92_PLL
	default CPU_LM3S9B92_PLL_80M
	help
	  These choices are applied to system clock.
	  Note that though the PLL frequency is 400MHz, the derivable
	  value has been divided by 2 as 200MHz.

config CPU_LM3S9B92_PLL_100M
	bool "100MHz"
	help
	  The LM3S9B92 datasheet says this could not function, but the
	  evaluation board seems working well for this configuration.
	  So we leave the default value to a suggested 80MHz and please
	  don't bother if this could not work for your board.

config CPU_LM3S9B92_PLL_80M
	bool "80MHz"

config CPU_LM3S9B92_PLL_50M
	bool "50MHz"

config CPU_LM3S9B92_PLL_40M
	bool "40MHz"

config CPU_LM3S9B92_PLL_25M
	bool "25MHz"

config CPU_LM3S9B92_PLL_20M
	bool "20MHz"

endchoice

config TICK_LM3S9B92_PERIODIC
	bool "Enable SysTick as periodic tick (HZ)"
	depends EXPERIMENTAL
	select TICK
	select TICK_PERIODIC
	select TSC_LM3S9B92_GPT1
	select MATH_MUL32
	help
	  Since HZ interrupt is not non-maskable, this may not be the best
	  choice for the timing implementation.

config TSC_LM3S9B92_GPT1
	bool "Enable GPT1 as 32bit TSC device"
	depends TICK_LM3S9B92_PERIODIC
	help
	  This is possible if we us SysTick as HZ generator.  If this
	  configuration is not enabled, TSC will be implemented using
	  SysTick.  Thus, this option may only useful if SysTick is
	  configured as a HZ generator.

menuconfig GPIO_LM3S9B92
	bool "TI LM3S9B92 general purpose IO support"
	depends GPIO
	default y

if GPIO_LM3S9B92

config GPIO_LM3S9B92_AHB
	bool "Enable AHB access for GPIO registers"
	help
	  The GPIO modules may be accessed via two different memory
	  apertures. The legacy aperture APB (Advanced Peripheral Bus) is
	  backwards-compatible with previous Stellaris parts.
	  The other aperture AHB (Advanced High-Performance Bus), offers
	  the same register map but provides better back-to-back access
	  performance than the APB bus. These apertures are mutually
	  exclusive.
	  The aperture enabled for a given GPIO port is controlled by the
	  appropriate bit in the GPIOHBCTL register.

endif

menuconfig GPT_LM3S9B92
	bool "TI LM3S9B92 general purpose timer support"
	depends TIMER
	select ARCH_HAS_GPT
	default y

if GPT_LM3S9B92

endif

menuconfig UART_LM3S9B92
	bool "TI LM3S9B92 UART controller support"
	select GPIO
	select ARCH_HAS_UART
	select MATH_MOD32
	select MATH_MUL32
	depends UART
	default y

if UART_LM3S9B92

choice
	prompt "UART1 Mux"
	depends UART_ASYNC
	default UART_LM3S9B92_UART1_PD2

config UART_LM3S9B92_UART1_PA0
	bool "RX=PA0 TX=PA1"

config UART_LM3S9B92_UART1_PB0
	bool "RX=PB0 TX=PB1"

config UART_LM3S9B92_UART1_PB4
	bool "RX=PB4 TX=PB5"

config UART_LM3S9B92_UART1_PC6
	bool "RX=PC6 TX=PC7"

config UART_LM3S9B92_UART1_PD0
	bool "RX=PD0 TX=PD1"

config UART_LM3S9B92_UART1_PD2
	bool "RX=PD2 TX=PD3"

endchoice

choice
	prompt "UART2 Mux"
	depends UART_ASYNC
	default UART_LM3S9B92_UART2_PD5

config UART_LM3S9B92_UART2_PD0
	bool "RX=PD0 TX=PD1"

config UART_LM3S9B92_UART2_PD5
	bool "RX=PD5 TX=PD6"

config UART_LM3S9B92_UART2_PG0
	bool "RX=PG0 TX=PG1"

endchoice

endif

menuconfig SSI_LM3S9B92
	bool "TI LM3S9B92 SSI controller support"
	depends SPI
	select GPIO
	select BIT_FLS16
	select ARCH_HAS_SPI
	default y

if SSI_LM3S9B92

endif

menuconfig FLASH_LM3S9B92
	bool "TI LM3S9B92 on-chip flash support"
	depends MTD_FLASH
	select ARCH_HAS_FLASH
	default y

if FLASH_LM3S9B92

endif

menuconfig LED_LM3S9B92
	bool "TI LM3S9B92 LED support"
	select GPIO
	depends LED
	default y

if LED_LM3S9B92
endif

menuconfig USB_LM3S9B92
	bool "TI LM3S9B92 USB controller support"
	depends USB
	select ARCH_HAS_USB_OTG
	select ARCH_IS_USBD_ENDP_TXCMPL
	select ARCH_IS_USBD_ENDP_DUPLEX
	select ARCH_HAS_USBD_ENDP_CSO
	select GPIO
	default y

if USB_LM3S9B92

config USB_LM3S9B92_DEV
	bool "TI LM3S9B92 USB device support"
	depends USB_DEV
	default y

if USB_LM3S9B92_DEV

config USB_LM3S9B92_FIFO_DOUBLE
	bool "Enable double buffering FIFO support"
	depends EXPERIMENTAL

config USB_LM3S9B92_MAX_ISOS
	int "Number of isochronous endpoints"
	range 0 3
	default 0

endif

endif

menuconfig IFDS_LM3S9B92
	bool "TI LM3S9B92 serial smart card support"
	select ARCH_HAS_IFDS
	select GPIO
	depends IFD_SERIAL
	default y

if IFDS_LM3S9B92

endif

endmenu

endif
```

## arch/arm/mach-vexpressa9/Kconfig
```kconfig
#
# For a description of the syntax of this configuration file,
# see scripts/kbuild/config-language.txt.
#

if ARCH_VEXPRESSA9

menu "Versatile express for Cortex-A9 board options"

config UART_VEXPRESSA9
	bool "ARM Versatile express A9 UART controller support"
	select UART_PL01X
	depends UART || DEBUG_PRINT
	default y
	help
	  PrimeCell (PL011) UART.

if UART_VEXPRESSA9

endif

endmenu

endif
```
