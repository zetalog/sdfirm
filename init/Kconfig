## kernel/uart/Kconfig
```kconfig
#
# UART Devices
#

config ARCH_HAS_UART
	bool

menuconfig UART
	bool "Universal asynchronous RX/TX (UART) support"

if UART

config UART_SYNC
	bool "Synchronous UART support"
	default y

if UART_SYNC

choice
	prompt "UART baud rate"
	help
	  This setting lets you define what baudrate is for the serial
	  port.

config UART_230400
	bool "230400"

config UART_115200
	bool "115200"

config UART_57600
	bool "57600"

config UART_38400
	bool "38400"

config UART_19200
	bool "19200"

config UART_9600
	bool "9600"

config UART_4800
	bool "4800"

config UART_2400
	bool "2400"

endchoice

endif

config UART_ASYNC
	bool "Asynchronous UART support"
	select BULK

if UART_ASYNC

config UART_MAX_PORTS
	int "Maximum UART ports"
	range 1 10

endif

endif
```

## kernel/uefi/Kconfig
```kconfig
#
# UEFI Firmware
#

menuconfig UEFI
	bool "Unified extensible firmware interface (UEFI) support"

if UEFI

config UEFI_DXE
	bool "UEFI driver execution environment (DXE) support"
	select CRC32

config UEFI_GPT
	bool "UEFI GUID partition table (GPT) support"
	select MTD

config UEFI_GPT_DEBUG
	bool "Enable UEFI debugging message"
	select STRING_HEXDUMP if CONSOLE_OUTPUT

endif
```
