## init/Kconfig
```kconfig
#
# For a description of the syntax of this configuration file,
# see scripts/kbuild/config-language.txt.
#

menu 'Generic setup'

config VENDOR_NAME
	string "Device vendor name"
	default "Soliton (Shanghai)"

config PRODUCT_NAME
	string "Device product name"
	default "Soliton Small Device"

config VENDOR_ID
	int "Device vendor identifier"
	range 0 65535
	default 990

config PRODUCT_ID
	int "Device product identifier"
	range 0 255
	default 0

config SERIAL_NO
	int "Device serial number"
	range 0 65535
	default 0

choice
	prompt "System types"

config BOOTLOADER
	bool "Bootloader"
	select SYS_NOIRQ
	help
	  Allow dynamic allocations. IRQ is disabled. Not a runtime system.
	  Disallow booting from memory.

config FIRMWARE
	bool "Device firmware"
	select SYS_IRQ
	select ARCH_HAS_BOOT_LOAD
	select CONSOLE_VERBOSE if CONSOLE_OUTPUT
	help
	  Disallow dynamic allocation. IRQ is enabled. A runtime system.
	  Allow booting from memory.

config EMBEDDED
	bool "Embedded system"
	select SYS_IRQ
	select ARCH_HAS_BOOT_LOAD
	help
	  Allow dynamic allocations. IRQ is enabled. A runtime system.
	  Allow booting from memory.

endchoice

if BOOTLOADER

menu "Bootloader options"

config BOOT_LINUX
	bool "Linux boot protocol"
	select CONSOLE

config BOOT_ROM
	bool "Silicon boot ROM"

endmenu

endif

if FIRMWARE

menu "Firmware options"

source init/gem5/Kconfig
source init/ris/Kconfig

endmenu

endif

menuconfig COMMAND
	bool "Enable command line support"
	select STRING_STRTOUL
	select STRING_STRTOULL

config COMMAND_BATCH
	bool "Enable batch command support"
	depends COMMAND

config COMMAND_BATCH_COMMAND
	string "Batch commands"
	depends COMMAND_BATCH

config ARCH_HAS_CONSOLE_EARLY
	bool

menuconfig CONSOLE
	bool "Enable console on (possibly) UART0"
	select PRINT_PRINTF

if CONSOLE

menuconfig CONSOLE_COMMAND
	bool "Enable console command line support"
	select CONSOLE_INPUT
	select COMMAND

config CONSOLE_OUTPUT
	bool "Enable console output"

config CONSOLE_OUTPUT_CR
	bool "Append CR before LN"
	depends CONSOLE_OUTPUT

config CONSOLE_PRINT_BUFFER_SIZE
	int "Configure console print buffer size"
	default 64
	range 32 1024

config CONSOLE_INPUT
	bool "Enable console input"

choice
	prompt "Console UART baud rate"
	default CONSOLE_115200
	help
	  This setting lets you define what baudrate is for the serial
	  port.

config CONSOLE_230400
	bool "230400"

config CONSOLE_115200
	bool "115200"

config CONSOLE_76800
	bool "76800"

config CONSOLE_57600
	bool "57600"

config CONSOLE_38400
	bool "38400"

config CONSOLE_19200
	bool "19200"

config CONSOLE_9600
	bool "9600"

config CONSOLE_4800
	bool "4800"

config CONSOLE_2400
	bool "2400"

endchoice

config CONSOLE_VERBOSE
	bool "Enable console logging messages"

config CONSOLE_DEBUG
	bool "Enable console debugging messages"
	select CONSOLE_VERBOSE
	depends EXPERIMENTAL

config CONSOLE_BANNER
	bool "Enable sdfirm boot banner"

config CONSOLE_DEBUG_BOOT
	bool "Enable boot debug sequence 0x55"
	depends EXPERIMENTAL

endif

endmenu
```

## init/Kconfig.debug
```kconfig
#
# For a description of the syntax of this configuration file,
# see scripts/kbuild/config-language.txt.
#

menu 'Development options'

config EXPERIMENTAL
	bool "Prompt for development"
	help
	  Some of the various things that SDFirm supports can be in a state
	  of development where the functionality, stability, or the level of
	  testing is not yet high enough for general use. This is usually
	  known as the "alpha-test" phase among developers. If a feature is
	  currently in alpha-test, then the developers usually discourage
	  uninformed widespread use of this feature by the general public to
	  avoid "Why doesn't this work?" type mail messages. However, active
	  testing and use of these systems is welcomed. Just be aware that it
	  may not meet the normal level of reliability or it may fail to work
	  in some special cases. Detailed bug reports from people familiar
	  with the kernel internals are usually welcomed by the developers
	  This option will also make obsoleted drivers available. These are
	  drivers that have been replaced by something else, and/or are
	  scheduled to be removed in a future kernel release.
	  Unless you intend to help test and develop a feature or driver that
	  falls into this category, or you have a situation that requires
	  using these features, you should probably say N here, which will
	  cause the configurator to present you with fewer choices. If
	  you say Y here, you will be offered the choice of using features or
	  drivers that are currently considered to be in the alpha-test phase.

config CC_OPT_SIZE
	bool "Optimize for size"
	default y
	help
	  Enabling this option will pass size optimization option
	  instead of speed optimization option to the compilers,
	  resulting in a smaller kernel.
	  If unsure, say N.

config CC_OPT_SPEED
	bool "Optimize for speed"
	# ARM64 LR/SC implementation requires O2
	# depends !DHRYSTONE_GROUND_RULES
	help
	  Enabling this option will pass speed optimization option
	  instead of size optimization option to the compilers,
	  resulting in a speedy kernel.
	  If unsure, sayn N.

config CC_ALWAYS_INLINE
	bool "Use always inline"
	help
	  Switch inline implementation to __always_inline rather than
	  inline.

menu "Simulation options"

menuconfig SIMULATION
	bool "Prompt for simulation"

if SIMULATION

endif

config VERILOG_DATA_WIDTH
	int "Verilog data width"
	default 32 if ARCH_HAS_BITS_PER_UNIT_32
	default 64 if ARCH_HAS_BITS_PER_UNIT_64

endmenu

menuconfig DEBUG
	bool 'Debugging options'
	depends EXPERIMENTAL

if DEBUG

config CC_GEN_DEBUG
	bool "Compile with debug info"
	help
	  Say Y here if you wish to examine internals while applets are
	  running.  This increases the size of the binary considerably, and
	  should only be used when doing development.  If you are doing
	  development and want to debug, answer Y.
	  Most people should answer N.

config DEBUG_PANIC
	bool "Enable debug panic output"
	depends DEBUG_PRINT || CONSOLE_OUTPUT
	select PANIC_DEBUG if DEBUG_PRINT

menuconfig DEBUG_PRINT
	bool "Enable debug messages on UART0"
	depends !CONSOLE

if DEBUG_PRINT

choice
	prompt "Debug UART baud rate"
	help
	  This setting lets you define what baudrate is for the serial
	  port.

config DEBUG_230400
	bool "230400"

config DEBUG_115200
	bool "115200"

config DEBUG_57600
	bool "57600"

config DEBUG_38400
	bool "38400"

config DEBUG_19200
	bool "19200"

config DEBUG_9600
	bool "9600"

config DEBUG_4800
	bool "4800"

config DEBUG_2400
	bool "2400"

endchoice

config PANIC_DEBUG
	bool "Panic debug message support"

config IDLE_DEBUG
	bool "Task/timer debug message support"

config IO_DEBUG
	bool "Input/output debug message support"
	depends KBD

config BULK_DEBUG
	bool "Bulk IO debug message support"
	depends BULK

config USB_DEBUG
	bool "USB debug message support"
	depends USB

config USB_DEBUG_CALL
	bool "USB callback debug messages support"
	depends USB_DEBUG

config UART_DEBUG
	bool "UART debug message support"
	depends UART

config HID_DEBUG
	bool "HID debug message support"
	depends USB_HID

config SCD_DEBUG
	bool "SCD debug message support"
	depends USB_SCD

config SCS_DEBUG
	bool "Smart card debug message support"
	depends SCS
	select BIT_FFS16

config MSD_DEBUG
	bool "Mass storage device debug message support"
	depends USB_MSD

config DFU_DEBUG
	bool "Device firmware update debug message support"
	depends USB_DFU

config PN53X_DEBUG
	bool "PN53x device debug message support"
	depends PN53X

config EZIO_DEBUG
	bool "EZIO lcd debug message support"
	depends LCD_EZIO

endif

endif

endmenu
```

## init/gem5/Kconfig
```kconfig
config GEM5
	bool "Run embedded GEM5 SimPoint slice support"

if GEM5

config GEM5_STATIC_PAGES
	bool "Use static pages in data section"

config GEM5_SKIP_SET_PGT
	bool "Do not set page table to zero in initialization"

config GEM5_NOT_RESTORE_MEM
	bool "Do not restore memory data for Simpoint slice"

endif
```

## init/ris/Kconfig
```kconfig
config RIS
	bool "Random instruction sequence (RIS) support"

if RIS

config RIS_TEMPLATE
	string "RIS source template path"
	default "demo.ris"

endif
```
