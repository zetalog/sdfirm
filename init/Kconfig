## kernel/Kconfig
```kconfig
#
# Firmware Features
#

menu "Feature setup"

menu "Generic kernel features"

choice
	prompt "Scheduling model"
	default SYS_IRQ

config SYS_NOIRQ
	bool "Polling IRQs in BH"
	help
	  No hardware interrupt handlers will be registered, all hardware
	  events are examined through polling.
	  This is a suitable architecture for those bootloaders that would
	  use an unsafe different interrupt vectors from the loaded
	  firmware.

config SYS_IRQ
	bool "IRQ interrupted BH"
	help
	  Hardware interrupt handlers will be registered, while some
	  hardware events will still be implemented in synchronous way.
	  This is a suitable architecture for those firmwares that would
	  expect faster process of interrupts and the firmware itself
	  does not require high resolution realtime responsiveness.

config SYS_RT
	bool "Polling periheral IRQs in BH, allowing timer IRQs"
	help
	  No hardware interrupt handlers will be registered besides the
	  GPT interrupts.  Other hardware events will be implemented
	  through polling.
	  This is a suitable architecture for those firmwares that would
	  expect critical realtime responsiveness.

config SYS_TASK
	bool "Multiple tasking with various IRQs"
	select TASK
	depends EXPERIMENTAL
	depends !SMP
	help
	  Same as "Polling states with various IRQs", but multi-tasking is
	  added instead of timer-driven state machines.
	  This architecture requires larger memory consumption but could
	  offer better software realtime responsiveness than the
	  "Polling states with various IRQs" architecture.

endchoice

config ARCH_HAS_NOVEC
	bool

config ARCH_HAS_LOVEC
	bool

config ARCH_HAS_HIVEC
	bool

config ARCH_HAS_VIC
	bool

config ARCH_HAS_IRQC
	bool

config ARCH_HAS_IRQC_ACK
	bool

config ARCH_HAS_IRQC_MASK
	bool
	depends !ARCH_HAS_IRQC_ACK

config ARCH_HAS_GPT
	bool

config ARCH_HAS_TSC
	bool

config ARCH_HAS_TSC_CONST
	bool

config ARCH_HAS_WDT
	bool

config ARCH_IS_TICKLESS
	bool

config ARCH_HAS_IDLE
	bool

config ARCH_HAS_BOOT_LOAD
	bool
	select XIP

config ARCH_IS_BIG_ENDIAN
	bool

menu "Scheduling facility (irq) support"
	depends !SYS_NOIRQ

config MAX_VECTORS
	int "Num of vectors (1~255)"
	range 1 255
	depends !CC_ISR_VECTOR && !ARCH_HAS_VIC
	default 4
	help
	  Vector handlers consumes RAM memories when ISR entries are
	  implemented by the firmware rather than the compiler.  Setting
	  maximum vector number the software currently is using can reduce
	  memory consumption.

endmenu

menu "Scheduling facility (bh) support"

config MAX_BHS
	int "Num of bottom halves (1~8)"
	range 1 8
	default 4
	help
	  State machines may register bottom halves for tasks.  Since
	  state machines can be disabled, you can also reduce number of
	  bottom halves here to save memory usage.
	  Following bottom halves may be required:
	  timer
	  bulk
	  task
	  And the followings may be deleted in the future:
	  ifd
	  keyboard
	  acr122
	  If you are not sure, say 6 here.

endmenu

config ARCH_HAS_THREAD
	bool

menuconfig TASK
	bool "Scheduling facility (task) support"
	depends EXPERIMENTAL
	depends SYS_TASK
	select PAGE

if TASK

config MAX_TASKS
	int "Num of schedulable tasks (1~8)"
	range 1 8
	default 4

config TASK_TEST
	bool "Enable task self test"

if TASK_TEST

endif

endif

menu "Scheduling facility (SMP) support"

config ARCH_HAS_SMP
	bool

config ARCH_HAS_SMP_BOOT
	bool

config ARCH_HAS_SMP_BOOT_QUIRK_INIT_WAIT_ENTRY
	bool

menuconfig SMP_BOOT
	bool "Enable SMP bootloader support"
	depends ARCH_HAS_SMP_BOOT

if SMP_BOOT

config SMP_BOOT_QUIRK_INIT_WAIT_ENTRY
	bool "Enable quirk to initialize wait entry"
	depends ARCH_HAS_SMP_BOOT_QUIRK_INIT_WAIT_ENTRY

endif

menuconfig SMP
	bool "Enable SMP kernel support"
	depends ARCH_HAS_SMP
	select PAGE
	select SMP_BOOT if ARCH_HAS_SMP_BOOT

if SMP

config ARCH_HAS_QSPINLOCK
	bool

config SMP_WAIT_BOOT
	bool "Enable wait for SMP bring-up"

endif

endmenu

menu "Scheduling facility (MSI) support"

config ARCH_HAS_MSI
	bool

menuconfig MSI
	bool "Enable per-cpu MSI support"
	depends ARCH_HAS_MSI
	select BIT_FIND_CLEAR

if MSI

endif

endmenu

menu "Timing facility (jiffy) support"

config TICKLESS
	bool
	default y if !TICK
	select MATH_DIV32

config TICK
	bool "Enable tick device support"
	depends !ARCH_IS_TICKLESS
	depends !SYS_NOIRQ
	default y
	help
	  A "jiffies" variable will get compiled into the firmware and
	  the firmware may get interrupted by a jiffies counting tick
	  device hardware.

config TICK_PERIODIC
	bool "Enable periodic tick device support"
	depends TICK
	help
	  A platform that supports the periodic tick device is a platform
	  that owns a non IRQ maskable device interrupted per 1/HZ
	  seconds.
	  If the platform does not have a periodic tick device, a hardware
	  timestamp counter (TSC) device may be used to calibrate the
	  jiffies value.

endmenu

menu "Timing facility (delay) support"

config LPS_NO_LPS
	bool "Use constant TSC instead of calibrated loops/jiffy"
	depends ARCH_HAS_TSC_CONST && !TICK

if !LPS_NO_LPS

config LPS_64BITS
	bool "Enable 64 bit loops/jiffy support"
	select MATH_MUL64
	select MATH_DIV64

config LPS_32BITS
	bool "Enable 32 bit loops/jiffy support"
	depends !LPS_64BITS
	select MATH_MUL32
	select MATH_DIV32

config LPS_WEIGHT
	int "Initail loops/jiffy weight"
	default 8
	range 0 15 if (!LPS_32BITS && !LPS_64BITS)
	range 0 31 if LPS_32BITS
	range 0 64 if LPS_64BITS
	help
	  Correct initial LPS weight can help firmware to boot faster.
	  Incorrect initial LPS weight may result in calibrate delay
	  failure.
	  If calibrate delay always get failed on initial LPS weight 0, it
	  is suggested that the system should choose a counter with
	  greater bit width.
	  Initial LPS weight should be chosen carefully according to the
	  current running CPU frequency. 

config LPS_PRESET
	bool "Enabled preset loops/jiffy support"

config LPS_PRESET_MS
	int "Preset loops/ms value"
	depends LPS_PRESET
	range 1 65535 if !LPS_32BITS
	range 1 4294967296 if LPS_32BITS

endif

endmenu

menuconfig TIMER
	bool "Timing facility (timer) support"
	default y
	select TIMER_ONESHOT if !TICK
	select BIT_FIND_CLEAR

if TIMER

config TIMER_31BIT
	bool "Enable 31-bit timeout value"
	help
	  tick_t is 32-bit, so timeout_t can be 31-bit (stored as a signed
	  32-bit value).

config TIMER_16BIT
	bool "Enable 16-bit timeout value"
	depends !TIMER_31BIT

config TIMER_ONESHOT
	bool "Enable onshot timer interrupt"
	depends !TICK

config MAX_TIMERS
	int "Num of timers (1~16)"
	range 1 16
	default 1
	help
	  State machines may register timers for delayed works.  Since
	  state machines can be disabled, you can also reduce number of
	  timers here to save memory usage.
	  Following state machines require timers:
	  usb (USB)
	  scs (IFD_PRES_POLL)
	  So if you are not sure, say 1 here.

config TIMER_TEST
	bool "Enable timer self test"

if TIMER_TEST

config TIMER_TEST_TIMEOUT
	bool "Enable timer timeout test"

config TIMER_TEST_MAX_SHOTS
	int "Maximum test shots"
	depends TIMER_TEST_TIMEOUT
	default -1

config TIMER_TEST_SHOT_PERIOD
	int "Period of each shot"
	range 2 128
	default 2

config TIMER_TEST_SHUTDOWN
	bool "Enable shutdown after test"

endif

endif

menu "Address space layout (xip) support"

config BFM
	bool "Enable Boot From Memory (BFM) support"
	depends ARCH_HAS_BOOT_LOAD
	select XIP

config XIP
	bool "Enable eXecute In Place (XIP) support"

config BOOT_BASE
	hex "Boot address of the firmware"
	default 0
	help
	  The boot address of the firmware.
	  In an XIP firmware, this equls to the load address of the .text
	  section, and hence can be used in the linker script to determine
	  the start address of the .text section. Note that this address
	  can also be used to indicate the boot address of the .data
	  section in the XIP firmware, sdfirm will self-loading .data
	  section by copying data from this address + sizeof(.text) to the
	  load address of the .data section.
	  While in a non-XIP firmware, sdfirm will self-loading .text/.data
	  section by copying data from this address to the load address of
	  the .text/.data section.

config LOAD_BASE
	hex "Load address of the firmware"
	default 0
	help
	  The load address of the firmware.
	  In an XIP firmware, this equals to the load address of the .data
	  section, sdfirm will self-loading .data section by copying data
	  from the boot address + sizeof(.text) to this address.
	  While in a non-XIP firmware, sdfirm will self-loading .text/.data
	  section by copying data from the boot address of .text/.data
	  section to this address.

config LOAD_TEXT
	bool "Copy .text sections from boot address to load address"
	depends !XIP && !ARCH_HAS_BOOT_LOAD
	default y
	help
	  For non-XIP firmware, programmer may have already loaded the
	  .text sections to the RAM due to their load addresses are RAM
	  addresses. For XIP firmware, no need to load .text sections.
	  In this case, sdfirm shouldn't copy .text sections to itself
	  by disabling this option.

config LOAD_DATA
	bool "Copy .data sections from boot address to load address"
	default y
	depends !ARCH_HAS_BOOT_LOAD
	help
	  Programmer may have already loaded the .data sections to the RAM
	  due to their load addresses are RAM addresses, and hence there
	  should be no .data sections flashed in the ROM. In this case,
	  sdfirm shouldn't copy .data sections to itself by disabling this
	  option.

config NO_ZERO_BSS
	bool "Disable .bss section zeroing"
	depends EXPERIMENTAL
	help
	  On simulation environment, .bss zeroing can be skipped as the
	  memory target model itself may have already been zeroed.

config NO_ZERO_GPR
	bool "Disable GPR zeroing"
	depends EXPERIMENTAL
	help
	  On simulation environment, GPR zeroing can be skipped as the
	  register memory model itself may have already been zeroed.

endmenu

menu "Address space allocator (stack) support"

config STACK_CUST
	bool "Enable customized percpu stack size"
	help
	  By default percpu stack size is 1 page (4KB). It can be
	  customized using this option.

config STACK_SHIFT
	int "Percpu stack shift"
	range 4 16
	depends STACK_CUST
	default 12

endmenu

config ARCH_HAS_HEAP
	bool

menuconfig HEAP
	bool "Address space allocator (heap) support"
	select HEAP_PAGE if !ARCH_HAS_HEAP
	help
	  Heap will start aligned from data/bss end.

if HEAP

config HEAP_PAGE
	bool "Use page allocator to prepare heap region"
	depends !ARCH_HAS_HEAP
	depends PAGE

choice
	prompt "Heap start address alignment"
	default HEAP_ALIGN_4 if 32BIT
	default HEAP_ALIGN_8 if 64BIT

config HEAP_ALIGN_1
	bool "1"

config HEAP_ALIGN_2
	bool "2"

config HEAP_ALIGN_4
	bool "4"

config HEAP_ALIGN_8
	bool "8"

endchoice

config HEAP_SIZE
	hex "Total heap allocable size"
	range 0x100 0x20000000
	default 0x100

choice
	prompt "Allocator selection"
	default HEAP_DLMALLOC

config HEAP_DLMALLOC
	bool "Doug Lea malloc"

endchoice

config ALLOC_TRIM
	bool "Enable heap trim support"
	depends HEAP_DLMALLOC

config ALLOC_CHECK
	bool "Enable allocation check support"
	depends HEAP_DLMALLOC

endif

menuconfig MEM
	bool "Address space allocator (bootmem) support"
	select STRING_STRTOUL
	select STRING_STRTOULL

if MEM

config MEM_MAX_REGIONS
	int "Maximum region banks"
	default 3

config MEM_RESIZE
	bool "Enable resizable memory region array support"

config MEM_HEAP
	bool "Use heap allocator instead of memory allocator"
	depends ARCH_HAS_HEAP
	depends !PAGE
	select HEAP
	help
	  For embedded systems, use simple heap allocator would surfice.
	  In this case, memory resource allocator can also be
	  implemented via heap allocator interface.
	  If unsure, say 'N'.

endif

menuconfig PAGE
	bool "Address space allocator (page) support"
	select MEM
	select MMU_MAP_MEM if MMU

if PAGE

endif

config ARCH_HAS_MMU
	bool

config ARCH_HAS_MMU_4K
	bool

config ARCH_HAS_MMU_16K
	bool

config ARCH_HAS_MMU_64K
	bool

config ARCH_HAS_MMU_4M
	bool

config ARCH_HAS_MMU_1L
	bool

config ARCH_HAS_MMU_2L
	bool

config ARCH_HAS_MMU_3L
	bool

config ARCH_HAS_MMU_4L
	bool

config ARCH_HAS_MMU_5L
	bool

config ARCH_HAS_MMU_CONT
	bool

config ARCH_HAS_MMU_HUGE
	bool

config ARCH_HAS_MMU_BARRIER
	bool

menuconfig MMU
	bool "Address space layout (paging) support"
	depends ARCH_HAS_MMU
	select MEM

if MMU

choice
	prompt "Page size"

config MMU_4K_PAGE
	bool "4K size"
	depends ARCH_HAS_MMU_4K

config MMU_16K_PAGE
	bool "16K size"
	depends ARCH_HAS_MMU_16K

config MMU_64K_PAGE
	bool "64K size"
	depends ARCH_HAS_MMU_64K

config MMU_4M_PAGE
	bool "4M size"
	depends ARCH_HAS_MMU_4M

endchoice

choice
	prompt "Page table levels"

config MMU_1L_TABLE
	bool "1 level"
	depends ARCH_HAS_MMU_1L

config MMU_2L_TABLE
	bool "2 levels"
	depends ARCH_HAS_MMU_2L

config MMU_3L_TABLE
	bool "3 levels"
	depends ARCH_HAS_MMU_3L

config MMU_4L_TABLE
	bool "4 levels"
	depends ARCH_HAS_MMU_4L

config MMU_5L_TABLE
	bool "5 levels"
	depends ARCH_HAS_MMU_5L

endchoice

config MMU_PAGE_OFFSET
	bool "Enable kernel offset support"
	depends !BOOTLOADER

config MMU_IDMAP
	bool "Enable identity mapping"
	default y
	help
	  Enable this allows kernel to use identity mapping to switch page
	  tables, the behavior is close to Linux kernel. However firmware
	  can choose to disable identity mapping so that there is only one
	  mapping directory linked in, thus save memory consumption.
	  If unsure, say 'Y'.

config MMU_IDMAP_DEVICE
	bool "Enable early device identity mapping"
	depends EXPERIMENTAL
	help
	  If there is a board specific definition of IDMAP_DEV_BASE, create
	  mappings for it in the boot page table. This is normally useful
	  for enabling very early consoles (earlier before the readiness of
	  the fixmap mechanism which requires the readiness of the early
	  memory resource allocator, so it is only useful for debugging the
	  memory resource allocator and the fixmap machanisms).
	  If unsure, say 'N'.

config MMU_MAP_MEM
	bool "Map memories"

config MMU_TEXT_MODIFY
	bool "Enable .text modification"
	help
	  This option is only prepared for SELF modification tests.
	  If unsure, say 'N'.

config MMU_NO_EARLY_TABLE_ZEROING
	bool "Skip early page table zeroing"
	help
	  In simulation environment, the simulated memory may have alreadyi
	  been initialized to zero, so we can skip early page table zeroing
	  to accelerate the simulation.
	  If unsure, say 'N'.

config MMU_DEBUG_TABLE
	bool "Debugging table entry population"
	depends CONSOLE_DEBUG

endif

config ARCH_HAS_DMAC
	bool

menuconfig DMA
	bool "Address space layout (DMA) support"
	select PAGE

if DMA

config MAX_CHANNELS
	int "Num of channels (1~255)"
	range 1 255
	default 4
	help
	  Channel handlers consumes RAM memories when DMA entries are
	  implemented by the firmware rather than the compiler.  Setting
	  maximum channel number the software currently is using can reduce
	  memory consumption.

endif

menuconfig MBOX
	bool "Address space layout (MBOX) support"

if MBOX

config MAX_MAILBOXES
	int "Num of mailboxes (1-255)"
	range 1 255
	default 4

endif

config ARCH_HAS_FP
	bool

menuconfig FP
	bool "Arithmetic facility (float) support"
	depends ARCH_HAS_FP
	select PRINT_FP if PRINT_VSNPRINTF

menu "Power management model (board) support"

config FINISH
	bool "Board exit with test result"
	depends SIMULATION

config SHUTDOWN
	bool "Board shutdown support"

config REBOOT
	bool "Board reboot support"

menuconfig SUSPEND
	bool "Board suspend/resume support"

if SUSPEND

endif

menuconfig HIBERNATE
	bool "Board hibernate/resume support"

if HIBERNATE

endif

endmenu

menuconfig IDLE
	bool "Power management model (idle) support"
	depends on ARCH_HAS_IDLE

if IDLE

endif

menuconfig BULK
	bool "IO data flow model (bulk) support"
	select BIT_FLS16
	select BIT_FIND_CLEAR
	select TIMER

if BULK

config BULK_MAX_CHANS
	int "Number of bulk channels"
	range 1 255
	default 1

endif

menuconfig TERM
	bool "IO data flow model (term) support"

if TERM

config TERM_MAX_CONS
	int "Number of terminal consoles"
	range 1 255

config TERM_WIDTH
	int "Characters per row"
	range 8 80
	default 80

config TERM_HEIGHT
	int "Characters per column"
	range 2 24
	default 24

endif

endmenu

config ARCH_HAS_GPIO
	bool

menuconfig GPIO
	bool "General purpose Input/Output (GPIO) support"

if GPIO

config GPIO_COMMANDS
	bool "Enable GPIO command line support"

endif

config ARCH_HAS_CLK
	bool

menuconfig CLK
	bool "Clock tree framework support"
	select STRING_STRTOUL
	select CLK_MNEMONICS if CONSOLE_COMMAND

if CLK

config CLK_MAX_DRIVERS
	int "Maximum clock drivers"
	range 1 10

config CLK_MNEMONICS
	bool "Enable verbose clock names"

endif

config ARCH_HAS_CLK_GENERIC
	bool

menuconfig CLK_GENERIC
	bool "General clock layer support"
	depends ARCH_HAS_CLK_GENERIC
	depends !CLK

source kernel/io/Kconfig
source kernel/uart/Kconfig
source kernel/spi/Kconfig
source kernel/i2c/Kconfig
source kernel/i3c/Kconfig
source kernel/usb/Kconfig
source kernel/scs/Kconfig
source kernel/mtd/Kconfig
source kernel/scsi/Kconfig
source kernel/net/Kconfig
source kernel/video/Kconfig
source kernel/mmc/Kconfig
source kernel/ddr/Kconfig
source kernel/pci/Kconfig
source kernel/rio/Kconfig
source kernel/iommu/Kconfig
source kernel/fdt/Kconfig
source kernel/uefi/Kconfig
source kernel/ipmi/Kconfig

config ARCH_HAS_ETH
	bool

config ARCH_HAS_RAS
	bool

config RAS
	bool "Reliability availability serviceability (RAS) support"

config ARCH_HAS_PMU
	bool

config ARCH_HAS_PERF_EVENT_64BIT
	bool

config ARCH_HAS_PERF_EVENT_32BIT
	bool

menuconfig PERF
	bool "Performance counting (perf) support"

if PERF

config PERF_MAX_PMUS
	int "Maximum performance counter units"
	default 1

endif

menuconfig WDT
	bool "General watchdog support"

endmenu
```
