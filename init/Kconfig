## kernel/acpi/Kconfig
```kconfig
#
# ACPI Firmware Interfaces
#

config ARCH_HAS_ACPI
	bool

config ARCH_HAS_ACPI_PM_EVENT
	bool
	depends !ACPI_HW_REDUCED

config ARCH_HAS_ACPI_PM_TIMER
	bool
	depends !ACPI_HW_REDUCED

config ARCH_HAS_ACPI_GPE
	bool
	depends !ACPI_HW_REDUCED

menuconfig ACPI
	bool "Advanced Configuration Power Management Interface (ACPI) support"

if ACPI

config ACPI_HW_REDUCED
	bool "Enable hardware reduced ACPI support"
	default y if ARM

config ACPI_PM_EVENT
	bool "Enable power management (PM) fixed event support"
	depends ARCH_HAS_ACPI_PM_EVENT
	default y if !ACPI_HW_REDUCED

config ACPI_PM_TIMER
	bool "Enable power management (PM) timer support"
	depends ARCH_HAS_ACPI_PM_TIMER
	default y if !ACPI_HW_REDUCED

config ACPI_GPE
	bool "Enable generic purpose event (GPE) support"
	depends ARCH_HAS_ACPI_GPE
	default y if !ACPI_HW_REDUCED

config ACPI_AML
	bool "Enable ACPI machine languate (AML) interpreter support"
	default y

if ACPI_AML

config ACPI_AML_PREFIX_SIMPLE
	bool "Allow AML_NONE ByteConst/WordConst/DwordConst/QwordConst/String encoding"
	help
	  The ComputationalData opcode argument will be parsed along with
	  the creations of the opcode.  Which means following encodings:
	    ByteData
	    WordData
	    DwordData
	    QwordData
	    AsciiCharList NullChar
	  will be defined as:
	    Nothing
	  And the content will be parsed along with the prefix.

	  If unsure, say "N" here.

endif

endif
```

## kernel/ddr/Kconfig
```kconfig
#
# DDR Devices
#

config ARCH_HAS_DDR
	bool

menuconfig DDR
	bool "Double data rate (DDR) support"
	select BIT_FLS8

if DDR

config DDR_MAX_CHANNELS
	int "Number of channels (1~255)"
	range 1 255
	default 2
	help
	  Channel controls single or multiple modules.

config DDR_MAX_MODULES
	int "Number of modules (1~255)"
	range 1 255
	default 4
	help
	  Module is comprised of multiple ranks with single capacity.
	  Setting maximum module number the software currently is using
	  can reduce firmware memory consumption.

choice
	prompt "Custom default SPD"
	default DDR_SPD_3200
	help
	  The DDR core use maximum supported SPD as default SPD. However
	  users may select an alternative custom value instead of the
	  maximum data rate.

config DDR_SPD_3200
	bool "3200"

config DDR_SPD_2933
	bool "2933"

config DDR_SPD_2666
	bool "2666"

config DDR_SPD_2400
	bool "2400"

config DDR_SPD_2133
	bool "2133"

config DDR_SPD_1866
	bool "1866"

config DDR_SPD_1600
	bool "1600"

config DDR_SPD_1333
	bool "1333"

config DDR_SPD_1066
	bool "1066"

config DDR_SPD_800
	bool "800"

config DDR_SPD_667
	bool "667"

config DDR_SPD_533
	bool "533"

config DDR_SPD_400
	bool "400"

config DDR_SPD_266
	bool "266"

config DDR_SPD_200
	bool "200"

endchoice

config ARCH_HAS_DDR_SPD
	bool

config DDR_SPD
	bool "Enable serial presence detect (SPD) eeprom support"
	depends ARCH_HAS_DDR_SPD
	select I2C
	select I2C_MASTER

config DDR_TS
	bool "Enable thermal sensor support"

config DDR3
	bool "Enable DDR3 support"

config DDR4
	bool "Enable DDR4 support"
	select SPD_EE1004 if (DDR_SPD && !DDR_TS)
	#select SPD_TS2004AV if (DDR_SPD && DDR_TS)

if DDR4

menu "DDR4 Options"

config DDR4_FGR
	bool "Enable Fine Granularity Refresh (FGR)"

config DDR4_TCR
	bool "Enable Temperature Controlled Refresh (TCR)"

endmenu

endif

endif
```

## kernel/dma/Kconfig
```kconfig
#
# DMA Devices
#

config ARCH_HAS_DMAC
	bool

menuconfig DMA
	bool "Direct memory access (DMA) support"

if DMA

endif
```

## kernel/fdt/Kconfig
```kconfig
#
# FDT Firmware
#

config ARCH_HAS_FDT
	bool

menuconfig FDT
	bool "Flattened device tree (FDT) support"

if FDT

endif
```

## kernel/i2c/Kconfig
```kconfig
#
# I2C Devices
#

config ARCH_HAS_I2C
	bool

menuconfig I2C
	bool "Inter integrated circuit (I2C) support"

if I2C

config I2C_MASTER
	bool "Enable bus master support"
	default y

config I2C_MAX_MASTERS
	int "Number of masters"
	depends I2C_MASTER
	default 1

config I2C_SLAVE
	bool "Enable bus slave support"

config I2C_GENERAL_CALL
	bool "Enable general call address support"
	help

config I2C_10BIT_ADDRESS
	bool "Enable 10-bit addressing support"
	help
	  Disabling this will force the master driver to use 7-bit
	  addressing.

config I2C_DEVICE_ID
	bool "Enable device-ID support"
	help
	  Disabling this will force the master driver not to perform
	  device ID probing procedure.

config I2C_CMD_TOOL
	bool "Enable I2C command tool"
	default y

endif
```

## kernel/i3c/Kconfig
```kconfig
#
# I3C Devices
#

config ARCH_HAS_I3C
	bool

config ARCH_HAS_I3C_AAO
	bool

config ARCH_HAS_I3C_TC
	bool

menuconfig I3C
	bool "Improved inter integrated circuit (I3C) support"

if I3C

config I3C_MASTER
	bool "Enable I3C master controller support"

config I3C_MAX_MASTERS
	int "Number of masters"
	default 1

config I3C_AAO
	bool "Enable optional address arbitration optimization"
	depends ARCH_HAS_I3C_AAO
	help
	  An I3C Master Device assigns 7-bit Dynamic Addresses in the range
	  7’h03 to 7’h7B. However because the I3C Master treats the entire
	  9-bit Arbitrable Address Header as Open Drain, it has no way to
	  detect whether a Slave Device might be transmitting its 617 own
	  Address during some (or all) of the Address Header.
	  Note that for I3C Secondary Masters and I3C In-Band Interrupt
	  Slaves, the I3C Master is free to restrict assigned Dynamic
	  Addresses to the lower half of the available range (7’h03 to
	  7’h3F), thus leaving the value of Address bit A6 (the first
	  Address bit after the START) as value 0 in all assigned Dynamic
	  Addresses.

config I3C_TC
	bool "Enable optional timing control support"
	depends ARCH_HAS_I3C_TC
	help
	  This Timing Control framework allows uncertainties affecting the
	  transmission or reception of timing information (for example: Bus
	  activity, busy Master or Slave, operation latency, system jitter,
	  etc.) to be nullified.

config I3C_HCI
	bool "I3C host controller interface (I3C HCI) support"

config I3C_DEBUG
	bool "I3C debug support"
	help
	  Enable I3C debug support. This will enable the I3C debug
	  interface and the I3C debug commands.

endif
```

## kernel/io/Kconfig
```kconfig
#
# Input/Output Devices
#

menu "Human Interface Devices (HID) support"

config LCD
	bool "Liquid crystal display (LCD) output support"

config KBD
	bool "Keyboard input support"

config LED
	bool "Light-Emitting Diode (LED) output support"

endmenu
```

## kernel/iommu/Kconfig
```kconfig
#
# IOMMU Devices
#

config ARCH_HAS_IOMMU
	bool

menuconfig IOMMU
	bool "I/O memory management unit (IOMMU) support"
	select BIT_FFS64
	select BIT_FLS64
	select DMA

if IOMMU

config IOMMU_MAX_DEVICES
	int "Number of devices"
	range 1 8
	default 1

config IOMMU_MAX_GROUPS
	int "Number of groups"
	range 1 64

config IOMMU_MAX_DOMAINS
	int "Number of domains"
	range 1 256

choice
	prompt "Default domain type"
	default IOMMU_DEF_DOMAIN_TRANSLATED

config IOMMU_DEF_DOMAIN_TRANSLATED
	bool "Translated"

config IOMMU_DEF_DOMAIN_PASSTHROUGH
	bool "Passthrough"

endchoice

endif
```

## kernel/ipmi/Kconfig
```kconfig
config ARCH_HAS_LPC
	bool

config ARCH_HAS_ESPI
	bool

config ARCH_HAS_ESPI_OOB
	bool

config ARCH_HAS_ESPI_FLASH
	bool

config ARCH_IS_ESPI_SYS_SINGLE
	bool

config ARCH_IS_ESPI_SYS_MULTI
	bool

config ARCH_HAS_ESPI_ALERT_PP
	bool

config ARCH_HAS_ESPI_ALERT_OD
	bool

config ARCH_HAS_ESPI_IO_SINGLE
	bool

config ARCH_HAS_ESPI_IO_DUAL
	bool

config ARCH_HAS_ESPI_IO_QUAD
	bool

config ARCH_IS_ESPI_FREQ_66MHZ
	bool

config ARCH_IS_ESPI_FREQ_50MHZ
	bool

config ARCH_IS_ESPI_FREQ_33MHZ
	bool

config ARCH_IS_ESPI_FREQ_25MHZ
	bool

config ARCH_IS_ESPI_FREQ_20MHZ
	bool

config ARCH_HAS_ESPI_PERI_READ_64
	bool

config ARCH_HAS_ESPI_PERI_READ_128
	bool

config ARCH_HAS_ESPI_PERI_READ_256
	bool

config ARCH_HAS_ESPI_CRC
	bool

config ARCH_HAS_ESPI_RSP_MOD
	bool

config ARCH_HAS_SIO
	bool

config ARCH_HAS_KCS
	bool

config ARCH_HAS_MCTP
	bool

config ARCH_HAS_PECI
	bool

menu "Mangement interfaces support"

menuconfig IPMI
	bool "Intelligent Platform Management Interface (IPMI) support"

if IPMI

config KCS
	bool "Keyboard Control Service (KCS) support"

if KCS

config KCS_HIF
	bool "Enable KCS host interface support"
	select LPC
	select STRING_HEXDUMP if COMMAND

config KCS_BMC
	bool "Enable KCS BMC slave demo support"

endif

endif

menuconfig LPC
	bool "Low Pin Count (LPC) support"

if LPC

config SIO
	bool "Super IO (SIO) chip support"

config SERIRQ
	bool "Serial IRQ (SERIRQ) chip support"

endif

menuconfig ESPI
	bool "Enhanced Serial Peripheral Interface (eSPI) support"
	select BIT_FLS32

if ESPI

choice
	prompt "System topology"

config ESPI_SYS_SINGLE
	bool "Single master-single slave"
	depends ARCH_IS_ESPI_SYS_SINGLE

config ESPI_SYS_MULTI
	bool "Single master-multiple slaves"
	depends ARCH_IS_ESPI_SYS_MULTI

endchoice

choice
	prompt "Default IO mode"
	default ESPI_QUAD if ARCH_HAS_ESPI_QUAD
	default ESPI_DUAL if ARCH_HAS_ESPI_DUAL && !ARCH_HAS_ESPI_QUAD
	default ESPI_SINGLE if ARCH_HAS_ESPI_SINGLE && !ARCH_HAS_ESPI_DUAL && !ARCH_HAS_ESPI_QUAD
	help
	  If quad is the default I/O mode, it falls to dual I/O mode if
	  slave doesn't support.
	  If dual is the default I/O mode, it falls to single I/O mode if
	  slave doesn't support.

config ESPI_IO_SINGLE
	bool "Single"
	depends ARCH_HAS_ESPI_IO_SINGLE

config ESPI_IO_DUAL
	bool "Dual"
	depends ARCH_HAS_ESPI_IO_DUAL

config ESPI_IO_QUAD
	bool "Quad"
	depends ARCH_HAS_ESPI_IO_QUAD

endchoice

choice
	prompt "Operation mode"

config ESPI_FREQ_66MHZ
	bool "66MHz"
	depends ARCH_IS_ESPI_FREQ_66MHZ

config ESPI_FREQ_50MHZ
	bool "50MHz"
	depends ARCH_IS_ESPI_FREQ_50MHZ

config ESPI_FREQ_33MHZ
	bool "33MHz"
	depends ARCH_IS_ESPI_FREQ_30MHZ

config ESPI_FREQ_25MHZ
	bool "25MHz"
	depends ARCH_IS_ESPI_FREQ_25MHZ

config ESPI_FREQ_20MHZ
	bool "20MHz"
	depends ARCH_IS_ESPI_FREQ_20MHZ

endchoice

config ESPI_OOB
	bool "Enable out-of-band (OOB) channel support"
	depends ARCH_HAS_ESPI_OOB
	default y if ARCH_HAS_ESPI_OOB

config ESPI_FLASH
	bool "Enable flash access channel support"
	depends ARCH_HAS_ESPI_FLASH
	default y if ARCH_HAS_ESPI_FLASH
	select ESPI_FLASH_ERASE_4K if !ESPI_FLASH_ERASE_64K && !ESPI_FLASH_ERASE_128K && !ESPI_FLASH_ERASE_256K

choice
	prompt "Alert type"
	default ESPI_ALERT_OD if ARCH_HAS_ESPI_ALERT_OD
	default ESPI_ALERT_PP if ARCH_HAS_ESPI_ALERT_PP && !ARCH_HAS_ESPI_ALERT_OD

config ESPI_ALERT_IO1
	bool "IO pin 1"

config ESPI_ALERT_PP
	bool "Push-pull"
	depends !ESPI_SYS_MULTI
	depends ARCH_HAS_ESPI_ALERT_PP

config ESPI_ALERT_OD
	bool "Open-drain"
	depends !ESPI_SYS_MULTI
	depends ARCH_HAS_ESPI_ALERT_OD

endchoice

config ESPI_CRC
	bool "Enable Cyclic Redundancy Check (CRC) support"
	depends ARCH_HAS_ESPI_CRC
	default y if ARCH_HAS_ESPI_CRC

config ESPI_RSP_MOD
	bool "Enable response modifier support"
	depends ARCH_HAS_ESPI_RSP_MOD
	default y if ARCH_HAS_ESPI_RSP_MOD

choice
	prompt "Peripheral read request size"

config ESPI_PERI_READ_64
	bool "64"
	depends ARCH_HAS_ESPI_PERI_READ_64

config ESPI_PERI_READ_128
	bool "128"
	depends ARCH_HAS_ESPI_PERI_READ_128

config ESPI_PERI_READ_256
	bool "256"
	depends ARCH_HAS_ESPI_PERI_READ_256

endchoice

if ESPI_FLASH

menu "eSPI flash configurations"

choice
	prompt "Flash read request size"

config ESPI_FLASH_READ_64
	bool "64"

config ESPI_FLASH_READ_128
	bool "128"

config ESPI_FLASH_READ_256
	bool "256"

config ESPI_FLASH_READ_512
	bool "512"

config ESPI_FLASH_READ_1024
	bool "1024"

config ESPI_FLASH_READ_2048
	bool "2048"

config ESPI_FLASH_READ_4096
	bool "4096"

endchoice

config ESPI_FLASH_ERASE_4K
	bool "Enable 4Kbytes block erase size"
	depends !ESPI_FLASH_ERASE_128K && !ESPI_FLASH_ERASE_256K
	default y

config ESPI_FLASH_ERASE_64K
	bool "Enable 64Kbytes block erase size"
	depends !ESPI_FLASH_ERASE_128K && !ESPI_FLASH_ERASE_256K

config ESPI_FLASH_ERASE_128K
	bool "Enable 128Kbytes block erase size"
	depends !ESPI_FLASH_ERASE_256K

config ESPI_FLASH_ERASE_256K
	bool "Enable 256Kbytes block erase size"

endmenu

endif

config ESPI_DEBUG
	bool "Enabling debugging messages"
	depends CONSOLE_DEBUG

endif

menuconfig PECI
	bool "Platform environment control interface (PECI) support"

if PECI

endif

menuconfig MCTP
	bool "Management component transport protocol (MCTP) support"

if MCTP

endif

menuconfig SSIF
	bool "SMBus System Interface (SSIF) support"
	select STRING_HEXDUMP if COMMAND

if SSIF

endif

endmenu
```

## kernel/mmc/Kconfig
```kconfig
#
# MMC Devices
#

config ARCH_HAS_MMC
	bool

config ARCH_HAS_SD
	bool

config ARCH_HAS_UHSII
	bool

config ARCH_HAS_EMMC
	bool

config ARCH_HAS_SDHC
	bool

config MMC_CORE
	bool
	select CRC16_CCITT

if ARCH_HAS_MMC || ARCH_HAS_SD

menuconfig MMCSD
	bool "MMC/SD/SDIO card support"

if MMCSD

config MMC_MAX_SLOTS
	int "Number of memory card slots (1~8)"
	range 1 8
	default 1

config MMC_MAX_CARDS
	int "Number of memory cards (1~8)"
	range 1 8
	default 1

config MMC_WIDTH
	bool "Enable bus width selection support"

config MMC_CID_ALL_FIELDS
	bool "Enable storing of all CID register fields"
	depends EXPERIMENTAL
	help
	  A card is identified by its CID number. This method requires the
	  card to have an unique CID number. To ensure uniqueness of CIDs
	  the CID register contains 24 bits (MID and OID fields) which are
	  defined by the MMCA.
	  This option needs to be enabled in order to have more CID
	  register fields saved by sdfirm during rumtime. Be aware that
	  these fields are still used for debugging purpose and not for
	  improving the uniqueness of CIDs.
	  If unsure, say 'N'.

config MMC_DEBUG
	bool "MMC debug message support"
	depends DEBUG_PRINT || CONSOLE

choice
	prompt "Physical layer"

config MMC
	bool "Multimedia card (MMC)"
	depends ARCH_HAS_MMC
	select MMC_CORE

config SD
	bool "Secure digital (SD) card"
	depends ARCH_HAS_SD
	select MMC_CORE

endchoice

if MMC

config MMC_ASYNC
	bool "Enable asynchronous mode support"
	help
	  By default, do not use handshake signals (STB, ACK) but polling
	  the state (busy/not busy), which is known as synchronous mode.
	  This option allows sdfirm to enable asynchronous mode via the
	  handshake signals.
	  If unsure, say 'N'.

config MMC_SPI
	bool "SPI mode support"

endif

if SD

config SD_PHY_VERSION
	int "SD physical version"
	range 1 6
	default 6

choice
	prompt "Capacity"

config SD_SDSC
	bool "Standard (0~2GB)"

config SD_SDHC
	bool "High (2GB~32GB)"

config SD_SDXC
	bool "Extended (32GB~)"

endchoice

config SD_SPI
	bool "SPI bus protocol support"
	select MMC_SPI

if SD_SPI

endif

config UHSII
	bool "UHS-II bus protocol support"
	depends ARCH_HAS_UHSII

if UHSII

config UHSII_CTS
	bool "Enable command issuing during CTS"

config UHSII_TID
	bool "Enable support of TID check"

endif

menuconfig SDHC
	bool "Secure Digital Host Controller (SDHC) support"
	select ARCH_HAS_SDHC
	select BIT_FLS32

if SDHC

config SDHC_SPEC_100
	bool

config SDHC_SPEC_200
	bool
	select SDHC_SPEC_100

config SDHC_SPEC_300
	bool
	select SDHC_SPEC_200

config SDHC_SPEC_400
	bool
	select SDHC_SPEC_300

config SDHC_SPEC_410
	bool
	select SDHC_SPEC_400

config SDHC_SPEC_420
	bool
	select SDHC_SPEC_410

config SDHC_SPEC_500
	bool
	select SDHC_SPEC_420

config SDHC_SD
	bool "SD mode support"

config SDHC_EMMC
	bool "eMMC mode support"

config SDHC_UHSI
	bool "UHS-I mode support"
	select SDHC_SD

config SDHC_UHSII
	bool "UHS-II mode support"

menu "DMA support"

config SDHC_SDMA
	bool "Single operation DMA (SDMA) support"

config SDHC_ADMA
	bool "Advanced DMA (ADMA) support"
	depends SDHC4

endmenu

config SDHC_PM
	bool "Enable suspend/resume mechanism support"

config SDHC_BUFFER
	bool "Enable buffer control support"

config SDHC_AUTO_CMD12
	bool "Auto CMD12 support"

config SDHC_AUTO_CMD23
	bool "Auto CMD23 support"
	depends SDHC4

config SDHC_ACCEL
	bool "Enable simulation acceleration"
	depends SIMULATION

endif

endif

endif

endif
```
