## kernel/mtd/Kconfig
```kconfig
#
# MTD Devices
#

menuconfig MTD
	bool "Memory technology device (MTD) support"
	select BIT_FLS32
	select BIT_FLS16

if MTD

config MTD_MAX_CHIPS
	int "Number of memory chip drivers (1~8)"
	range 1 8
	default 1

config MTD_MAX_DEVS
	int "Number of memory devices (1~8)"
	range 1 8
	default 1

config MTD_CONCAT
	bool "Enable MTD device concatenation support"
	select BIT_FLS32
	select BIT_FLS16
	help

config MTD_BLOCK_RW
	bool "Read/write on block boundary"
	default y

if MTD_CONCAT

config MTD_MAX_CONCATS
	int "Number of concatenated devices (1~8)"
	range 1 8
	default 1

choice
	prompt "Concatenation style"

config MTD_CONCAT_PAGE
	bool "Page boundary"

config MTD_CONCAT_CHIP
	bool "Chip boundary"

endchoice

endif

config MTD_BLOCK
	bool "MTD block device support"
	depends SCSI_SBC
	default y

menuconfig MTD_FLASH
	bool "Flash (NOR) memory support"

config ARCH_HAS_FLASH
	bool
	select BIT_FLS16

if MTD_FLASH

config FLASH_MAX_BANKS
	int "Number of Flash banks"
	range 1 16
	default 1

endif

menuconfig MTD_DATAFLASH
	bool "ATMEL SPI interfaced DataFlash support"
	depends SPI_MASTER
	select BIT_FLS16

if MTD_DATAFLASH

config DATAFLASH_MAX_BANKS
	int "Number of DataFlash banks"
	range 1 16
	default 2

config DATAFLASH_WRITE_VERIFY
	bool "Verify DataFlash page writes"

config DATAFLASH_OTP
	bool "DataFlash one time programmable (OTP) support"

endif

config ARCH_HAS_SPIFLASH
	bool

config ARCH_HAS_SPIFLASH_ADDR_4BYTE
	bool

menuconfig MTD_SPIFLASH
	bool "Winbond SPI interfaced flash support"
	depends SPI_MASTER

if MTD_SPIFLASH

config SPIFLASH_MAX_BANKS
	int "Number of SPI flash banks"
	range 1 16
	default 1

choice
	prompt "SPI wires"

config SPIFLASH_STD
	bool "Standard SPI instructions"

config SPIFLASH_DUAL
	bool "Dual SPI instructions"

config SPIFLASH_QUAD
	bool "Quad SPI instructions"

endchoice

choice
	prompt "Standard SPI mode"
	default SPIFLASH_MODE_3

config SPIFLASH_MODE_0
	bool "Mode 0"

config SPIFLASH_MODE_3
	bool "Mode 3"

endchoice

choice
	prompt "Block erase size"

config SPIFLASH_ERASE_4K
	bool "Sector 4KB"

config SPIFLASH_ERASE_32K
	bool "Block 32KB"

config SPIFLASH_ERASE_64K
	bool "Block 64KB"

endchoice

config SPIFLASH_ADDR_4BYTE
	bool "Enable 4-byte address mode"
	depends ARCH_HAS_SPIFLASH_ADDR_4BYTE

endif

config MTD_MMCARD
	bool "Multimedia card (MMC) device support"

endif
```

## kernel/net/Kconfig
```kconfig
#
# Networking
#

menuconfig NET
	bool "Networking support"
	select HEAP
	select CRYPTO_RAND

if NET

source kernel/net/inet/Kconfig

endif
```

## kernel/net/inet/Kconfig
```kconfig
#
# Internet Protocol
#


menuconfig INET
	bool "Internet protocol (IP) support"

if INET
endif
```

## kernel/pci/Kconfig
```kconfig
#
# PCI Devices
#

config ARCH_HAS_PCI
	bool

menuconfig PCI
	bool "Peripheral component interconnect (PCI) support"
	depends ARCH_HAS_PCI

if PCI

endif
```

## kernel/rio/Kconfig
```kconfig
#
# RIO Devices
#

config ARCH_HAS_RIO
	bool

config ARCH_HAS_SRIO_1X
	bool

config ARCH_HAS_SRIO_2X
	bool

config ARCH_HAS_SRIO_4X
	bool

config ARCH_HAS_SRIO_8X
	bool

config ARCH_HAS_SRIO_16X
	bool

config ARCH_HAS_SRIO_1_25G
	bool

config ARCH_HAS_SRIO_2_5G
	bool

config ARCH_HAS_SRIO_3_125G
	bool

config ARCH_HAS_SRIO_5G
	bool

config ARCH_HAS_SRIO_6_25G
	bool

config ARCH_HAS_SRIO_LEVEL_I
	bool
	select ARCH_HAS_RIO_1_25G
	select ARCH_HAS_RIO_2_5G
	select ARCH_HAS_RIO_3_125G

config ARCH_HAS_SRIO_LEVEL_II
	bool
	select ARCH_HAS_RIO_5G
	select ARCH_HAS_RIO_6_25G

menuconfig RIO
	bool "RapidIO interconnect (RIO) support"
	depends ARCH_HAS_RIO

if RIO

config RIO_MAX_PORTS
	int "Number of RapidIO ports (1~8)"
	range 1 8
	default 1

config SRIO
	bool "LP-Serial physical layer support"

choice
	prompt "Link speed"

config SRIO_1_25G
	bool "1.25Gbaud"
	depends ARCH_HAS_SRIO_1_25G

config SRIO_2_5G
	bool "2.5Gbaud"
	depends ARCH_HAS_SRIO_2_5G

config SRIO_3_125G
	bool "3.125Gbaud"
	depends ARCH_HAS_SRIO_3_125G

config SRIO_5G
	bool "5Gbaud"
	depends ARCH_HAS_SRIO_5G

config SRIO_6_25G
	bool "6.25Gbaud"
	depends ARCH_HAS_SRIO_6_25G

endchoice

choice
	prompt "Link mode"
	default SRIO_4X

config SRIO_1X
	bool "1X lanes"
	depends ARCH_HAS_SRIO_1X

config SRIO_2X
	bool "2X lanes"
	depends ARCH_HAS_SRIO_2X

config SRIO_4X
	bool "4X lanes"
	depends ARCH_HAS_SRIO_4X

config SRIO_8X
	bool "8X lanes"
	depends ARCH_HAS_SRIO_8X

config SRIO_16X
	bool "16X lanes"
	depends ARCH_HAS_SRIO_16X

endchoice

endif
```

## kernel/scs/Kconfig
```kconfig
#
# Smart Card Standard
#

config ARCH_HAS_IFD
	bool
config ARCH_HAS_IFD_PRES_IRQ
	bool
config ARCH_HAS_PCD
	bool

menuconfig SCS
	bool "Smart card standards support"
	help
	  nothing here

if SCS

menuconfig SCS_SLOT
	bool "Smart card slot device support"

if SCS_SLOT

config SCS_MAX_SLOTS
	int "Number of smart card slots (1~8)"
	range 1 8
	default 1

config COS_SLOT
	bool "Enable card operating system (ISO7816-4)"
	select COS

config IFD_SLOT
	bool "Enable contact card initiator (ISO7816-3)"
	select IFD
	select IFD_AUTO_RESET
	select IFD_XCHG_APDU

config ACR122_SLOT
	bool "Enable fake ACR122 reader"
	select ACR122

endif

menuconfig IFD
	bool "Contact interface device (ISO7816-3) support"
	select IFD_T0
	help
	  nothing here

if IFD

config IFD_MAX_SLOTS
	int "Number of slots support (1~15)"
	range 1 15
	default 1
	help
	  Set this to the maximum number of the slots your want the
	  kernel to register in the boot time.

choice
	prompt "Card presence sensor"
	default IFD_PRES_POLL

config IFD_PRES_IRQ
	bool "Interrupt"
	depends ARCH_HAS_IFD_PRES_IRQ

config IFD_PRES_POLL
	bool "Polling"
	select TIMER

endchoice

config IFD_WT_RATIO
       int "Enable waiting time adjustment"
       range 1 10
       default 1
       help
         This option may useless if ICCs are always standard compatible.
         But it is useful when ICCs' are not correctly timing measured.
         If you are not sure, say '1' here, which means no adjustment.

choice
	prompt "Exchange level"
	default IFD_XCHG_TPDU
	help
	  nothing here

config IFD_XCHG_TPDU
	bool "TPDU"
	depends !IFD_SLOT
	help
	  This option will use a buffer with 260 bytes to store APDU.
	  If you enable T=1 support, use TPDU level exchange can save a
	  lot of code rom.

config IFD_XCHG_APDU
	bool "Short APDU"
	select IFD_AUTO_SEQUENCE
	select IFD_AUTO_INFO_XCHG
#	select IFD_AUTO_PPS_PROP
	help
	  This option will use a buffer with 261 bytes to store APDU.

endchoice

config IFD_PANIC_BUF
	bool "Enable transmission buffer debugging"
	depends PANIC_DEBUG && IFD_XCHG_TPDU

menu "Transmission protocols support"

menuconfig IFD_T0
	bool "Protocol T=0 support"
	default y
	help
	  Protocol T=0 is a half-duplex transmission of characters protocol

if IFD_T0

config IFD_T0_APDU
	bool "Issue GET_RESPONSE/ENVELOP for APDU level exchange"
	depends IFD_XCHG_APDU
	help
	  If this is not configured, T=0 protocol will not issue
	  GET_RESPONSE even when Ne < protocol buffer size or
	  ENVELOP      even when Nc > protocol buffer size.
	  When this configuration item is enabled, it is required that
	  upper layer should set CLA for GET RESPONSE generation.
	  If you are not sure, say N.

config IFD_T0_6C
	bool "T=0 SW1=0x6C support"
	depends IFD_XCHG_APDU

endif

menuconfig IFD_T1
	bool "Protocol T=1 support"
	select CRC16_CCITT if IFD_XCHG_APDU
	help
	  Protocol T=1 is a half-duplex transmission of blocks protocol

if IFD_T1

config IFD_T1_MAX_IFSD
	int "T=1 maximum information field size"
	range 32 254
	default 254
	help
	  Only works for IFSD=254, other configuration values are not
	  tested.
	  If unsure, say '254' here.

config IFD_T1_NAD
	bool "T=1 addressing support"
	help
	  The node address byte(NAD) allows identifying the source and the
	  intended destination of the clock; it may be used to distinguish
	  between multiple logical connections when the coexist. Bits 1 to
	  3 are the source node address denoted SAD and bits 5 to 7 the 
	  destination node address denoted DAD.
	  When the addressing is not used, the values of SAD and DAD shall
	  be set to 000. Any other value of NAD where SAD and DAD are
	  identical is reserved for future use.

config IFD_T1_CRC
	bool "T=1 CRC support"
	default n

config IFD_T1_LRC
	bool "T=1 LRC support"
	default y

endif

endmenu

menuconfig IFD_AUTO_SEQUENCE
	bool "Auto sequence support"
	help
	  Automatic sequences include:
	  Class selection
	  Activation, cold reset, warm reset
	  Reset
	  Information exchange
	  Please refer to ISO/IEC 7816-3 chapter 6.

if IFD_AUTO_SEQUENCE
config IFD_AUTO_CLASS_SELECT
	bool "Automatic class selection"
	help
	  Automatic ICC voltage selection.

choice	
	prompt "Class sequence"
	default IFD_CLASS_SELECT_ASCEND
	depends IFD_AUTO_CLASS_SELECT
	help
	  Choose class selection algorithm here.

config IFD_CLASS_SELECT_DESCEND
	bool "Descend"
	help
	  Class A -> Class B -> Class C if you want to gain maximum
	  performance.
	  
config	IFD_CLASS_SELECT_ASCEND
	bool "Ascend"
	help
	  Class C -> Class B -> Class A if you want to gain minimum
	  power consumption.

endchoice

config IFD_AUTO_ACTIVATE
	bool "Automatic activation"
	select IFD_AUTO_CLASS_SELECT
	help
	  Automatic activation on ICC inserting.
	  This will lead to automatic clock frequency and data rate
	  configuration.

config IFD_AUTO_RESET
	bool "Automatic reset"
	select IFD_AUTO_ACTIVATE
	help
	  Automatic reset on ICC activation.
	  This will lead to automatic ATR preparation.

config IFD_AUTO_INFO_XCHG
	bool "Automatic infomation exchange"
	select IFD_AUTO_RESET
	depends !IFD_SLOT
	help
	  Automatic parameters configuration based on ATR data.
	  This will lead to automatic PPS if card is in negotiatable mode.

if IFD_AUTO_INFO_XCHG
choice
	prompt "PPS negotiation base"
	default IFD_AUTO_PPS_BASE
	help
	  Choose PPS negotiation algorithm here.

config IFD_AUTO_PPS_BASE
	bool "Active parameters"
	depends !IFD_SLOT
#	depends !IFD_XCHG_APDU
	help
	  Automatic PPS negotiation made by SCS according to the active
	  parameters.
	  If you are not sure, say Y.

config IFD_AUTO_PPS_PROP
	bool "Proprietary algorithm"
	help
	  Automatic PPS negotiation made by SCS according to a manufacture
	  proprietary algorithm to select communication parameters with
	  ICC.
	  Since this requires ATR rebuilding or saving support, we could
	  never support this.
	  If you are not sure, say N.

endchoice

config IFD_AUTO_ATR_BUILD
	bool "Building fake ATR from interface device settings"
	depends on IFD_AUTO_PPS_PROP
endif
endif

config IFD_CLOCK_CONTROL
	bool "Clock control support"
	depends !IFD_SLOT
	help
	  nothing here

config IFD_MECHA_CONTROL
	bool "Mechanical control support"
	depends !IFD_SLOT
	help
	  nothing here

endif

menuconfig PCD
	bool "Proximity coupling device (ISO14443-4) support"

if PCD

endif

menuconfig COS
	bool "Card operating system (COS) support"
	help
	  nothing here

if COS

config COS_MAX_CHANS
	int "Number of COS channels (1~4)"
	range 1 4
	default 1
	help

endif

endif
```

## kernel/scsi/Kconfig
```kconfig
#
# SCSI Storage
#

menuconfig SCSI
	bool "Small computer storage interface (SCSI-3) support"

if SCSI

#config SCSI_INITIATOR
#	bool "Enable SCSI initiator device support"

config SCSI_TARGET
	bool "Enable SCSI target device support"
	select BULK
	default y

if SCSI_TARGET

config SCSI_T10_REVISION
	int "T10 product revision level"
	range 0 65535
	default 0

config SCSI_MAX_UNITS
	int "Number of logical units per target device (1~8)"
	default 1

config SCSI_MAX_PORTS
	int "Number of target ports per target device (1~8)"
	default 1

config SCSI_MAX_TASKS
	int "Number of tasks per logical unit (1~8)"
	default 1

config SCSI_MAX_CMNDS
	int "Number of commands per logical unit (1~8)"
	default 1

config SCSI_MAX_BUFFER
	int "Data IN/OUT buffer size"
	range 64 65536
	default 2048

menu "Standard INQUIRY data features"

config SCSI_LINK
	bool "Enable continuation of tasks (LINKED) support"
	default 1

config SCSI_NACA
	bool "Enable auto contingent allegiance (NormACA) support"

choice
	prompt "Task set management model"
	default SCSI_CMDQUE
	help
	  Affect BQue/CmdQue bits in standard INQUIRY data.

config SCSI_CMDQUE
	bool "Full (BQue=0, CmdQue=1)"

config SCSI_BQUE
	bool "Base (BQue=1, CmdQue=0)"

endchoice

config SCSI_HISUP
	bool "Enable hierachical addressing model (HiSup) support"
	depends EXPERIMENTAL

config SCSI_STD_ACC
	bool "Enable access controls coordinator (ACC) support"
	depends EXPERIMENTAL

#choice
#	prompt "Target port group (TPGS) support"
#	depends EXPERIMENTAL
#endchoice

config SCSI_3PC
	bool "Enable third-party copy (3PC) support"
	depends EXPERIMENTAL

config SCSI_RMB
	bool "Enable removable medium (RMB) support"

endmenu

menuconfig SCSI_INQUIRY_EX
	bool "Extended INQUIRY data (VPD=0x86) features"

if SCSI_INQUIRY_EX

config SCSI_PRIOR
	bool "Task priority support"

endif

menu "Vital product data (VPD) parameters support"

config SCSI_MAX_VPDS
	int "Number of VPD pages (2~255)"
	range 2 255
	default 2

config SCSI_VPD_ASCII
	bool "ASCII information (VPD=0x01~0x7F)"

config SCSI_MAX_ASCIIS
	int "Number of ASCII informations (0~127)"
	depends SCSI_VPD_ASCII
	range 0 127
	default 0

menu "Device Identification (VPD=0x83)"

config SCSI_RPID
	bool "Enable relative port identifier support"

endmenu

config SCSI_VPD_SN
	bool "Serial number (VPD=0x80)"

config SCSI_VPD_SOFT_ID
	bool "Software interface identification (VPD=0x84)"
	depends EXPERIMENTAL

config SCSI_VPD_ADDRS
	bool "Management network addresses (VPD=0x85)"
	depends EXPERIMENTAL

config SCSI_VPD_PORTS
	bool "SCSI ports (VPD=0x88)"
	depends EXPERIMENTAL

endmenu

menuconfig SCSI_LOG
	bool "Log parameters (LOG) support"
	depends EXPERIMENTAL

if SCSI_LOG
endif

menuconfig SCSI_MODE
	bool "Mode parameters (VPD=0x87) support"
	help
	  Enabling of this configuration item will turn on the MODE SENSEN
	  and MODE SELECT SCSI commands support.
	  Mode page policy VPD will also be registered.

if SCSI_MODE

config SCSI_MAX_MODES
	int "Number of mode pages per logical unit (1~32)"
	default 1

config SCSI_MAX_PAGES
	int "Mode pages buffer size"
	range 64 4096
	default 64
	help
	  Mode parameters will stored in this buffer, allocated per
	  logical unit.

config SCSI_MODE_SAVING
	bool "Saving mode parameters support"

endif

menu "Control mode (Page=0x0A,0x00) features"

config SCSI_TMF_ONLY
	bool "Enable task termination on faulted nexus (TMF_ONLY)"
	help
	  Device server should terminate all tasks received on the faulted
	  I_T nexus with an ACA ACTIVE status when an ACA condition has
	  been established.

endmenu

endif

menuconfig SCSI_SMC
	bool "SCSI media changer commands (SMC) support"
	select SCSI_RMB

if SCSI_SMC
endif

menuconfig SCSI_SBC
	bool "SCSI block commands (SBC) support"
	help
	  SBC describes the command sets for block-oriented direct-access
	  devices such as magnetic disk drives

if SCSI_SBC

config SBC_PROTECT
	bool "Protect information support"
	select SCSI_INQUIRY_EX

config SBC_PROTECT_RTO
	bool "Reference tag ownership support"
	depends SBC_PROTECT

config SBC_PROTECT_GRD
	bool "Checking LOGICAL BLOCK GUARD field"
	depends SBC_PROTECT

config SBC_PROTECT_APP
	bool "Checking LOGICAL BLOCK APPLICATION TAG field"
	depends SBC_PROTECT

config SBC_PROTECT_REF
	bool "Checking LOGICAL BLOCK REFERENCE TAG field"
	depends SBC_PROTECT

config SBC_GROUP
	bool "Grouping function support"
	select SCSI_INQUIRY_EX

config SBC_CACHE
	bool "Device caches (DPO, FUA) support"
	select SCSI_INQUIRY_EX

endif

endif
```

## kernel/spi/Kconfig
```kconfig
#
# SPI Devices
#

config ARCH_HAS_SPI
	bool

menuconfig SPI
	bool "Serial peripheral interface (SPI) support"

if SPI

config SPI_MASTER
	bool "Enable bus master support"

config SPI_SLAVE
	bool "Enable bus slave support"

config SPI_MAX_DEVICES
	int "Number of SPI slave devices (1~8)"
	range 1 8
	default 2

endif
```
