## drivers/net/Kconfig
```kconfig
#
# For a description of the syntax of this configuration file,
# see scripts/kbuild/config-language.txt.
#

menu "Network drivers"

menuconfig DW_XGMAC
	bool "Synopsys DesignWare 10G ethernet MAC (XGMAC) support"
	select DW_XPCS
	select CRYPTO_RAND

if DW_XGMAC

config DW_XGMAC_MDIO_FAST
	bool "Enable faster clock on MDIO"
	depends SIMULATION

endif

config ARCH_IS_DW_XPCS_XGXS_DTE
	bool

config ARCH_IS_DW_XPCS_XGXS_PHY
	bool

config ARCH_IS_DW_XPCS_10000BASE_X
	bool

config ARCH_IS_DW_XPCS_1000BASE_X
	bool

config ARCH_HAS_DW_XPCS_1000BASE_X
	bool

config ARCH_IS_DW_XPCS_BACKPLANE
	bool

config ARCH_IS_DW_XPCS_10000BASE_R
	bool

config ARCH_HAS_DW_XPCS_10000BASE_KX4
	bool

config ARCH_HAS_DW_XPCS_10000BASE_KR
	bool

config ARCH_HAS_DW_XPCS_5000BASE_KR
	bool

config ARCH_HAS_DW_XPCS_2500BASE_KX
	bool

config ARCH_HAS_DW_XPCS_1000BASE_KX
	bool

config ARCH_IS_DW_XPCS_MDIO
	bool

config ARCH_IS_DW_XPCS_MCI
	bool

config ARCH_IS_DW_XPCS_APB
	bool

config ARCH_IS_DW_XPCS_APB_INDIRECT
	bool
	select ARCH_IS_DW_XPCS_APB

config ARCH_IS_DW_XPCS_PHY_SNPS_XAUI
	bool

config ARCH_IS_DW_XPCS_PHY_GEN1_3G
	bool
	select ARCH_IS_DW_XPCS_PHY_SNPS_XAUI

config ARCH_IS_DW_XPCS_PHY_GEN2_3G
	bool
	select ARCH_IS_DW_XPCS_PHY_SNPS_XAUI

config ARCH_IS_DW_XPCS_PHY_GEN2_6G
	bool
	select ARCH_IS_DW_XPCS_PHY_SNPS_XAUI

config ARCH_IS_DW_XPCS_PHY_GEN4_3G
	bool
	select ARCH_IS_DW_XPCS_PHY_SNPS_XAUI

config ARCH_IS_DW_XPCS_PHY_GEN4_6G
	bool
	select ARCH_IS_DW_XPCS_PHY_SNPS_XAUI

config ARCH_IS_DW_XPCS_PHY_GEN5_10G
	bool
	select ARCH_IS_DW_XPCS_PHY_SNPS_XAUI

config ARCH_IS_DW_XPCS_PHY_GEN5_12G
	bool
	select ARCH_IS_DW_XPCS_PHY_SNPS_XAUI

config ARCH_IS_DW_XPCS_PHY_GEN5_16G
	bool
	select ARCH_IS_DW_XPCS_PHY_SNPS_XAUI

config ARCH_IS_DW_XPCS_PHY_RX_LSB
	bool
	depends !ARCH_IS_DW_XPCS_PHY_SNPS_XAUI

config ARCH_IS_DW_XPCS_PHY_TX_LSB
	bool
	depends !ARCH_IS_DW_XPCS_PHY_SNPS_XAUI

config ARCH_HAS_DW_XPCS_PHY_RDY
	bool
	depends !ARCH_IS_DW_XPCS_PHY_SNPS_XAUI

config ARCH_HAS_DW_XPCS_KRTR
	bool

config ARCH_HAS_DW_XPCS_FEC
	bool

config ARCH_HAS_DW_XPCS_FEC_FORWARD
	bool

config ARCH_HAS_DW_XPCS_AN
	bool

config ARCH_HAS_DW_XPCS_EEE
	bool

config ARCH_HAS_DW_XPCS_GPIO
	bool

config ARCH_IS_DW_XPCS_SGMII
	bool

config ARCH_IS_DW_XPCS_QSGMII
	bool

config ARCH_HAS_DW_XPCS_USXGMII
	bool

config ARCH_IS_DW_XPCS_XGMII_SDR
	bool

config ARCH_IS_DW_XPCS_XGMII_DDR
	bool

config ARCH_IS_DW_XPCS_XGMII_DDW
	bool

config ARCH_HAS_DW_XPCS_GMII
	bool

config ARCH_HAS_DW_XPCS_RXAUI
	bool

config ARCH_HAS_DW_XPCS_SGMII_AN
	bool

menuconfig DW_XPCS
	bool "Synopsys DesignWare ethernet PCS (XPCS) support"

if DW_XPCS

config DW_XPCS_PMA_PMD_MMD
	bool

config DW_XPCS_PCS_MMD
	bool
	select DW_XPCS_PCS

config DW_XPCS_AN_MMD
	bool

config DW_XPCS_VS_MII_MMD
	bool

config DW_XPCS_1000BASE_X
	bool

config DW_XPCS_PCS
	bool

choice
	prompt "Mode of operation"

config DW_XPCS_XGXS
	bool "XGXS PCS"
	depends ARCH_IS_DW_XPCS_XGXS_DTE || ARCH_IS_DW_XPCS_XGXS_PHY

config DW_XPCS_10000BASE_X
	bool "10000BASE-X PCS"
	depends ARCH_IS_DW_XPCS_10000BASE_X
	select DW_XPCS_PCS_MMD
	select DW_XPCS_PMA_PMD_MMD

config DW_XPCS_BACKPLANE
	bool "Backplane ethernet PCS"
	depends ARCH_IS_DW_XPCS_BACKPLANE
	select DW_XPCS_AN_MMD
	select DW_XPCS_PMA_PMD_MMD
	select DW_XPCS_PCS_MMD

config DW_XPCS_1000BASE_X_ONLY
	bool "1000BASE-X PCS"
	depends ARCH_IS_DW_XPCS_1000BASE_X
	select DW_XPCS_1000BASE_X
	select DW_XPCS_PCS_MMD
	select DW_XPCS_VS_MII_MMD

config DW_XPCS_10000BASE_R
	bool "10000BASE-R PCS"
	depends ARCH_IS_DW_XPCS_10000BASE_R
	select DW_XPCS_PCS_MMD

endchoice

config DW_XPCS_1000BASE_X_ADD
	bool "Add 1000BASE-X PCS support"
	depends ARCH_HAS_DW_XPCS_1000BASE_X && \
		(DW_XPCS_XGXS || DW_XPCS_10000BASE_X || DW_XPCS_10000BASE_R)
	select DW_XPCS_1000BASE_X

if DW_XPCS_XGXS

choice
	prompt "XGXS mode"

config DW_XPCS_XGXS_DTE
	bool "XGXS in DTE"
	depends ARCH_IS_DW_XPCS_XGXS_DTE

config DW_XPCS_XGXS_PHY
	bool "XGXS in PHY"
	depends ARCH_IS_DW_XPCS_XGXS_PHY

endchoice

endif

config DW_XPCS_KX4
	bool

config DW_XPCS_KR
	bool

config DW_XPCS_KX
	bool

if DW_XPCS_BACKPLANE

menu "Backplane ethernet PCS speed"

config DW_XPCS_10000BASE_KX4
	bool "10000BASE-KX4"
	depends ARCH_HAS_DW_XPCS_10000BASE_KX4
	select DW_XPCS_KX4

config DW_XPCS_10000BASE_KR
	bool "10000BASE-KR"
	depends ARCH_HAS_DW_XPCS_10000BASE_KR
	select DW_XPCS_KR

config DW_XPCS_5000BASE_KR
	bool "5000BASE-KR"
	depends ARCH_HAS_DW_XPCS_5000BASE_KR
	select DW_XPCS_KR

config DW_XPCS_2500BASE_KX
	bool "2500BASE-KX"
	depends ARCH_HAS_DW_XPCS_2500BASE_KX
	select DW_XPCS_KX

config DW_XPCS_1000BASE_KX
	bool "1000BASE-KX"
	depends ARCH_HAS_DW_XPCS_1000BASE_KX
	select DW_XPCS_KX

endmenu

endif

choice
	prompt "Management interface"

config DW_XPCS_MDIO
	bool "MDIO"
	depends ARCH_IS_DW_XPCS_MDIO

config DW_XPCS_MCI
	bool "Micro-controller"
	depends ARCH_IS_DW_XPCS_MCI

config DW_XPCS_APB
	bool "APB3"
	depends ARCH_IS_DW_XPCS_APB

endchoice

config DW_XPCS_RPCS_ONLY
	bool
	default y if (DW_XPCS_10000BASE_R && !DW_XPCS_1000BASE_X_ONLY) || \
		     (!DW_XPCS_KX4 && !DW_XPCS_KX)

config DW_XPCS_RPCS
	bool
	default y if DW_XPCS_10000BASE_R || DW_XPCS_KR

config DW_XPCS_USXGMII
	bool "Enable USXGMII support"
	depends DW_XPCS_RPCS
	depends ARCH_HAS_DW_XPCS_USXGMII

config DW_XPCS_KRTR
	bool "Enable clause 72 KR training support"
	depends DW_XPCS_KR && ARCH_IS_DW_XPCS_PHY_SNPS_XAUI
	depends ARCH_HAS_DW_XPCS_KRTR

config DW_XPCS_FEC
	bool "Enable forward error correction (FEC) support"
	depends DW_XPCS_KR
	depends ARCH_HAS_DW_XPCS_FEC

config DW_XPCS_FEC_FORWARD
	bool "Enable error forwarding support"
	depends DW_XPCS_FEC
	depends ARCH_HAS_DW_XPCS_FEC_FORWARD

config DW_XPCS_AN
	bool "Enable clause 37 auto-negotiation support"
	depends ARCH_HAS_DW_XPCS_AN
	depends (DW_XPCS_1000BASE_X_ADD || DW_XPCS_KX) && !DW_XPCS_USXGMII

if (DW_XPCS_AN && (DW_XPCS_1000BASE_X || DW_XPCS_KX)) || \
   DW_XPCS_1000BASE_X_ONLY

choice
	prompt "PHY mode"

config DW_XPCS_SGMII
	bool "SGMII"
	depends ARCH_IS_DW_XPCS_SGMII

config DW_XPCS_QSGMII
	bool "QSGMII"
	depends ARCH_IS_DW_XPCS_QSGMII

endchoice

endif

config DW_XPCS_SINGLE_LANE
	bool
	default y if !DW_XPCS_KX && \
		     !DW_XPCS_1000BASE_X_ONLY && !DW_XPCS_10000BASE_R

if !DW_XPCS_SINGLE_LANE

config DW_XPCS_MAX_LANES
	int "Number of lanes"
	range 1 4
	default 4

endif

if !((!DW_XPCS_KX4 && !DW_XPCS_KR) || DW_XPCS_1000BASE_X_ONLY || \
     DW_XPCS_USXGMII)

choice
	prompt "XGMII interface"

config DW_XPCS_XGMII_SDR
	bool "Single data rate (SDR)"
	depends ARCH_IS_DW_XPCS_XGMII_SDR

config DW_XPCS_XGMII_DDR
	bool "Dual data rate (DDR)"
	depends ARCH_IS_DW_XPCS_XGMII_DDR

config DW_XPCS_XGMII_DDW
	bool "Dual data rate (DDW)"
	depends ARCH_IS_DW_XPCS_XGMII_DDW

endchoice

endif

config DW_XPCS_SGMII_AN
	bool "Enable SGMII PHY automate support"
	depends DW_XPCS_SGMII
	depends ARCH_HAS_DW_XPCS_SGMII_AN

config DW_XPCS_GMII
	bool "Enable GMII support"
	depends ARCH_HAS_DW_XPCS_GMII

config DW_XPCS_RXAUI
	bool "Enable RXAUI support"
	depends ARCH_HAS_DW_XPCS_RXAUI

config DW_XPCS_EEE
	bool "Enable energy efficiency ethernet (EEE) support"
	depends ARCH_HAS_DW_XPCS_EEE

config DW_XPCS_GPIO
	bool "Enable GPIO support"
	depends ARCH_HAS_DW_XPCS_GPIO

endif

endmenu
```

## drivers/noc/Kconfig
```kconfig
#
# For a description of the syntax of this configuration file,
# see scripts/kbuild/config-language.txt.
#

menu "NoC interconnect drivers"

config ARCH_HAS_NOC
	bool

config ARCH_HAS_NCORE_RECONF
	bool

menuconfig NCORE
	bool "Arteris Ncore interconnect support"
	select NCORE_RECONF if ARCH_HAS_NCORE_RECONF

if NCORE

config NCORE_RECONF
	bool "Enable reconfiguration of NoC"
	depends ARCH_HAS_NCORE_RECONF
	help
	  For number of CAIs (normally equivalent to the number of CPU
	  cores) that is less than 32, it is possible to configure them
	  all at once using masks. By doing this, reconfiguration of NoC
	  is allowed.

endif

menuconfig MONACO
	bool "Qualcomm MONACO ring interconnect support"

if MONACO

endif

config CCN512
	bool "ARM CCN512 support"

config CCI550
	bool "ARM CCI550 support"

config ARCH_HAS_CMN600
	bool

menuconfig CMN600
	bool "ARM CMN600 support"
	depends ARCH_HAS_CMN600

if CMN600

config ARCH_HAS_CMN600_CML
	bool

config CMN600_HNF_CAL
	bool "Enable Component Aggregation Layer (CAL) mode on HN-F support"

config CMN600_CML
	bool "Enable Coherent Multichip Link (CML) support"
	depends ARCH_HAS_CMN600_CML
	select BIT_FLS64

config CMN600_SAM_RANGE_BASED
	bool "Enable range based SAM configuration"
	help
	  By default, ARM reference driver uses range based rather than
	  hashed SAM configuration. However, this driver uses hashed SAM
	  unless this option is enabled.

if CMN600_CML

config CMN600_CML_TLP
	bool "Enable PCIe TLP header support"

config CMN600_CML_RA_RAID_NO_CXRA
	bool "Enable counting CXRA as agent ID"
	help
	  According to silicon verification, CXRA needn't be assigned of
	  an agent ID. However, this is the default behavior according to
	  ARM reference driver.

config CMN600_CML_HA_RAID_RNF_LOCAL
	bool "Enable programming local RN-F agent IDs"
	help
	  According to silicon verification, not only remote RN-F but also
	  local RN-F should be programmed to CMN_cxg_ha_rnf_raid_to_ldid
	  with RNF feild filling with 0.
	  However, ARM reference driver never fills such entries.

config CMN600_RAS
	bool "Enable realiability availability serviceability support"
	depends RAS

endif

config CMN600_DEBUG
	bool "Enable register debugging"
	depends CONSOLE_DEBUG

config CMN600_DEBUG_DISCOVER
	bool "Enable discover result debugging"
	depends CMN600_DEBUG

config CMN600_DEBUG_CONFIGURE
	bool "Enable configure progress debugging"
	depends CMN600_DEBUG

endif

source drivers/noc/n100/Kconfig

endmenu
```

## drivers/noc/n100/Kconfig
```kconfig
#
# For a description of the syntax of this configuration file,
# see scripts/kbuild/config-language.txt.
#

config ARCH_HAS_N100
	bool

menuconfig N100
	bool "SpacemiT N100 support"
	depends ARCH_HAS_N100

if N100

config ARCH_HAS_N100_CCIX
	bool

config N100_CCIX
	bool "Enable Cache Coherent Interconnect for Accelerators (CCIX) support"
	select BIT_FLS64

if N100_CCIX

endif

config N100_DEBUG
	bool "Enable register debugging"
	depends CONSOLE_DEBUG

endif
```

## drivers/pci/Kconfig
```kconfig
#
# For a description of the syntax of this configuration file,
# see scripts/kbuild/config-language.txt.
#

menu "PCI drivers"

config ARCH_HAS_DW_PCIE_RC
	bool

config ARCH_HAS_DW_PCIE_EP
	bool

menuconfig DW_PCIE
	bool "Synopsys DesignWare PCI-Express (PCIe) support"
	depends ARCH_HAS_PCI

if DW_PCIE

config DW_PCIE_RC
	bool "Enable PCIe root complex (RC) support"
	depends ARCH_HAS_DW_PCIE_RC
	default y

config DW_PCIE_SPEED_GEN1
	bool "Enable GEN1 link speed limitation support"
	default n
	help
	  This option should only be enabled for chiplink implementation
	  on ZEBU.

config DW_PCIE_DEBUG
	bool "Enable register access debugging support"

endif

endmenu
```

## drivers/peci/Kconfig
```kconfig
#
# For a description of the syntax of this configuration file,
# see scripts/kbuild/config-language.txt.
#

menu "PECI slave drivers"

menuconfig SPACEMIT_SPI_PECI
	bool "SPACEMIT PECI emulation support"
	depends PECI
	select SPI
	select SPI_SLAVE

if SPACEMIT_PECI

endif

endmenu
```

## drivers/phy/Kconfig
```kconfig
#
# For a description of the syntax of this configuration file,
# see scripts/kbuild/config-language.txt.
#

menu "Physical medium drivers"

config DW_E16MP_TSMC12FFC
	bool "Synopsys DWC E16MP PHY TSMC12FFC support"

if DW_E16MP_TSMC12FFC

endif

endmenu
```

## drivers/pmu/Kconfig
```kconfig
#
# For a description of the syntax of this configuration file,
# see scripts/kbuild/config-language.txt.
#

menu "PMU drivers"

config ARCH_HAS_SMMU_PMCG
	bool
	depends ARM_SMMUv3

config SMMU_PMCG
	bool "SMMUv3 performance monitor counter groups (PMCG) support"
	depends ARCH_HAS_SMMU_PMCG

if SMMU_PMCG

config SMMU_PMCG_MSI
	bool "Enable PMCG MSI support"

endif

endmenu
```

## drivers/ras/Kconfig
```kconfig
menu "RAS drivers"

config CMN600_RAS
	bool "Enable CMN600 realiability availability serviceability (RAS) support"
	depends RAS

config DDR_RAS
	bool "Enable DDR reliability availability serviceability (RAS) support"
	depends RAS && DW_UMCTL2_DDR5
	select RISCV_GHES
	help
	  This option enables DDR RAS support for error detection and handling.
	  It includes features such as:
	  - ECC error detection and correction
	  - CRC error detection
	  - Parity error detection
	  - Interrupt handling for various error types

config ECC_SRAM_RAS
	bool "Enable ECC SRAM reliability availability serviceability (RAS) support"
	depends on RAS
	help
	  This option enables ECC SRAM RAS support for error detection and handling.
	  It includes features such as:
	  - ECC error detection and correction for SRAM
	  - Interrupt handling for SEC/DED errors
	  - Error injection and threshold configuration

endmenu
```
