## drivers/uart/Kconfig
```kconfig
#
# For a description of the syntax of this configuration file,
# see scripts/kbuild/config-language.txt.
#

menu "Debugging console drivers"

config CON_NS16550
	bool

config DBG_NS16550
	bool

config ARCH_HAS_NS16540
	bool

config ARCH_HAS_NS16550
	bool

config ARCH_HAS_NS16750
	bool

config ARCH_HAS_NS16550_FIFO_0
	bool

config ARCH_HAS_NS16550_FIFO_16
	bool

config ARCH_HAS_NS16550_FIFO_32
	bool

config ARCH_HAS_NS16550_FIFO_64
	bool

config ARCH_HAS_NS16550_FIFO_128
	bool

config ARCH_HAS_NS16550_FIFO_256
	bool

config ARCH_HAS_NS16550_FIFO_512
	bool

config ARCH_HAS_NS16550_FIFO_1024
	bool

config ARCH_HAS_NS16550_FIFO_2048
	bool

config ARCH_HAS_NS16550_MEM32
	bool

menuconfig NS16550
	bool "National Semiconductor 16550 UART support"
	depends ARCH_HAS_NS16550
	select CON_NS16550 if CONSOLE
	select DBG_NS16550 if DEBUG_PRINT
	select ARCH_HAS_UART
	select MATH_DIV32

if NS16550

choice
	prompt "FIFO depth"
	default NS16550_FIFO_64

config NS16550_FIFO_NONE
	bool "0"
	depends ARCH_HAS_NS16550_FIFO_0

config NS16550_FIFO_16
	bool "16"
	depends ARCH_HAS_NS16550_FIFO_16

config NS16550_FIFO_32
	bool "32"
	depends ARCH_HAS_NS16550_FIFO_32

config NS16550_FIFO_64
	bool "64"
	depends ARCH_HAS_NS16550_FIFO_64

config NS16550_FIFO_128
	bool "128"
	depends ARCH_HAS_NS16550_FIFO_128

config NS16550_FIFO_256
	bool "256"
	depends ARCH_HAS_NS16550_FIFO_256

config NS16550_FIFO_512
	bool "512"
	depends ARCH_HAS_NS16550_FIFO_512

config NS16550_FIFO_1024
	bool "1024"
	depends ARCH_HAS_NS16550_FIFO_1024

config NS16550_FIFO_2048
	bool "2048"
	depends ARCH_HAS_NS16550_FIFO_2048

endchoice

config NS16540
	bool "Enable 16540 compatible mode"
	depends ARCH_HAS_16540

config NS16750
	bool "Enable 16750 compatible mode"
	depends ARCH_HAS_16750

endif

config CON_DW_UART
	bool

config DBG_DW_UART
	bool

config ARCH_HAS_DW_UART_FIFO_MEM_EXTERNAL
	bool

config ARCH_HAS_DW_UART_FIFO_MEM_USER
	bool

config ARCH_HAS_DW_UART_FIFO_MEM_INTERNAL
	bool

config ARCH_HAS_DW_UART_16550_COMPATIBLE
	bool

config ARCH_HAS_DW_UART_AFCE_MODE
	bool

config ARCH_HAS_DW_UART_SIR_MODE
	bool

config ARCH_HAS_DW_UART_FIFO_ACCESS
	bool

config ARCH_HAS_DW_UART_ADDITIONAL_FEATURES
	bool

config ARCH_HAS_DW_UART_FIFO_STAT
	bool
	select ARCH_HAS_DW_UART_ADDITIONAL_FEATURES

config ARCH_HAS_DW_UART_SHADOW
	bool
	select ARCH_HAS_DW_UART_ADDITIONAL_FEATURES

config ARCH_HAS_DW_UART_ADD_ENCODED_PARAMS
	bool
	select ARCH_HAS_DW_UART_ADDITIONAL_FEATURES

config ARCH_HAS_DW_UART_DLF_SIZE_4
	bool

config ARCH_HAS_DW_UART_DLF_SIZE_6
	bool

menuconfig DW_UART
	bool "Synopsys DesignWare APB UART support"
	select CON_DW_UART if CONSOLE
	select DBG_DW_UART if DEBUG_PRINT
	select ARCH_HAS_UART
	select MATH_DIV32

if DW_UART

choice
	prompt "FIFO depth"
	default DW_UART_FIFO_16

config DW_UART_FIFO_NONE
	bool "0"
	depends ARCH_HAS_NS16550_FIFO_0

config DW_UART_FIFO_16
	bool "16"
	depends ARCH_HAS_NS16550_FIFO_16

config DW_UART_FIFO_32
	bool "32"
	depends ARCH_HAS_NS16550_FIFO_32

config DW_UART_FIFO_64
	bool "64"
	depends ARCH_HAS_NS16550_FIFO_64

config DW_UART_FIFO_128
	bool "128"
	depends ARCH_HAS_NS16550_FIFO_128

config DW_UART_FIFO_256
	bool "256"
	depends ARCH_HAS_NS16550_FIFO_256

config DW_UART_FIFO_512
	bool "512"
	depends ARCH_HAS_NS16550_FIFO_512

config DW_UART_FIFO_1024
	bool "1024"
	depends ARCH_HAS_NS16550_FIFO_1024

config DW_UART_FIFO_2048
	bool "2048"
	depends ARCH_HAS_NS16550_FIFO_2048

endchoice

choice
	prompt "FIFO memory type"
	default DW_UART_FIFO_MEM_INTERNAL

config DW_UART_FIFO_MEM_EXTERNAL
	bool "External"
	depends ARCH_HAS_DW_UART_FIFO_MEM_EXTERNAL

config DW_UART_FIFO_MEM_USER
	bool "External"
	depends ARCH_HAS_DW_UART_FIFO_MEM_USER

config DW_UART_FIFO_MEM_INTERNAL
	bool "Internal"
	depends ARCH_HAS_DW_UART_FIFO_MEM_INTERNAL
	depends !DW_UART_FIFO_2048 && !DW_UART_FIFO_1024 && !DW_UART_FIFO_512

endchoice

config DW_UART_9BIT_DATA
	bool "Enable 9-bit mode"
	depends ARCH_HAS_DW_AMBA_ADVANCED

config DW_UART_DLF
	bool "Enable fractional baud rate divisor"
	depends ARCH_HAS_DW_AMBA_ADVANCED

choice
	prompt "Fractional divisor width"
	default DW_UART_DLF_SIZE_4

config DW_UART_DLF_SIZE_4
	bool "4"
	depends DW_UART_DLF
	depends ARCH_HAS_DW_UART_DLF_SIZE_4

config DW_UART_DLF_SIZE_6
	bool "6"
	depends DW_UART_DLF
	depends ARCH_HAS_DW_UART_DLF_SIZE_6

endchoice

config DW_UART_16550_COMPATIBLE
	bool "Enable 16550-compatible mode"
	depends ARCH_HAS_DW_UART_16550_COMPATIBLE
	help
	  Configure the peripheral to be fully 16550 compatible. This is
	  achieved by not having the busy functionality implemented.

config DW_UART_AFCE_MODE
	bool "Enable 16750-compatible auto flow control mode"
	depends ARCH_HAS_DW_UART_AFCE_MODE
	depends !DW_UART_FIFO_NONE

config DW_UART_SIR_MODE
	bool "Enable IrDA 1.0 SIR infrared mode"
	depends ARCH_HAS_DW_UART_SIR_MODE

config DW_UART_FIFO_ACCESS
	bool "Enable FIFO access test mode"
	depends ARCH_HAS_DW_UART_FIFO_ACCESS

config DW_UART_ADDITIONAL_FEATURES
	bool "Enable additional registers"

if DW_UART_ADDITIONAL_FEATURES

config DW_UART_FIFO_STAT
	bool "Enable FIFO status registers"
	depends !DW_UART_FIFO_NONE

config DW_UART_SHADOW
	bool "Enable shadow registers"

config DW_UART_ADD_ENCODED_PARAMS
	bool "Enable configuration parameter register"

endif

endif

menuconfig UART_PL01X
	bool "ARM CoreLink PrimeCell UART (PL01x) support"
	select ARCH_HAS_UART
	help
	  ARM CoreLink PrimeCell UART (PL010/PL011) offers similar
	  functionality to the industry-standard 16C550 UART.

if UART_PL01X

config ARCH_IS_UART_PL010
	bool

config ARCH_IS_UART_PL011
	bool

choice
	prompt "PL01x architecture"

config UART_PL010
	bool "PL010"
	depends ARCH_IS_UART_PL010

config UART_PL011
	bool "PL011"
	depends ARCH_IS_UART_PL011

endchoice

config UART_PL01X_SBSA
	bool "PL01X Server Base System Architecture (SBSA) subset"
	select ARCH_IS_UART_PL011
	help
	  Select this to exclude non-SBSA required features.

endif

config CON_SEGGER_RTT
	bool

config SEGGER_RTT
	bool "SEGGER Real-Time Transfer (RTT) support"
	select CON_SEGGER_RTT if CONSOLE
	help
	  Implementation of SEGGER real-time transfer (RTT) whichallows
          real-time communication on targets which support debugger memory
          accesses while the CPU is running.

config DW_UART_BIRD
	bool "Temp dw uart driver"
	help
	  temp uart driver

endmenu
```

## drivers/video/Kconfig
```kconfig
#
# For a description of the syntax of this configuration file,
# see scripts/kbuild/config-language.txt.
#

menu "Video drivers"

config VIDEO_HX8347G
	bool "Himax HX8347-G TFT controller support"
	select GPIO
	depends VIDEO

if VIDEO_HX8347G

endif

endmenu
```

## drivers/wdt/Kconfig
```kconfig
#
# For a description of the syntax of this configuration file,
# see scripts/kbuild/config-language.txt.
#

menu "WatchDog drivers"

config DW_WDTS
	bool "Synopsys DesignWare APB watchdog support"

endmenu
```
