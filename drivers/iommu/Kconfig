## drivers/iommu/Kconfig
```kconfig
#
# For a description of the syntax of this configuration file,
# see scripts/kbuild/config-language.txt.
#

menu "IO MMU drivers"

config ARCH_HAS_SMMU
	bool

config ARCH_HAS_SMMUv1
	bool
	select ARCH_HAS_SMMU

config ARCH_HAS_SMMUv1_64KB
	bool
	select ARCH_HAS_SMMUv1

config ARCH_HAS_SMMUv2
	bool
	select ARCH_HAS_SMMU

config ARCH_HAS_RVSMMU
	bool
	select ARCH_HAS_SMMU

config ARCH_HAS_SMMUv3
	bool

config ARCH_HAS_SMMUv3_0
	bool
	select ARCH_HAS_SMMUv3

config ARCH_HAS_SMMUv3_1
	bool
	select ARCH_HAS_SMMUv3_0

config ARCH_HAS_SMMUv3_2
	bool
	select ARCH_HAS_SMMUv3_1

config ARCH_IS_SMMU_SM
	bool

config ARCH_HAS_SMMU_S2
	bool

config ARCH_HAS_SMMU_BTM
	bool

config ARCH_HAS_SMMU_CTTW
	bool

config ARCH_HAS_SMMU_HAFDB
	bool

config ARCH_HAS_SMMU_VMID16
	bool

config ARCH_HAS_SMMU_SSDT
	bool

config ARCH_HAS_SMMU_EXSMRG
	bool

config ARCH_HAS_SMMU_COMPINDEX
	bool

config ARCH_HAS_SMMU_E2HC
	bool

config ARCH_HAS_SMMU_PTFS_SHORT
	bool
	help
	  AArch32 short-descriptor support.

config ARCH_HAS_SMMU_PTFS_LONG
	bool
	help
	  AArch32 long-descriptor support.

config ARCH_HAS_SMMU_PTFS_v8_4KB
	bool
	help
	  4KB translation granule size.

config ARCH_HAS_SMMU_PTFS_v8_16KB
	bool
	help
	  16KB translation granule size.

config ARCH_HAS_SMMU_PTFS_v8_64KB
	bool
	help
	  64KB translation granule size.

config ARCH_HAS_SMMU_PTFS_SV32
	bool
	help
	  RISC-V 32-bit address translation.

config ARCH_HAS_SMMU_PTFS_SV39
	bool
	help
	  RISC-V 39-bit address translation.

config ARCH_HAS_SMMU_PTFS_SV48
	bool
	help
	  RISC-V 48-bit address translation.

config SMMU_COMMON
	bool
	select HEAP

config SMMU
	bool
	select BIT_FIND_CLEAR
	select SMMU_COMMON

config RISCV_IOMMU
	bool

choice
	prompt "Translation scheme"

config SMMU_ARCH64
	bool "ARCH64"
	depends ARM_SMMUv2 || ARM_SMMUv3

config SMMU_ARCH32_S
	bool "ARCH32 short"
	depends ARCH_HAS_SMMU_PTFS_SHORT

config SMMU_ARCH32_L
	bool "ARCH32 long"
	depends ARCH_HAS_SMMU_PTFS_LONG

config SMMU_SV39
	bool "RISCV SV39"
	depends ARCH_HAS_SMMU_PTFS_SV39

config SMMU_SV48
	bool "RISCV SV48"
	depends ARCH_HAS_SMMU_PTFS_SV48

endchoice

if SMMU

config SMMU_CTTW
	bool "Coherent table walk (CTTW) support"
	depends ARCH_HAS_SMMU_CTTW

config SMMU_BTM
	bool "Broadcast TLB maintenance (BTM) support"
	depends ARCH_HAS_SMMU_BTM

config SMMU_HAFDB
	bool "Hardware access flag and dirty bit (HAFADBS) support"
	depends ARCH_HAS_SMMU_HAFDB

endif

menuconfig ARM_SMMU
	bool "ARM System Memory Management Unit (SMMU) support"
	depends ARCH_HAS_SMMU
	select SMMU

if ARM_SMMU

choice
	prompt "SMMU Architecture"

config ARM_SMMUv1
	bool "ARM SMMUv1"
	depends ARCH_HAS_SMMUv1
	select ARCH_HAS_SMMU_SSDT

config ARM_SMMUv1_64KB
	bool "ARM SMMUv1 64KB"
	depends ARCH_HAS_SMMUv1_64KB

config ARM_SMMUv2
	bool "ARM SMMUv2"
	depends ARCH_HAS_SMMUv2
	select ARCH_HAS_SMMU_EXSMRG
	select ARCH_HAS_SMMU_SSDT
	select ARCH_HAS_SMMU_COMPINDEX

endchoice

config SMMU_SSDT
	bool "Security state determination table (SSDT) support"
	depends ARCH_HAS_SMMU_SSDT

config SMMU_EXSMRG
	bool "Extended stream match register group (EXSMRG) support"
	depends ARCH_HAS_SMMU_EXSMRG
	select ARCH_IS_SMMU_SM

config SMMU_COMPINDEX
	bool "StreamID compressed indexing support"
	depends ARCH_HAS_SMMU_COMPINDEX

config SMMU_E2HC
	bool "E2H context (E2HC) support"
	depends ARCH_HAS_SMMU_E2HC

config SMMU_DISABLE_BYPASS
	bool "Disable bypass streams"
	help
	  Disable bypass streams such that incoming transactions from
	  devices that are not attached to an iommu domain will report an
	  abort back to the device and will not be allowed to pass through
	  the SMMU.

endif

menuconfig ARM_SMMUv3
	bool "ARM System Memory Management Unit v3 (SMMUv3) support"
	depends ARCH_HAS_SMMUv3
	select BIT_FIND_CLEAR
	select BIT_FLS64
	select SMMU_COMMON
	select ARCH_HAS_SMMU_PMCG

if ARM_SMMUv3

endif

config SMMU_MMU500
	bool "ARM CoreLink MMU-500 SMMU support"
	select ARCH_HAS_SMMUv2
	select ARM_SMMU

config SMARCO_RVSMMU
	bool "SmarCo DUOWEN RISCV SMMU (RVSMMU) support"
	select ARCH_HAS_RVSMMU
	select ARCH_IS_SMMU_SM
	select ARCH_HAS_SMMU_BTM
	select ARCH_HAS_SMMU_VMID16
	select ARCH_HAS_SMMU_PTFS_SV39
	select SMMU

config SMMU_MMU600
	bool "ARM CoreLink MMU-600 SMMU support"
	select ARCH_HAS_SMMUv3
	select ARM_SMMUv3

config IOMMU_PGTABLE_ARMv8
	bool "ARMv8 I/O page table support"

config IOMMU_PGTABLE_RISCV
	bool "RISC-V I/O page table support"

endmenu
```

## drivers/kcs/Kconfig
```kconfig
menu "KCS drivers"

menuconfig KCS_MICROSEMI_CORELPC
	bool "Enable KCS Microsemi CoreLPC support"
	depends KCS
endmenu
```

## drivers/lcd/Kconfig
```kconfig
#
# For a description of the syntax of this configuration file,
# see scripts/kbuild/config-language.txt.
#

menu "LCD drivers"

config LCD_HD44780U
	bool "Hitachi HD44780U LCD controller support"
	depends LCD

if LCD_HD44780U
config LCD_HD44780U_MAX_ROWS
	int "Number of dispaly rows (1~2)"
	range 1 2
	depends LCD
	default 2

config LCD_HD44780U_MAX_COLS
	int "Number of dispaly columns (1~16)"
	range 1 16
	depends LCD
	default 16
endif

config LCD_PCF2119X
	bool "NXP PCF2119X LCD controller support"
	depends LCD

if LCD_PCF2119X

config LCD_PCF2119X_DISP_LINE
	int "Number of dispaly rows (1~2)"
	range 1 2
	default 2

config LCD_PCF2119X_DATA_LENGTH_8BITS
	bool "Interface data length"
	default y

config LCD_PCF2119X_MUL_MODE32
	bool "1x32 or 2x16 character display"
	default y

endif

config LCD_NHDC0216AZ
	bool "Newheaven Display C0216AZ LCD controller support"
	depends LCD

if LCD_NHDC0216AZ

config LCD_NHD_C0216AZ_MAX_ROWS
	int "Number of dispaly rows (1~2)"
	range 1 2
	default 2

config LCD_NHD_C0216AZ_MAX_COLS
	int "Number of dispaly columns (1~16)"
	range 1 16
	depends LCD
	default 16

endif

config LCD_NHDC0216CIZ
	bool "Newheaven Display C0216CiZ LCD controller support"
	depends LCD

if LCD_NHDC0216CIZ
endif

endmenu
```

## drivers/lpc/Kconfig
```kconfig
menu "LPC drivers"

menuconfig SPACEMIT_LPC
	bool "Enable SpacemiT low pin counter bridge (LPC) support"
	depends LPC

if SPACEMIT_LPC

config SPACEMIT_LPC_BRIDGE
	bool "Enable AXI bridging support"
	
endif

endmenu
```

## drivers/mctp/Kconfig
```kconfig
#
# For a description of the syntax of this configuration file,
# see scripts/kbuild/config-language.txt.
#

menu "MCTP Bus Owner Proxy drivers"

menuconfig SPACEMIT_MCTP
	bool "SPACEMIT MCTP support"
	depends MCTP

if SPACEMIT_MCTP

config SPACEMIT_MCTP_DEBUG_IO
	bool "Enable IO register debugging"
	depends CONSOLE_DEBUG

endif

endmenu
```

## drivers/mmc/Kconfig
```kconfig
#
# For a description of the syntax of this configuration file,
# see scripts/kbuild/config-language.txt.
#

menu "MMC host drivers"

menuconfig DW_MSHC
	bool "Synopsys DesignWare Mobile Storage Host (MSHC) support"
	select SDHCI

if DW_MSHC

choice
	prompt "Card interface type"

config DW_MSHC_SD_UHSII
	bool "SD + UHS-II"
	select ARCH_HAS_SD
	select ARCH_HAS_UHSII

config DW_MSHC_SD
	bool "SD"
	select ARCH_HAS_SD

config DW_MSHC_UHSII
	bool "UHS-II"
	select ARCH_HAS_UHSII

config DW_MSHC_SD_EMMC
	bool "SD + eMMC"
	select ARCH_HAS_SD
	select ARCH_HAS_EMMC

config DW_MSHC_EMMC
	bool "eMMC"
	select ARCH_HAS_EMMC

endchoice

config DW_MSHC_UHSII_PHY_LINK_WIDTH_8BIT
	bool "Enable UHS-II 8-bit PHY-LINK interface width"
	depends ARCH_HAS_UHSII
	help
	  By default, UHS-II PHY-LINK interface width is 16-bit, this
	  option enables 8-bit support.

config DW_MSHC_SD_DAT_WIDTH_8BIT
	bool "Enable SD/eMMC 8-bit data bus width"
	default y if !SD
	depends ARCH_HAS_SD || ARCH_HAS_EMMC
	help
	  It's recommended to use 4-bit data interface width for SD
	  applications and 8-bit data interface width for eMMC
	  applications. However, this is no restriction on using any width
	  for an SD/eMMC application. By default, 4-bit data interface
	  width is used. This option allows to switch to 8-bit data
	  interface width.

config DW_MSHC_LS_NO_PHY_MODE
	bool "SD/eMMC low speed SDR only support"
	depends !DW_MSHC_UHSII
	help
	  Indicates DWC_mshc is configured to support SD/eMMC low speed
	  mode SDR upto 100MHz without PHY. When selected, MSHC provides a
	  programmable option to launch sd_dat_out* and sd_cmd_out* with
	  respect to negative edge of cclk_tx and a programmable option to
	  sample sd_dat_in and sd_cmd_in with respect to negative edge of
	  cclk_rx. Tuning of sampling clock is not supported.

menu "DMA settings"

config DW_MSHC_DMA
	bool

config DW_MSHC_SDMA
	bool "Enable SDMA support"
	select DW_MSHC_DMA

config DW_MSHC_ADMA2
	bool "Enable ADMA2 support"
	select DW_MSHC_DMA

config DW_MSHC_ADMA3
	bool "Enable ADMA3 support"
	select DW_MSHC_DMA

if DW_MSHC_DMA

choice
	prompt "Packet buffer depth (external memory size)"
	default DW_MSHC_PKT_BUF_DEPTH_512
	help
	  Sets the depth of the Packet Buffer.
	  Packet buffer is a local storage used by DWC_mshc to store data
	  packets while carrying out data transfer to and from the card.
	  An external SPRAM is used as a packet buffer. The depth of
	  external SPRAM must be same as value of this parameter.
	  The depth of the packet buffer decides the number of blocks that
	  can be pre-fetched during a card write or the number of blocks
	  that can be stored before throttling the card interface during
	  card read.
	  The selected Master Interface data width decides the total
	  Packet Buffer Size Packet Buffer Size (in bytes) =
	  Packet Buffer Depth x AXI Data Width (in bytes)
	  It is recommended to select the minimum size of the Packet Buffer
	  as:
	  * 2 x Maximum Block Size (for SD/eMMC)
	  * 2 x Maximum N_FCU x Maximum Block Size (for UHS-II)
	  Note: When CQE is enabled with extra rows in the packet buffer,
	  you must select a higher depth than the minimum required.

config DW_MSHC_PKT_BUF_DEPTH_256
	bool "256"

config DW_MSHC_PKT_BUF_DEPTH_512
	bool "512"

config DW_MSHC_PKT_BUF_DEPTH_1024
	bool "1024"

config DW_MSHC_PKT_BUF_DEPTH_2048
	bool "2048"

config DW_MSHC_PKT_BUF_DEPTH_4096
	bool "4096"

config DW_MSHC_PKT_BUF_DEPTH_8192
	bool "8192"

config DW_MSHC_PKT_BUF_DEPTH_16384
	bool "16384"

config DW_MSHC_PKT_BUF_DEPTH_32768
	bool "32768"

endchoice

choice
	prompt "Internal FIFO depth (DMA <-> external memory)"
	default DW_MSHC_DMAQ_DEPTH

config DW_MSHC_DMAQ_DEPTH_4
	bool "4"

config DW_MSHC_DMAQ_DEPTH_8
	bool "8"

config DW_MSHC_DMAQ_DEPTH_16
	bool "16"

endchoice

endif

endmenu

if DW_MSHC_SD_EMMC && !DW_MSHC_LS_NO_PHY_MODE

menu "SD/eMMC tuning"

config DW_MSHC_TUNE
	bool

choice
	prompt "Tuning modes"

config DW_MSHC_RETUNE_MODE_1
	bool "Mode 1"
	select DW_MSHC_TUNE

config DW_MSHC_RETUNE_MODE_3
	bool "Mode 3"
	select DW_MSHC_TUNE

endchoice

choice
	prompt "Number of re-tuning timer"

config DW_MSHC_RETUNE_TIMER_1
	bool "1 second"

config DW_MSHC_RETUNE_TIMER_2
	bool "2 seconds"

config DW_MSHC_RETUNE_TIMER_4
	bool "4 seconds"

config DW_MSHC_RETUNE_TIMER_8
	bool "8 seconds"

config DW_MSHC_RETUNE_TIMER_16
	bool "16 seconds"

config DW_MSHC_RETUNE_TIMER_32
	bool "32 seconds"

config DW_MSHC_RETUNE_TIMER_64
	bool "64 seconds"

config DW_MSHC_RETUNE_TIMER_128
	bool "128 seconds"

config DW_MSHC_RETUNE_TIMER_256
	bool "256 seconds"

config DW_MSHC_RETUNE_TIMER_512
	bool "512 seconds"

config DW_MSHC_RETUNE_TIMER_1024
	bool "1024 seconds"

endchoice

config DW_MSHC_TUNE_SDR50
	bool "Tuning required for SDR50"

choice
	prompt "Number of tuning clock phases"

config DW_MSHC_DL_CW_8
	bool "8"

config DW_MSHC_DL_CW_16
	bool "16"

config DW_MSHC_DL_CW_32
	bool "32"

config DW_MSHC_DL_CW_64
	bool "64"

config DW_MSHC_DL_CW_128
	bool "128"

endchoice

choice
	prompt "Default tuning mode"

config DW_MSHC_TUNE_WIN
	bool "Large sampling window mode"

config DW_MSHC_TUNE_TH
	bool "Threshold based mode"

endchoice

endmenu

endif

endif

menuconfig SDHCI
	bool "Secure Digital Host Controller (SDHC) support"
	select ARCH_HAS_SDHC
	select BIT_FLS32

if SDHCI

config SDHC_SD
	bool "SD mode support"

config SDHC_UHSI
	bool "UHS-I mode support"
	select SDHC_SD

config SDHC_UHSII
	bool "UHS-II mode support"

endif

endmenu
```

## drivers/mtd/Kconfig
```kconfig
#
# For a description of the syntax of this configuration file,
# see scripts/kbuild/config-language.txt.
#

menu "MTD memory drivers"

config DATAFLASH_AT45DB642D
	bool "ATMEL AT45DB642D DataFlash support"
	select MTD_DATAFLASH

if DATAFLASH_AT45DB642D

endif

config SPIFLASH_W25Q
	bool "Winbond W25Q series SPI flash support"
	select MTD_SPIFLASH

if SPIFLASH_W25Q

endif

endmenu
```
