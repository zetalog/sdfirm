## drivers/rio/Kconfig
```kconfig
#
# For a description of the syntax of this configuration file,
# see scripts/kbuild/config-language.txt.
#

menu "RIO controller drivers"

config ARCH_IS_RAB_SERIAL
	bool

config ARCH_IS_RAB_PAGE_2KB
	bool

config ARCH_IS_RAB_PAGE_4KB
	bool

config ARCH_HAS_RAB_DEBUG
	bool

config ARCH_HAS_RAB_INTR
	bool

config ARCH_HAS_RAB_RIO_50BIT
	bool

config ARCH_HAS_RAB_SRIO_1X
	bool

config ARCH_HAS_RAB_SRIO_2X
	bool

config ARCH_HAS_RAB_SRIO_4X
	bool

config ARCH_HAS_RAB_SRIO_1_25G
	bool

config ARCH_HAS_RAB_SRIO_2_5G
	bool

config ARCH_HAS_RAB_SRIO_3_125G
	bool

config ARCH_HAS_RAB_SRIO_5G
	bool

config ARCH_HAS_RAB_SRIO_6_25G
	bool

config ARCH_IS_RAB_LCS
	bool

config ARCH_IS_RAB_SCS
	bool

config ARCH_HAS_RAB_BPOT_LI
	bool

config ARCH_HAS_RAB_BPIN_LO
	bool

config ARCH_HAS_RAB_BPOT_PBUS
	bool

config ARCH_HAS_RAB_BPIN_PBUS
	bool

config ARCH_HAS_RAB_CSRLOCK
	bool

config ARCH_HAS_RAB_AET
	bool

menuconfig MOBIVEIL_RAB
	bool "MobiVeil RapidIO to AXI Bridge (RAB) controller support"
	select SRIO if ARCH_IS_RAB_SERIAL

if MOBIVEIL_RAB

choice
	prompt "Link mode"

config RAB_SRIO_1X
	bool "1X lane"
	depends ARCH_HAS_RAB_SRIO_1X
	select ARCH_HAS_SRIO_1X

config RAB_SRIO_2X
	bool "2X lane"
	depends ARCH_HAS_RAB_SRIO_2X
	select ARCH_HAS_SRIO_2X

config RAB_SRIO_4X
	bool "4X lane"
	depends ARCH_HAS_RAB_SRIO_4X
	select ARCH_HAS_SRIO_4X

endchoice

choice
	prompt "Link speed"

config RAB_SRIO_1_25G
	bool "1.25Gbaud"
	depends ARCH_HAS_RAB_SRIO_1_25G
	select ARCH_HAS_SRIO_1_25G

config RAB_SRIO_2_5G
	bool "2.5Gbaud"
	depends ARCH_HAS_RAB_SRIO_2_5G
	select ARCH_HAS_SRIO_2_5G

config RAB_SRIO_3_125G
	bool "3.125Gbaud"
	depends ARCH_HAS_RAB_SRIO_3_125G
	select ARCH_HAS_SRIO_3_125G

config RAB_SRIO_5G
	bool "5Gbaud"
	depends ARCH_HAS_RAB_SRIO_5G
	select ARCH_HAS_SRIO_5G

config RAB_SRIO_6_25G
	bool "6.25Gbaud"
	depends ARCH_HAS_RAB_SRIO_6_25G
	select ARCH_HAS_SRIO_6_25G

endchoice

choice
	prompt "Transport system"

config RAB_LCS
	bool "Large"
	depends ARCH_IS_RAB_LCS

config RAB_SCS
	bool "Small"
	depends ARCH_IS_RAB_SCS

endchoice

choice
	prompt "Page size"
	help
	  A dedicated APB slave interface is provided to AMBA hosts for
	  CSR access. It provides either 4KB or 8KB access window. The
	  page size is decided based on RAB_APB_CSR[page] register fields.

config RAB_PAGE_2KB
	bool "2KB"
	depends ARCH_IS_RAB_PAGE_2KB
	help
	  For 4KB access window, the lower 2KB APB addresses directly
	  mapped to RAB registers (the lower 2KB), and the higher APB 2KB
	  addresses get mapped to a 2KB paged window in the 16MB space.
	  There are 8K pages of size 2KB to access full 16MB space.

config RAB_PAGE_4KB
	bool "4KB"
	depends ARCH_IS_RAB_PAGE_4KB
	help
	  For 8KB access window, the lower 4KB APB addresses directly
	  mapped to RAB registers (the lower 4KB), and the higher APB 4KB
	  addresses get mapped to a 4KB paged window in the 16MB space.
	  There are 4K pages of size 4KB to access full 16MB space.

endchoice

config RAB_FORCE_2X
	bool "Enable force 2X lane"
	depends RAB_SRIO_4X

config RAB_FORCE_1X
	bool "Enable force 1X lane"
	depends RAB_SRIO_4X

config RAB_DEBUG
	bool "Enable debug feature registers"
	depends ARCH_HAS_RAB_DEBUG

config RAB_INTR
	bool "Enable AXI-WR registers for interrupt"
	depends ARCH_HAS_RAB_INTR

config RAB_RIO_50BIT
	bool "Enable RIO 50-bit addressing registers"
	depends ARCH_HAS_RAB_RIO_50BIT

menu "Bypass interface"

config RAB_BPOT_LI
	bool "Enable bypass out logic inbound"
	depends ARCH_HAS_RAB_BPOT_LI

config RAB_BPIN_LO
	bool "Enable bypass in logic outbound"
	depends ARCH_HAS_RAB_BPIN_LO

config RAB_BPOT_PBUS
	bool "Enable bypass out PBUS"
	depends ARCH_HAS_RAB_BPOT_PBUS

config RAB_BPIN_PBUS
	bool "Enable bypass in PBUS"
	depends ARCH_HAS_RAB_BPIN_PBUS

config RAB_CSRLOCK
	bool "Enable bypass CSR lock"
	depends ARCH_HAS_RAB_CSRLOCK

endmenu

config RAB_AET
	bool "Enable adaptive equalizatiion training"
	depends ARCH_HAS_RAB_AET

endif

endmenu
```

## drivers/scd/Kconfig
```kconfig
config ARCH_HAS_IFDS
	bool

if IFD
menu "IFD drivers"

config IFD_SERIAL
	bool "Serial smart card interface"

if IFD_SERIAL

endif

endmenu
endif


if PCD
menu "PCD drivers"

config PCD_PN53X
	bool "NXP PN53x proximity coupling device"

if PCD_PN53X

endif

endmenu
endif
```

## drivers/scs/Kconfig
```kconfig
config ARCH_HAS_IFDS
	bool

if IFD
menu "IFD drivers"

config IFD_SERIAL
	bool "Serial smart card interface"

if IFD_SERIAL

endif

endmenu
endif

config PN53X
	bool "NXP PN53x proximity coupling device"

if PN53X

choice
	prompt "PN53x host bus"

config PN53X_SPI
	bool "SPI"
	select SPI
	select SPI_MASTER

config PN53X_STUB
	bool "stub"

endchoice

endif

config ACR122
	bool "ACS ACR122 pseudo APDU support"
	select PN53X

if ACR122

endif

if PCD
menu "PCD drivers"

endmenu
endif

if COS
menu "COS drivers"

config COS_SCOS
	bool "Small device card operating system (SCOS)"
	default y

endmenu
endif
```

## drivers/spd/Kconfig
```kconfig
#
# SPD Devices
#

menu "Serial Presence Detect (SPD) drivers"

config SPD_BUS_KHZ
	int "I2C BUS frequency (KHz) for SPD"
	default 60

menuconfig SPD_EE1004
	bool "JEDEC EE1004 SPD EEPROM"
	depends I2C && I2C_MASTER
	default y

if SPD_EE1004

endif

menuconfig SPD5118
	bool "JEDEC SPD5118 Hub and SPD device"
	depends I2C && I2C_MASTER
	default y

endmenu
```

## drivers/spi/Kconfig
```kconfig
#
# For a description of the syntax of this configuration file,
# see scripts/kbuild/config-language.txt.
#

menu "SPI Master drivers"

config DW_SSI_MASTER
	bool

config ARCH_HAS_SSI_ENH_CLK_RATIO
	bool

config ARCH_HAS_SSI_RX_SAMPLE_DELAY
	bool

config ARCH_HAS_SSI_FIFO
	bool

config ARCH_HAS_SSI_XFER_16
	bool

config ARCH_HAS_SSI_XFER_32
	bool

config ARCH_IS_SSI_RX_FIFO_DEPTH_2
	bool

config ARCH_IS_SSI_RX_FIFO_DEPTH_4
	bool

config ARCH_IS_SSI_RX_FIFO_DEPTH_8
	bool

config ARCH_IS_SSI_RX_FIFO_DEPTH_16
	bool

config ARCH_IS_SSI_RX_FIFO_DEPTH_32
	bool

config ARCH_IS_SSI_RX_FIFO_DEPTH_64
	bool

config ARCH_IS_SSI_RX_FIFO_DEPTH_128
	bool

config ARCH_IS_SSI_RX_FIFO_DEPTH_256
	bool

config ARCH_IS_SSI_TX_FIFO_DEPTH_2
	bool

config ARCH_IS_SSI_TX_FIFO_DEPTH_4
	bool

config ARCH_IS_SSI_TX_FIFO_DEPTH_8
	bool

config ARCH_IS_SSI_TX_FIFO_DEPTH_16
	bool

config ARCH_IS_SSI_TX_FIFO_DEPTH_32
	bool

config ARCH_IS_SSI_TX_FIFO_DEPTH_64
	bool

config ARCH_IS_SSI_TX_FIFO_DEPTH_128
	bool

config ARCH_IS_SSI_TX_FIFO_DEPTH_256
	bool

config ARCH_IS_SSI_ENDCONV_NO
	bool

config ARCH_IS_SSI_ENDCONV_SIG
	bool

config ARCH_IS_SSI_ENDCONV_REG
	bool

config ARCH_HAS_SSI_DMA
	bool

config ARCH_HAS_SSI_FRF
	bool

config ARCH_HAS_SSI_SPI
	bool

config ARCH_HAS_SSI_SSP
	bool

config ARCH_HAS_SSI_MICROWIRE
	bool

config ARCH_HAS_SSI_DFLT_SCPOL
	bool

config ARCH_HAS_SSI_DFLT_SCPH
	bool

config ARCH_HAS_SSI_SCPH0_SSTOGGLE
	bool

config ARCH_HAS_SSI_DFLT_SECONV
	bool

config ARCH_HAS_SSI_SPI_1WIRE
	bool

config ARCH_HAS_SSI_SPI_2WIRE
	bool

config ARCH_HAS_SSI_SPI_4WIRE
	bool

config ARCH_HAS_SSI_SPI_8WIRE
	bool

config ARCH_HAS_SSI_IO_MAP
	bool

config ARCH_HAS_SSI_DDR
	bool
	depends !DW_SSI_SPI_MODE_STD && ARCH_HAS_DW_AMBA_ADVANCED
	help
	  Configures the device to support Dual Data transmission on both
	  positive and negative edge of sclk_out.

config ARCH_HAS_SSI_RXDS
	bool
	depends ARCH_HAS_DW_AMBA_ADVANCED
	select ARCH_HAS_SSI_DDR
	help
	  Configures the device to include data strobe signaling for rxd
	  signal.

config ARCH_HAS_SSI_DM
	bool
	depends !DW_SSI_SPI_MODE_STD && ARCH_HAS_APB_40 && \
		ARCH_HAS_DW_AMBA_ADVANCED
	help
	  Selects if data mask signal shall be included on SPI interface.

config ARCH_HAS_SSI_XIP
	bool

menuconfig DW_SSI
	bool "Synopsys DesignWare APB SSI support"
	select MATH_DIV32
	select DW_SSI_HC_FRF if !ARCH_HAS_SSI_FRF
	select DW_SSI_MASTER if SPI_MASTER

if DW_SSI

config DW_SSI_DEBUG
	bool "Enable debugging message"
	depends CONSOLE_DEBUG
	help
	  Additional debugging messages including register accesses and
	  driver states.

menu "Top Level Parameters"

config DW_SSI_ENH_CLK_RATIO
	bool "Include Enhanced Clock Ratio Architecture"
	depends ARCH_HAS_SSI_ENH_CLK_RATIO
	depends !DW_SSI_MASTER
	help
	  Enable device to work in clock ratio of 4 and 6 between ssi_clk
	  and sclk_in signals.

choice
	prompt "Maximum Transfer Size"
	default DW_SSI_MAX_XFER_SIZE_32
	help
	  Configures the maximum transfer size supported by device. The
	  receive and transmit FIFO widths will be equal to configured
	  value.

config DW_SSI_MAX_XFER_SIZE_16
	bool "16 Bits"
	depends ARCH_HAS_SSI_XFER_16

config DW_SSI_MAX_XFER_SIZE_32
	bool "32 Bits"
	depends ARCH_HAS_SSI_XFER_32

endchoice

config DW_SSI_FIFO_DEPTH
	bool "Use predefined FIFO buffer depth"
	depends !ARCH_HAS_SSI_FIFO

if DW_SSI_FIFO_DEPTH

config DW_SSI_RX_FIFO_DEPTH
	int "Receive FIFO buffer depth"
	default 8
	range 2 256 if DW_SSI_SPI_MODE_STD
	range 4 256 if !DW_SSI_SPI_MODE_STD

config DW_SSI_TX_FIFO_DEPTH
	int "Transmit FIFO buffer depth"
	default 8
	range 2 256 if DW_SSI_SPI_MODE_STD
	range 5 256 if (!DW_SSI_SPI_MODE_STD && DW_SSI_MAX_XFER_SIZE_16)
	range 3 256 if (!DW_SSI_SPI_MODE_STD && DW_SSI_MAX_XFER_SIZE_32)

endif

config DW_SSI_MAX_SLAVES
	int "Number of slave select lines"
	default 1
	range 1 16

config DW_SSI_RX_DLY_SR_DEPTH
	int "Maximum RXD Sample Delay"
	default 4
	range 4 255
	depends ARCH_HAS_SSI_RX_SAMPLE_DELAY
	help
	  Defines the maximum number of ssi_clk cycles that can be used to
	  delay the sampling of the rxd input.

config DW_SSI_ENDCONV
	bool "Include Endian Conversion for XIP and data register"
	depends ARCH_IS_SSI_ENDCONV_REG
	depends DW_SSI_MASTER

config DW_SSI_DMA
	bool "Enable DMA handshaking"
	depends ARCH_HAS_SSI_DMA

config DW_SSI_HC_FRF
	bool "Enable hard coded (fixed) frame format"
	depends !ARCH_HAS_SSI_FRF
	help
	  When set, the frame format (serial protocol) can be fixed so
	  that the user cannot dynamically program it.

choice
	prompt "Default frame format"
	default DW_SSI_DFLT_FRF_SPI

config DW_SSI_DFLT_FRF_SPI
	bool "Motorola SPI"
	depends ARCH_HAS_SSI_SPI

config DW_SSI_DFLT_FRF_SSP
	bool "TI SSP"
	depends ARCH_HAS_SSI_SSP

config DW_SSI_DFLT_FRF_MICROWIRE
	bool "NatSemi Microwire"
	depends ARCH_HAS_SSI_MICROWIRE

endchoice

config DW_SSI_DFLT_SCPOL
	bool "Default serial clock polarity"
	depends ARCH_HAS_SSI_DFLT_SCPOL
	depends DW_SSI_DFLT_FRF_SPI

config DW_SSI_DFLT_SCPH
	bool "Default serial clock phase"
	depends ARCH_HAS_SSI_DFLT_SCPH
	depends DW_SSI_DFLT_FRF_SPI

config DW_SSI_SCPH0_SSTOGGLE
	bool "Toggle slave select signal between frames"
	depends DW_SSI_DFLT_FRF_SPI || !DW_SSI_HC_FRF
	help
	  When operating in SPI mode with clock phase (SCPH) set to 0,
	  this parameter controls the behavior of the slave select line
	  (ss_*_n) between data frames.
	  1. If "Y" and CTRLR0.SSTE is "1" the "ss_*_n" line will
	     toggle between consecutive data frames, with the serial
	     clock (sclk) being held to its default value while "ss_*_n"
	     is high.
	  2. If "Y" and CTRLR0.SSTE is "0" the "ss_*_n" line will stay
	     low and sclk will run continuously for the duration of the
	     transfer.
	  3. If "N", the ss_*_n will stay low and sclk will run
	     continuously for the duration of the transfer.

config DW_SSI_DFLT_SECONV
	bool "Default Endianess Value"
	depends DW_SSI_ENDCONV
	depends ARCH_HAS_SSI_DFLT_SECONV

endmenu

menu "SPI Parameters"

config DW_SSI_SPI_MODE_STD_ONLY
	bool
	depends (ARCH_HAS_SSI_FRF || DW_SSI_DFLT_FRF_SPI) && \
		ARCH_HAS_DW_AMBA_ADVANCED

choice
	prompt "Select SPI mode"
	default DW_SSI_SPI_MODE_STD

config DW_SSI_SPI_MODE_STD
	bool "Standard SPI mode"
	depends ARCH_HAS_SSI_SPI_1WIRE

config DW_SSI_SPI_MODE_DUAL
	bool "Dual SPI mode"
	depends !DW_SSI_SPI_MODE_STD_ONLY
	depends ARCH_HAS_SSI_SPI_2WIRE

config DW_SSI_SPI_MODE_QUAD
	bool "Quad SPI mode"
	depends !DW_SSI_SPI_MODE_STD_ONLY
	depends ARCH_HAS_SSI_SPI_4WIRE

config DW_SSI_SPI_MODE_OCTAL
	bool "Octal SPI mode"
	depends !DW_SSI_SPI_MODE_STD_ONLY
	depends ARCH_HAS_SSI_SPI_8WIRE

endchoice

config DW_SSI_IO_MAP
	bool "Enable Enhanced SPI I/O mapping"
	depends ARCH_HAS_SSI_IO_MAP

config DW_SSI_DDR
	bool "Include Dual transfer rate transfers in SPI frame format"
	depends DW_SSI_MASTER
	depends !DW_SSI_SPI_MODE_STD
	depends ARCH_HAS_SSI_DDR
	depends ARCH_HAS_DW_AMBA_ADVANCED

config DW_SSI_RXDS
	bool "Include data strobe signal for rxd line"
	depends DW_SSI_DDR
	depends DW_SSI_MASTER
	depends ARCH_HAS_DW_AMBA_ADVANCED
	depends ARCH_HAS_SSI_RXDS

config DW_SSI_DM
	bool "Include Data Mask Signal for data transfer in SPI mode"
	depends !DW_SSI_SPI_MODE_STD
	depends ARCH_HAS_SSI_DM

config DW_SSI_XIP
	bool "Include XIP feature in SPI mode"
	depends ARCH_HAS_SSI_XIP
	depends !DW_SSI_SPI_MODE_STD && !ARCH_HAS_APB_20 && \
		ARCH_HAS_DW_AMBA_ADVANCED

endmenu

choice
	prompt "Flow control mode"
	default DW_SSI_FC_SCSTRETCH

config DW_SSI_FC_SSTOGGLE
	bool "Toggle CS (ss_*_n)"
	depends ARCH_HAS_SSI_SCPH0_SSTOGGLE
	help
	  Toggle ss_*_n line between consecutive data frames, with the
	  serial clock (sclk) being hold to its default value while
	  (ss_*_n) is high.

config DW_SSI_FC_SCSTRETCH
	bool "Stretch CLK (sclk)"
	help
	  The ss_*_n line stay low and sclk run continuously for the
	  duration of the transfer.

endchoice

config DW_SSI_XFER
	bool "Enable multi-byte transfer mode"

endif

endmenu
```

## drivers/stm/Kconfig
```kconfig
#
# For a description of the syntax of this configuration file,
# see scripts/kbuild/config-language.txt.
#

menu "STM drivers"

menuconfig SPACEMIT_STM
	bool "SPACEMIT STM support"
	default n
endmenu
```

## drivers/timer/Kconfig
```kconfig
#
# For a description of the syntax of this configuration file,
# see scripts/kbuild/config-language.txt.
#

menu "Timer drivers"

config DW_TIMERS
	bool "Synopsys DesignWare APB timers support"

if DW_TIMERS

config DW_TIMERS_COUNT
	int "Number of timer instances"
	range 1 8

endif

endmenu
```
